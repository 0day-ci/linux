## drivers/net/mctp/Kconfig
```kconfig
if MCTP

menu "MCTP Device Drivers"

config MCTP_SERIAL
	tristate "MCTP serial transport"
	depends on TTY
	select CRC_CCITT
	help
	  This driver provides an MCTP-over-serial interface, through a
	  serial line-discipline. By attaching the ldisc to a serial device,
	  we get a new net device to transport MCTP packets.

	  Say y here if you need to connect to MCTP devices over serial.

endmenu

endif
```

## drivers/net/pcs/Kconfig
```kconfig
# SPDX-License-Identifier: GPL-2.0-only
#
# PCS Layer Configuration
#

menu "PCS device drivers"

config PCS_XPCS
	tristate "Synopsys DesignWare XPCS controller"
	depends on MDIO_DEVICE && MDIO_BUS
	help
	  This module provides helper functions for Synopsys DesignWare XPCS
	  controllers.

config PCS_LYNX
	tristate
	help
	  This module provides helpers to phylink for managing the Lynx PCS
	  which is part of the Layerscape and QorIQ Ethernet SERDES.

config PCS_XILINX
	depends on OF
	depends on GPIOLIB
	depends on COMMON_CLK
	depends on PHYLINK
	tristate "Xilinx PCS driver"
	help
	  PCS driver for the Xilinx 1G/2.5G Ethernet PCS/PMA or SGMII device.
	  This device can either act as a PCS+PMA for 1000BASE-X or 2500BASE-X,
	  or as a GMII-to-SGMII bridge. It can also switch between 1000BASE-X
	  and SGMII dynamically if configured correctly when synthesized.
	  Typical applications use this device on an FPGA connected to a GEM or
	  TEMAC on the GMII side. The other side is typically connected to
	  on-device gigabit transceivers, off-device SERDES devices using TBI,
	  or LVDS IO resources directly.

	  To compile this driver as a module, choose M here: the module
	  will be called pcs-xilinx.

endmenu
```

## drivers/net/usb/realtek/Kconfig
```kconfig
# SPDX-License-Identifier: GPL-2.0-only
#
# Reatlek USB Network devices configuration
#
config USB_RTL8150
	tristate "USB RTL8150 based ethernet device support"
	select MII
	help
	  Say Y here if you have RTL8150 based usb-ethernet adapter.
	  Send me <petkan@users.sourceforge.net> any comments you may have.
	  You can also check for updates at <http://pegasus2.sourceforge.net/>.

	  To compile this driver as a module, choose M here: the
	  module will be called rtl8150.

config USB_RTL8152
	tristate "Realtek RTL8152/RTL8153 Based USB Ethernet Adapters"
	select MII
	help
	  This option adds support for Realtek RTL8152 based USB 2.0
	  10/100 Ethernet adapters and RTL8153 based USB 3.0 10/100/1000
	  Ethernet adapters.

	  To compile this driver as a module, choose M here: the
	  module will be called r8152.

config USB_RTL8153_ECM
	tristate "RTL8153 ECM support"
	depends on USB_NET_CDCETHER && (USB_RTL8152 || USB_RTL8152=n)
	help
	  This option supports ECM mode for RTL8153 ethernet adapter, when
	  CONFIG_USB_RTL8152 is not set, or the RTL8153 device is not
	  supported by r8152 driver.
```

## drivers/net/virtio/Kconfig
```kconfig
# SPDX-License-Identifier: GPL-2.0-only
#
# virtio-net device configuration
#
config VIRTIO_NET
	tristate "Virtio network driver"
	depends on VIRTIO
	select NET_FAILOVER
	help
	  This is the virtual network driver for virtio.  It can be used with
	  QEMU based VMMs (like KVM or Xen).  Say Y or M.
```

## drivers/net/wireless/purelifi/plfxlc/Kconfig
```kconfig
# SPDX-License-Identifier: GPL-2.0-only
config PURELIFI_XLC
	tristate "pureLiFi X, XL, XC device support"
	depends on CFG80211 && MAC80211 && USB
	help
	   This option adds support for pureLiFi LiFi wireless USB adapters.

	   The pureLiFi X, XL, XC USB devices are based on 802.11 OFDM PHY.

	   Supports common 802.11 encryption/authentication methods including
	   Open, WPA, WPA2-Personal and WPA2-Enterprise (802.1X).

	   To compile this driver as a module, choose m here. The module will
	   be called purelifi_xlc.
```

## drivers/nvme/hw/Kconfig
```kconfig
# SPDX-License-Identifier: GPL-2.0-only
config NVME_QEDN
	tristate "Marvell NVM Express over Fabrics TCP offload"
	depends on NVME_TCP_OFFLOAD
	select QED_NVMETCP
	help
	  This enables the Marvell NVMe TCP offload support (qedn).

	  If unsure, say N.
```

## drivers/perf/pci/Kconfig
```kconfig
# SPDX-License-Identifier: GPL-2.0-only
#
# PCIe Performance Monitor Drivers
#
menu "PCIe Performance Monitor"

config HISI_PCIE_PMU
	tristate "HiSilicon PCIE PERF PMU"
	depends on PCI && (ARM64 || COMPILE_TEST)
	help
	  Provide support for HiSilicon PCIe performance monitoring unit (PMU)
	  RCiEP devices.
	  Adds the PCIe PMU into perf events system for monitoring latency,
	  bandwidth etc.

endmenu
```

## drivers/phy/dwc/Kconfig
```kconfig
# SPDX-License-Identifier: GPL-2.0
config VIDEO_DWC_HDMI_PHY_E40X
	tristate "Synopsys DesignWare HDMI RX PHYs e405 and e406 driver"
	select GENERIC_PHY
	help
	  Support for Synopsys DesignWare HDMI RX PHYs versions
	  e405 and e406.

	  To compile this driver as a module, choose M here. The module
	  will be called phy-dw-hdmi-e40x.

config VIDEO_DWC_HDMI_PHY_E40X_SUPPORT_TESTCHIP
	bool "Synopsys DesignWare HDMI RX PHYs e405/e406 Test Chip Support"
	depends on VIDEO_DWC_HDMI_PHY_E40X
	help
	  Support for Synopsys DesignWare HDMI RX PHYs e405/e406 with Test Chip.

	  To have support for HDMI RX PHYs e405/e406 Test Chip, choose Y here.
	  It will enable Test Chip additional requirements, for example enable
	  the z calibration requirement during the PHY configuration.
```

## drivers/pinctrl/sunplus/Kconfig
```kconfig
# SPDX-License-Identifier: GPL-2.0
#
# Sunplus Pin control driver configuration
#

config PINCTRL_SPPCTL
	bool "Sunplus SP7021 pinmux and GPIO driver"
	depends on SOC_SP7021
	depends on OF && HAS_IOMEM
	select PINMUX
	select GENERIC_PINCTRL_GROUPS
	select GENERIC_PINMUX_FUNCTIONS
	select PINCONF
	select GENERIC_PINCONF
	select OF_GPIO
	select GPIOLIB
	select GPIO_SYSFS
	select GENERIC_IRQ_CHIP
	select GPIOLIB_IRQCHIP
	help
	  Say Y here to support Sunplus SP7021 pinmux controller.
	  The driver is selected automatically by platform.
	  This driver requires the pinctrl framework.
	  GPIO is provided by the same driver.

config PINCTRL_SPPCTL_DEBUG
	bool "Sunplus pinmux specific debug"
	depends on SOC_SP7021 && DEBUG_PINCTRL
	help
	  Say Y if you need to debug Sunplus pinmux driver in-depth.
	  Pin control driver will output more messages if you enable
	  this item. This function is dependent on DEBUG_PINCTRL. It
	  should be enabled first.
```

## drivers/platform/x86/intel/Kconfig
```kconfig
# SPDX-License-Identifier: GPL-2.0-only
#
# Intel x86 Platform Specific Drivers
#

menuconfig X86_PLATFORM_DRIVERS_INTEL
	bool "Intel x86 Platform Specific Device Drivers"
	default y
	help
	  Say Y here to get to see options for device drivers for
	  various Intel x86 platforms, including vendor-specific
	  drivers. This option alone does not add any kernel code.

	  If you say N, all options in this submenu will be skipped
	  and disabled.

if X86_PLATFORM_DRIVERS_INTEL

source "drivers/platform/x86/intel/int33fe/Kconfig"
source "drivers/platform/x86/intel/int3472/Kconfig"
source "drivers/platform/x86/intel/pmt/Kconfig"
source "drivers/platform/x86/intel/atomisp2/Kconfig"

config INTEL_HID_EVENT
	tristate "INTEL HID Event"
	depends on ACPI
	depends on INPUT
	depends on I2C
	select INPUT_SPARSEKMAP
	help
	  This driver provides support for the Intel HID Event hotkey interface.
	  Some laptops require this driver for hotkey support.

	  To compile this driver as a module, choose M here: the module will
	  be called intel_hid.

config INTEL_BXTWC_PMIC_TMU
	tristate "Intel BXT Whiskey Cove TMU Driver"
	depends on REGMAP
	depends on MFD_INTEL_PMC_BXT
	depends on INTEL_SOC_PMIC_BXTWC
	help
	  Select this driver to use Intel BXT Whiskey Cove PMIC TMU feature.
	  This driver enables the alarm wakeup functionality in the TMU unit
	  of Whiskey Cove PMIC.

config INTEL_CHTDC_TI_PWRBTN
	tristate "Intel Cherry Trail Dollar Cove TI power button driver"
	depends on INTEL_SOC_PMIC_CHTDC_TI
	depends on INPUT
	help
	  This option adds a power button driver driver for Dollar Cove TI
	  PMIC on Intel Cherry Trail devices.

	  To compile this driver as a module, choose M here: the module
	  will be called intel_chtdc_ti_pwrbtn.

config INTEL_MRFLD_PWRBTN
	tristate "Intel Merrifield Basin Cove power button driver"
	depends on INTEL_SOC_PMIC_MRFLD
	depends on INPUT
	help
	  This option adds a power button driver for Basin Cove PMIC
	  on Intel Merrifield devices.

	  To compile this driver as a module, choose M here: the module
	  will be called intel_mrfld_pwrbtn.

config INTEL_PUNIT_IPC
	tristate "Intel P-Unit IPC Driver"
	help
	  This driver provides support for Intel P-Unit Mailbox IPC mechanism,
	  which is used to bridge the communications between kernel and P-Unit.

source "drivers/platform/x86/intel/pmc/Kconfig"
source "drivers/platform/x86/intel/scu/Kconfig"
source "drivers/platform/x86/intel/telemetry/Kconfig"

config INTEL_IPS
	tristate "Intel Intelligent Power Sharing"
	depends on ACPI && PCI
	help
	  Intel Calpella platforms support dynamic power sharing between the
	  CPU and GPU, maximizing performance in a given TDP.  This driver,
	  along with the CPU frequency and i915 drivers, provides that
	  functionality.  If in doubt, say Y here; it will only load on
	  supported platforms.

config INTEL_RST
        tristate "Intel Rapid Start Technology Driver"
	depends on ACPI
	help
	  This driver provides support for modifying parameters on systems
	  equipped with Intel's Rapid Start Technology. When put in an ACPI
	  sleep state, these devices will wake after either a configured
	  timeout or when the system battery reaches a critical state,
	  automatically copying memory contents to disk. On resume, the
	  firmware will copy the memory contents back to RAM and resume the OS
	  as usual.

config INTEL_SMARTCONNECT
        tristate "Intel Smart Connect disabling driver"
	depends on ACPI
	help
	  Intel Smart Connect is a technology intended to permit devices to
	  update state by resuming for a short period of time at regular
	  intervals. If a user enables this functionality under Windows and
	  then reboots into Linux, the system may remain configured to resume
	  on suspend. In the absence of any userspace to support it, the system
	  will then remain awake until something triggers another suspend.

	  This driver checks to determine whether the device has Intel Smart
	  Connect enabled, and if so disables it.

source "drivers/platform/x86/intel/speed_select_if/Kconfig"

config INTEL_TURBO_MAX_3
	bool "Intel Turbo Boost Max Technology 3.0 enumeration driver"
	depends on X86_64 && SCHED_MC_PRIO
	help
	  This driver reads maximum performance ratio of each CPU and set up
	  the scheduler priority metrics. In this way scheduler can prefer
	  CPU with higher performance to schedule tasks.
	  This driver is only required when the system is not using Hardware
	  P-States (HWP). In HWP mode, priority can be read from ACPI tables.

config INTEL_UNCORE_FREQ_CONTROL
	tristate "Intel Uncore frequency control driver"
	depends on X86_64
	help
	  This driver allows control of uncore frequency limits on
	  supported server platforms.
	  Uncore frequency controls RING/LLC (last-level cache) clocks.

	  To compile this driver as a module, choose M here: the module
	  will be called intel-uncore-frequency.

endif # X86_PLATFORM_DRIVERS_INTEL
```

## drivers/platform/x86/intel/scu/Kconfig
```kconfig
# SPDX-License-Identifier: GPL-2.0
#
# Makefile for drivers/platform/x86/intel
# Intel x86 Platform-Specific Drivers
#

config INTEL_SCU_IPC
	bool

config INTEL_SCU
	bool
	select INTEL_SCU_IPC

config INTEL_SCU_PCI
	bool "Intel SCU PCI driver"
	depends on PCI
	select INTEL_SCU
	help
	  This driver is used to bridge the communications between kernel
	  and SCU on some embedded Intel x86 platforms. It also creates
	  devices that are connected to the SoC through the SCU.
	  Platforms supported:
	    Medfield
	    Clovertrail
	    Merrifield
	    Broxton
	    Apollo Lake

config INTEL_SCU_PLATFORM
	tristate "Intel SCU platform driver"
	depends on ACPI
	select INTEL_SCU
	help
	  This driver is used to bridge the communications between kernel
	  and SCU (sometimes called PMC as well). The driver currently
	  supports Intel Elkhart Lake and compatible platforms.

config INTEL_SCU_WDT
	bool
	default INTEL_SCU_PCI
	depends on INTEL_MID_WATCHDOG
	help
	  This is a specific platform code to instantiate watchdog device
	  on ACPI-based Intel MID platforms.

config INTEL_SCU_IPC_UTIL
	tristate "Intel SCU IPC utility driver"
	depends on INTEL_SCU
	help
	  The IPC Util driver provides an interface with the SCU enabling
	  low level access for debug work and updating the firmware. Say
	  N unless you will be doing this on an Intel MID platform.
```

## drivers/power/Kconfig
```kconfig
# SPDX-License-Identifier: GPL-2.0-only
source "drivers/power/pwrseq/Kconfig"
source "drivers/power/reset/Kconfig"
source "drivers/power/supply/Kconfig"
```

## drivers/power/pwrseq/Kconfig
```kconfig
# SPDX-License-Identifier: GPL-2.0-only
menuconfig PWRSEQ
	bool "Power Sequencer drivers"
	help
	  Provides support for special power sequencing drivers.

	  Say Y here to enable support for such devices

if PWRSEQ

config PWRSEQ_EMMC
	tristate "HW reset support for eMMC"
	default y
	depends on OF
	help
	  This selects Hardware reset support aka pwrseq-emmc for eMMC
	  devices. By default this option is set to y.

	  This driver can also be built as a module. If so, the module
	  will be called pwrseq_emmc.

config PWRSEQ_SD8787
	tristate "HW reset support for SD8787 BT + Wifi module"
	depends on OF
	help
	  This selects hardware reset support for the SD8787 BT + Wifi
	  module. By default this option is set to n.

	  This driver can also be built as a module. If so, the module
	  will be called pwrseq_sd8787.

config PWRSEQ_SIMPLE
	tristate "Simple HW reset support"
	default y
	depends on OF
	help
	  This selects simple hardware reset support aka pwrseq-simple.
	  By default this option is set to y.

	  This driver can also be built as a module. If so, the module
	  will be called pwrseq_simple.

endif
```

## drivers/scsi/spraid/Kconfig
```kconfig
#
# Ramaxel driver configuration
#

config RAMAXEL_SPRAID
	tristate "Ramaxel spraid Adapter"
	depends on PCI && SCSI && BLK_DEV_BSGLIB
	depends on ARM64 || X86_64
	help
	  This driver supports Ramaxel spraid driver.
```

## drivers/soc/actions/Kconfig
```kconfig
# SPDX-License-Identifier: GPL-2.0-only
if ARCH_ACTIONS || COMPILE_TEST

config OWL_PM_DOMAINS_HELPER
	bool

config OWL_PM_DOMAINS
	bool "Actions Semi SPS power domains"
	depends on PM
	select OWL_PM_DOMAINS_HELPER
	select PM_GENERIC_DOMAINS
	help
	  Say 'y' here to enable support for Smart Power System (SPS)
	  power-gating on Actions Semiconductor S500, S700 and S900 SoCs.
	  If unsure, say 'n'.

config OWL_SOCINFO
	bool "Actions Semi Owl SoC info driver"
	default ARCH_ACTIONS
	select SOC_BUS
	help
	  Say 'y' here to support the Action Semiconductor Owl socinfo
	  driver, providing information about the SoC to user space.

endif
```

## drivers/soc/fujitsu/Kconfig
```kconfig
# SPDX-License-Identifier: GPL-2.0-only
menu "fujitsu SoC drivers"

config A64FX_DIAG
	bool "A64FX diag driver"
	depends on ARM64
	help
	  Say Y here if you want to enable diag interrupt on A64FX.
	  This driver uses pseudo-NMI if available.

	  If unsure, say N.

endmenu
```
