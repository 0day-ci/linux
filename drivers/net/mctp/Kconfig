## drivers/staging/android/Kconfig
```kconfig
# SPDX-License-Identifier: GPL-2.0
menu "Android"

if ANDROID

config ASHMEM
	bool "Enable the Anonymous Shared Memory Subsystem"
	depends on SHMEM
	help
	  The ashmem subsystem is a new shared memory allocator, similar to
	  POSIX SHM but with different behavior and sporting a simpler
	  file-based API.

	  It is, in theory, a good memory allocator for low-memory devices,
	  because it can discard shared memory units when under memory pressure.

config USERPANIC_CHARDEV
	bool "User-panic device interface"
	help
	  Say Y here to use user-panic device for user space processes to
	  request a system panic with customized panic message.

	  A char device '/dev/userspace_panic' is created by this driver
	  when selecting 'Y'. User processes can request panic and attach
	  customized panic message and title by ioctl(CRASH_INFO). Later any
	  panic handler can collect the panic message to build debugging
	  reports.

endif # if ANDROID

endmenu
```

## drivers/staging/gs_fpgaboot/Kconfig
```kconfig
# SPDX-License-Identifier: GPL-2.0
#
# "xilinx FPGA firmware download, fpgaboot"
#
config GS_FPGABOOT
	tristate "Xilinx FPGA firmware download module"
	help
	  Xilinx FPGA firmware download module.

choice
	prompt "Support Board"
	depends on GS_FPGABOOT

config GS_FPGABOOT_BOARD_B4860G100
	bool "B4860G100"
	depends on PPC_85xx
	help
	  Select this to support B4860G100 board

endchoice
```

## drivers/staging/hikey9xx/Kconfig
```kconfig
# SPDX-License-Identifier: GPL-2.0

# to be placed at drivers/regulator
config REGULATOR_HI6421V600
	tristate "HiSilicon Hi6421v600 PMIC voltage regulator support"
	depends on MFD_HI6421_SPMI && OF
	depends on REGULATOR
	select REGMAP
	help
	  This driver provides support for the voltage regulators on
	  HiSilicon Hi6421v600 PMU / Codec IC.
	  This is used on Kirin 3670 boards, like HiKey 970.
```

## drivers/staging/ks7010/Kconfig
```kconfig
# SPDX-License-Identifier: GPL-2.0
config KS7010
	tristate "KeyStream KS7010 SDIO support"
	depends on MMC && WIRELESS
	select WIRELESS_EXT
	select WEXT_PRIV
	select FW_LOADER
	help
	  Selecting this option enables the driver for KeyStream KS7010 SDIO
	  hardware found in at least Spectec SDW-821 and SDW-823 microSD cards
	  (FCC-ID "S2Y-WLAN-11G-K" but not FCC-ID "S2Y-WLAN-11B-G" and Spectec
	  SDW-823).
```

## drivers/staging/media/i2c/Kconfig
```kconfig
config VIDEO_OVM6211
	tristate "OmniVision OVM6211 sensor support"
	depends on I2C && VIDEO_V4L2
	help
	  This is a Video4Linux2 sensor driver for the OmniVision
	  OVM6211 camera.

	  To compile this driver as a module, choose M here: the
	  module will be called ovm6211.
```

## drivers/staging/media/vxd/decoder/Kconfig
```kconfig
# SPDX-License-Identifier: GPL-2.0

config VIDEO_IMG_VXD_DEC
	tristate "IMG VXD DEC (Video Decoder) driver"
	depends on VIDEO_DEV && VIDEO_V4L2
	select VIDEOBUF2_CORE
	select VIDEOBUF2_DMA_CONTIG
	select VIDEOBUF2_DMA_SG
	select V4L2_MEM2MEM_DEV
	help
	  This is an IMG VXD DEC V4L2 driver that adds support for the
	  Imagination D5520 (Video Decoder) hardware.
	  The module name when built is vxd-dec.
```

## drivers/staging/media/wave5/Kconfig
```kconfig
# SPDX-License-Identifier: GPL-2.0
config VIDEO_WAVE_VPU
        tristate "Chips&Media Wave Codec Driver"
        depends on VIDEO_DEV && VIDEO_V4L2 && OF
        select VIDEOBUF2_DMA_CONTIG
        select VIDEOBUF2_VMALLOC
        select V4L2_MEM2MEM_DEV
        select GENERIC_ALLOCATOR
        help
          Chips&Media codec driver
```

## drivers/staging/zynpu/Kconfig
```kconfig
# SPDX-License-Identifier: GPL-2.0+
#
# ARM (China) ZHOUYI AI accelerator drivers configuration.
#

config ZYNPU
	tristate "ARM (China) ZHOUYI AI accelerator support"
	depends on OF && HAS_IOMEM
	select CMA
	select DMA_CMA
	help
	  Say yes here to build support for ZHOUYI AI accelerator.

	  This driver can also be built as a module. If so, the module will be
	  called zhouyi_npu.

choice
	prompt "ZHOUYI NPU version"
	depends on ZYNPU
	default ZHOUYI_V1
	help
	  Select the chip version of ZHOUYI NPU.

	config ZHOUYI_V1
		bool "ZHOUYI V1"
		help
		  select ZHOUYI Z1 support

	config ZHOUYI_V2
		bool "ZHOUYI V2"
		help
		  select ZHOUYI Z2 support

endchoice
```

## drivers/usb/misc/ch341/Kconfig
```kconfig
config USB_CH341_CORE
	tristate "USB WinChipHead CH341 in I2C/SPI/GPIO mode"
	depends on USB && GPIOLIB && I2C && SPI
	help

	  If you say yes to this option, support for the CH341 chips,
	  running in I2C/SPI/GPIO mode will be included. Some versions
	  of the chip do not support all the functionnalities but
	  there is no way to differentiate them. For instance the
	  CH341A and CH341B support everything while the CH341T can
	  only do I2C.

	  The serial mode is not supported by this driver. Use the
	  CH341 USB serial driver.

	  This driver can also be built as a module.  If so, the
	  module will be called ch341-buses.
```
