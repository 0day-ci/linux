## drivers/iio/meter/Kconfig
```kconfig
# SPDX-License-Identifier: GPL-2.0
#
# Energy meter drivers
#
# When adding new entries keep the list in alphabetical order

menu "Active energy metering"

config ADE9078
	tristate "Analog Devices ADE9078 Poly Phase Multifunction Energy Metering IC Driver"
	depends on SPI
	select REGMAP_SPI
	select IIO_BUFFER
	select IIO_KFIFO_BUF
	help
	  Support driver for the ADE9078Poly Phase Multifunction Energy Meter,
	  select y to build the driver.

	  To compile this driver as a module, choose M here: the module
	  will be called ade9078

endmenu
```

## drivers/infiniband/ulp/rv/Kconfig
```kconfig
# SPDX-License-Identifier: (GPL-2.0 OR BSD-3-Clause)
#
# Copyright(c) 2020 - 2021 Intel Corporation.
#
config INFINIBAND_RV
	tristate "InfiniBand Rendezvous Module"
	depends on X86_64 && INFINIBAND
	help
	  The rendezvous module provides mechanisms for HPC middlewares
	  to cache memory region registration, to manage connections
	  between nodes, and improve the scability of RDMA transactions.
```

## drivers/iommu/iommufd/Kconfig
```kconfig
# SPDX-License-Identifier: GPL-2.0-only
config IOMMUFD
	tristate "I/O Address Space management framework for passthrough devices"
	select IOMMU_API
	default n
	help
	  provides unified I/O address space management framework for
	  isolating untrusted DMAs via devices which are passed through
	  to userspace drivers.

	  If you don't know what to do here, say N.
```

## drivers/leds/flash/Kconfig
```kconfig
# SPDX-License-Identifier: GPL-2.0

if LEDS_CLASS_FLASH

config LEDS_RT4505
	tristate "LED support for RT4505 flashlight controller"
	depends on I2C && OF
	depends on V4L2_FLASH_LED_CLASS || !V4L2_FLASH_LED_CLASS
	select REGMAP_I2C
	help
	  This option enables support for the RT4505 flash LED controller.
	  RT4505 includes torch and flash functions with programmable current.
	  And it's commonly used to compensate the illuminance for the camera
	  inside the mobile product like as phones or tablets.

config LEDS_RT8515
	tristate "LED support for Richtek RT8515 flash/torch LED"
	depends on GPIOLIB
	depends on V4L2_FLASH_LED_CLASS || !V4L2_FLASH_LED_CLASS
	help
	  This option enables support for the Richtek RT8515 flash
	  and torch LEDs found on some mobile phones.

	  To compile this driver as a module, choose M here: the module
	  will be called leds-rt8515.

config LEDS_QCOM_SPMI_FLASH
	tristate "Support for QCOM SPMI Flash LEDs"
	depends on REGMAP_SPMI
	depends on OF
	help
	  This option enables support for the flash/torch LEDs present in
	  Qualcomm's PM8941 PMIC.

endif # LEDS_CLASS_FLASH
```

## drivers/leds/simple/Kconfig
```kconfig
config LEDS_MULTI_GPIO
	tristate "LED Support for multiple GPIOs LED"
	depends on LEDS_CLASS
	depends on GPIOLIB
	depends on OF
	help
	  This option enables support for a multiple GPIOs LED. Such LED is made
	  of multiple GPIOs and could change the brightness by setting different
	  states of the GPIOs.

	  To compile this driver as a module, choose M here: the
	  module will be called leds-multi-gpio.
```

## drivers/media/common/videobuf2/Kconfig
```kconfig
# SPDX-License-Identifier: GPL-2.0-only
# Used by drivers that need Videobuf2 modules
config VIDEOBUF2_CORE
	select DMA_SHARED_BUFFER
	tristate

config VIDEOBUF2_V4L2
	tristate

config VIDEOBUF2_DISABLE_USERPTR_AND_CMA
	bool "Disable use of V4L2 USERPTR streaming if CMA is enabled"
	depends on CMA
	depends on VIDEOBUF2_V4L2
	help
	  Say Y here to disable V4L2 USERPTR streaming mode if CMA is enabled.
	  If some of the pages of the buffer memory were allocated in CMA memory,
	  then attempting to pin those pages in place will fail with an error.

	  When in doubt, say N.

config VIDEOBUF2_MEMOPS
	tristate

config VIDEOBUF2_DMA_CONTIG
	tristate
	select VIDEOBUF2_CORE
	select VIDEOBUF2_MEMOPS
	select DMA_SHARED_BUFFER

config VIDEOBUF2_VMALLOC
	tristate
	select VIDEOBUF2_CORE
	select VIDEOBUF2_MEMOPS
	select DMA_SHARED_BUFFER

config VIDEOBUF2_DMA_SG
	tristate
	select VIDEOBUF2_CORE
	select VIDEOBUF2_MEMOPS

config VIDEOBUF2_DVB
	tristate
	select VIDEOBUF2_CORE
```

## drivers/media/platform/dwc/Kconfig
```kconfig
# SPDX-License-Identifier: GPL-2.0
config VIDEO_DWC_HDMI_RX
	tristate "Synopsys DesignWare HDMI Receiver driver"
	depends on VIDEO_V4L2 && VIDEO_V4L2_SUBDEV_API
	help
	  Support for Synopsys DesignWare HDMI RX Controller.
	  This driver supports HDMI 2.0 version.

	  To compile this driver as a module, choose M here. The module
	  will be called dw-hdmi-rx.

config VIDEO_DWC_HDMI_RX_CEC
	bool "Synopsys DesignWare HDMI Receiver CEC support"
	depends on VIDEO_DWC_HDMI_RX
	select CEC_CORE
	help
	  When selected the Synopsys DesignWare HDMI RX controller
	  will support the optional HDMI CEC feature.

	  It uses the generic CEC framework interface.
```

## drivers/media/platform/imx/Kconfig
```kconfig
#
# Codec configuration
#

config MXC_VPU_8Q
	tristate "Support for MXC 8Q VPU(Video Processing Unit) Codec"
	depends on ARCH_MXC
	depends on MEDIA_SUPPORT
	depends on VIDEO_DEV
	depends on VIDEO_V4L2
	select V4L2_MEM2MEM_DEV
	select VIDEOBUF2_DMA_CONTIG
	select VIDEOBUF2_VMALLOC
	default y
	help
	  This is a V4L2 driver for NXP MXC 8Q video accelerator hardware.
	  It accelerates encoding and decoding operations on
	  various NXP SoCs.
	  To compile this driver as a module choose m here.
```

## drivers/media/platform/keembay-camera/Kconfig
```kconfig
config VIDEO_INTEL_KEEMBAY_CAMERA
	tristate "Intel Keem Bay camera subsystem"
	depends on VIDEO_V4L2 && VIDEO_V4L2_SUBDEV_API
	depends on XLINK_CORE  && HAS_DMA && OF
	select VIDEOBUF2_DMA_CONTIG
	select V4L2_FWNODE
	help
          This is a V4L2 driver for the Intel Keem Bay VPU camera interface.

          To compile this driver as a module, choose M here: the module
          will be called keembay_cam
```

## drivers/media/platform/qcom/Kconfig
```kconfig
# SPDX-License-Identifier: GPL-2.0
source "drivers/media/platform/qcom/camss/Kconfig"
source "drivers/media/platform/qcom/venus/Kconfig"
```

## drivers/media/platform/sti/Kconfig
```kconfig
# SPDX-License-Identifier: GPL-2.0-only

comment "STMicroelectronics drivers"

source "drivers/media/platform/sti/bdisp/Kconfig"
source "drivers/media/platform/sti/c8sectpfe/Kconfig"
source "drivers/media/platform/sti/delta/Kconfig"
source "drivers/media/platform/sti/hva/Kconfig"
source "drivers/media/platform/sti/stm32/Kconfig"
```

## drivers/media/platform/sunxi/Kconfig
```kconfig
# SPDX-License-Identifier: GPL-2.0

source "drivers/media/platform/sunxi/sun4i-csi/Kconfig"
source "drivers/media/platform/sunxi/sun6i-csi/Kconfig"
source "drivers/media/platform/sunxi/sun6i-mipi-csi2/Kconfig"
source "drivers/media/platform/sunxi/sun8i-a83t-mipi-csi2/Kconfig"
```

## drivers/media/platform/sunxi/sun6i-mipi-csi2/Kconfig
```kconfig
# SPDX-License-Identifier: GPL-2.0-only
config VIDEO_SUN6I_MIPI_CSI2
	tristate "Allwinner A31 MIPI CSI-2 Controller Driver"
	depends on ARCH_SUNXI || COMPILE_TEST
	depends on PM && COMMON_CLK && VIDEO_V4L2
	select REGMAP_MMIO
	select PHY_SUN6I_MIPI_DPHY
	select MEDIA_CONTROLLER
	select VIDEO_V4L2_SUBDEV_API
	select V4L2_FWNODE
	help
	   Support for the Allwinner A31 MIPI CSI-2 Controller.
```

## drivers/media/platform/sunxi/sun8i-a83t-mipi-csi2/Kconfig
```kconfig
# SPDX-License-Identifier: GPL-2.0-only
config VIDEO_SUN8I_A83T_MIPI_CSI2
	tristate "Allwinner A83T MIPI CSI-2 Controller and D-PHY Driver"
	depends on ARCH_SUNXI || COMPILE_TEST
	depends on PM && COMMON_CLK && VIDEO_V4L2
	select REGMAP_MMIO
	select MEDIA_CONTROLLER
	select VIDEO_V4L2_SUBDEV_API
	select V4L2_FWNODE
	help
	   Support for the Allwinner A83T MIPI CSI-2 Controller and D-PHY.
```

## drivers/media/platform/ti/Kconfig
```kconfig
# SPDX-License-Identifier: GPL-2.0-only
source "drivers/media/platform/ti/am437x/Kconfig"
source "drivers/media/platform/ti/davinci/Kconfig"
source "drivers/media/platform/ti/omap/Kconfig"
source "drivers/media/platform/ti/omap3isp/Kconfig"
source "drivers/media/platform/ti/vpe/Kconfig"
```

## drivers/media/test-drivers/vivpu/Kconfig
```kconfig
# SPDX-License-Identifier: GPL-2.0-only
config VIDEO_VIVPU
	tristate "Virtual VPU Driver (vivpu)"
	depends on VIDEO_DEV && VIDEO_V4L2
	select VIDEOBUF2_VMALLOC
	select V4L2_MEM2MEM_DEV
	select MEDIA_CONTROLLER
	select MEDIA_CONTROLLER_REQUEST_API
	help
	  A virtual stateless VPU example device for uAPI development purposes.

	  A userspace implementation can use vivpu to run a decoding loop even
	  when no hardware is available or when the kernel uAPI for the codec
	  has not been upstreamed yet. This can reveal bugs at an early stage

	  When in doubt, say N.
```

## drivers/memory/mediatek/Kconfig
```kconfig
# SPDX-License-Identifier: GPL-2.0

config MTK_DRAMC
	tristate "MediaTek DRAMC driver"
	help
	  This selects the MediaTek(R) DRAMC driver.
	  Provide the API for DRAMC low power scenario, and the interface
	  for reporting DRAM information, e.g. DRAM mode register (MR) for
	  DRAM vendor ID, temperature, and density.
```

## drivers/misc/bcm-vk/Kconfig
```kconfig
# SPDX-License-Identifier: GPL-2.0-only
#
# Broadcom VK device
#
config BCM_VK
	tristate "Support for Broadcom VK Accelerators"
	depends on PCI_MSI
	help
	  Select this option to enable support for Broadcom
	  VK Accelerators.  VK is used for performing
	  multiple specific offload processing tasks in parallel.
	  Such offload tasks assist in such operations as video
	  transcoding, compression, and crypto tasks.
	  This driver enables userspace programs to access these
	  accelerators via /dev/bcm-vk.N devices.

	  If unsure, say N.

config BCM_VK_VIPER
	bool "VK driver for VIPER"
	depends on BCM_VK
	help
	  Turn on to enable using the vk driver for the viper variant.
	  Used for development environments where viper uses VK driver
	  and VK firmware rather than an alternate firmware and driver.

	  If unsure, say N.

config BCM_VK_TTY
	bool "Enable tty ports on a Broadcom VK Accelerator device"
	depends on TTY
	depends on BCM_VK
	help
	  Select this option to enable tty support to allow console
	  access to Broadcom VK Accelerator cards from host.

	  Device node will in the form /dev/bcm-vk.x_ttyVKy where:
	  x is the instance of the VK card
	  y is the tty device number on the VK card.
```

## drivers/misc/dlb/Kconfig
```kconfig
# SPDX-License-Identifier: GPL-2.0-only

config INTEL_DLB
	tristate "Intel Dynamic Load Balancer Driver"
	depends on 64BIT && PCI && X86
	help
	  This driver supports the Intel Dynamic Load Balancer (DLB), a
	  PCIe device (PCI ID 8086:27xx) that provides load-balanced,
	  prioritized scheduling of core-to-core communication and improves
	  DPDK Event Device library performance.

	  The user-space interface is described in
	  include/uapi/linux/dlb_user.h

	  To compile this driver as a module, choose M here. The module
	  will be called dlb.

	  If unsure, select N.
```

## drivers/misc/intel-nnpi/Kconfig
```kconfig
# SPDX-License-Identifier: GPL-2.0-only

#
# Copyright (C) 2019-2021 Intel Corporation
#
#

config INTEL_NNPI
	tristate "Intel(R) PCIe NNP-I (AI accelerator for inference) device driver"
	depends on PCI
	select DMA_SHARED_BUFFER
	help
	  Device driver for Intel NNP-I PCIe accelerator card for AI inference.

	  If unsure, say N.

	  To compile this driver as a module, choose M here. Two modules will
          get generated intel_nnpi and intel_nnpi_pcie.
```

## drivers/misc/iop/Kconfig
```kconfig
# SPDX-License-Identifier: GPL-2.0-only
#
# IOP configuration
#

config SUNPLUS_IOP
	tristate "Sunplus IOP support"
	default ARCH_SUNPLUS
	help
	  Sunplus I/O processor (8051) driver.
	  Processor for I/O control, RTC wake-up proceduce management,
	  and cooperation with CPU&PMC in power management.
	  Need Install DQ8051, The DQ8051 bin file generated by keil C.
```

## drivers/mmc/core/Kconfig
```kconfig
# SPDX-License-Identifier: GPL-2.0-only
#
# MMC core configuration
#
config MMC_BLOCK
	tristate "MMC block device driver"
	depends on BLOCK
	default y
	help
	  Say Y here to enable the MMC block device driver support.
	  This provides a block device driver, which you can use to
	  mount the filesystem. Almost everyone wishing MMC support
	  should say Y or M here.

config MMC_BLOCK_MINORS
	int "Number of minors per block device"
	depends on MMC_BLOCK
	range 4 256
	default 8
	help
	  Number of minors per block device. One is needed for every
	  partition on the disk (plus one for the whole disk).

	  Number of total MMC minors available is 256, so your number
	  of supported block devices will be limited to 256 divided
	  by this number.

	  Default is 8 to be backwards compatible with previous
	  hardwired device numbering.

	  If unsure, say 8 here.

config SDIO_UART
	tristate "SDIO UART/GPS class support"
	depends on TTY
	help
	  SDIO function driver for SDIO cards that implements the UART
	  class, as well as the GPS class which appears like a UART.

config MMC_TEST
	tristate "MMC host test driver"
	help
	  Development driver that performs a series of reads and writes
	  to a memory card in order to expose certain well known bugs
	  in host controllers. The tests are executed by writing to the
	  "test" file in debugfs under each card. Note that whatever is
	  on your card will be overwritten by these tests.

	  This driver is only of interest to those developing or
	  testing a host driver. Most people should say N here.

config MMC_CRYPTO
	bool "MMC Crypto Engine Support"
	depends on BLK_INLINE_ENCRYPTION
	help
	  Enable Crypto Engine Support in MMC.
	  Enabling this makes it possible for the kernel to use the crypto
	  capabilities of the MMC device (if present) to perform crypto
	  operations on data being transferred to/from the device.
```

## drivers/net/ethernet/actions/Kconfig
```kconfig
# SPDX-License-Identifier: GPL-2.0-only

config NET_VENDOR_ACTIONS
	bool "Actions Semi devices"
	default y
	depends on ARCH_ACTIONS
	help
	  If you have a network (Ethernet) card belonging to this class, say Y.

	  Note that the answer to this question doesn't directly affect the
	  kernel: saying N will just cause the configurator to skip all the
	  questions about Actions Semi devices.  If you say Y, you will be
	  asked for your specific card in the following questions.

if NET_VENDOR_ACTIONS

config OWL_EMAC
	tristate "Actions Semi Owl Ethernet MAC support"
	select PHYLIB
	help
	  This driver supports the Actions Semi Ethernet Media Access
	  Controller (EMAC) found on the S500 and S900 SoCs.  The controller
	  is compliant with the IEEE 802.3 CSMA/CD standard and supports
	  both half-duplex and full-duplex operation modes at 10/100 Mb/s.

config OWL_EMAC_GEN_ADDR_SYS_SN
	bool "Enable generating MAC address based on system serial"
	depends on OWL_EMAC
	select CRYPTO
	select CRYPTO_DES
	select CRYPTO_ECB
	select CRYPTO_SKCIPHER
	default n
	help
	  If you say Y here and no MAC address is available, the Actions Semi
	  Owl EMAC driver will generate the address based on the system serial
	  number.  The fallback is to use a randomly generated MAC address.

endif # NET_VENDOR_ACTIONS
```

## drivers/net/ethernet/mediatek/ccmni/Kconfig
```kconfig
# SPDX-License-Identifier: GPL-2.0
#
# MediaTek CCMNI driver
#

menuconfig MTK_NET_CCMNI
	tristate "MediaTek CCMNI driver"
	default n
	help
	  Cross Core Multi Network Interface:
	  If you select this, you will enable the CCMNI module which is used
	  to shield hardware differences and communicate with kernel netdevice
	  and be used for handling outgoing/incoimg mobile data. Module provides
	  virtual network devices which can be used to support different mobile
	  networks.
```
