## drivers/usb/typec/mux/Kconfig
```kconfig
# SPDX-License-Identifier: GPL-2.0

menu "USB Type-C Multiplexer/DeMultiplexer Switch support"

config TYPEC_MUX_PI3USB30532
	tristate "Pericom PI3USB30532 Type-C cross switch driver"
	depends on I2C
	help
	  Say Y or M if your system has a Pericom PI3USB30532 Type-C cross
	  switch / mux chip found on some devices with a Type-C port.

config TYPEC_MUX_INTEL_PMC
	tristate "Intel PMC mux control"
	depends on ACPI
	depends on INTEL_SCU_IPC
	select USB_ROLE_SWITCH
	help
	  Driver for USB muxes controlled by Intel PMC FW. Intel PMC FW can
	  control the USB role switch and also the multiplexer/demultiplexer
	  switches used with USB Type-C Alternate Modes.

config TYPEC_MUX_TS5USBA224
	tristate "TI TS5USBA224 USB High Speed/Audio switch mux driver"
	select GPIOLIB
	help
	  Say Y or M if your system has a TI TS5USBA224 USB High Speed/Audio
	  switch mux controller paired with a USB Type-C port controller.

	  If you choose to build this driver as a dynamically linked module, the
	  module will be called ts5usba224.ko.

endmenu
```

## drivers/uwb/Kconfig
```kconfig
# SPDX-License-Identifier: GPL-2.0-only
#
# Uwb driver configuration
#
menuconfig UWB
        bool "Ultra Wide Band(UWB) support"
        help
         Support for UWB Protocol driver.

         This driver is designed to support UCI(UWB Command Interface)
          as per FiRa Compliance.


          If unsure, say no.
if UWB
config NXP_UWB
        tristate "Nxp UCI(Uwb Command Interface) protocol driver support"
	depends on SPI
        help
          This option enables the UWB driver for Nxp sr1xx
          device. Such device supports UCI packet structure,
          FiRa compliance.

          Say Y here to compile support for sr1xx into the kernel or
          say M  to compile it as a module. The module will be called
          sr1xx.ko.
endif
```

## drivers/vfio/pci/mlx5/Kconfig
```kconfig
# SPDX-License-Identifier: GPL-2.0-only
config MLX5_VFIO_PCI
	tristate "VFIO support for MLX5 PCI devices"
	depends on MLX5_CORE
	select VFIO_PCI_CORE
	help
	  This provides a PCI support for MLX5 devices using the VFIO
	  framework. The device specific driver supports suspend/resume
	  of the MLX5 device.

	  If you don't know what to do here, say N.
```

## drivers/virt/coco/efi_secret/Kconfig
```kconfig
# SPDX-License-Identifier: GPL-2.0-only
config EFI_SECRET
	tristate "EFI secret area securityfs support"
	depends on EFI
	select EFI_COCO_SECRET
	select SECURITYFS
	help
	  This is a driver for accessing the EFI secret area via securityfs.

	  To compile this driver as a module, choose M here.
	  The module will be called efi_secret.
```

## drivers/virt/coco/sev_secret/Kconfig
```kconfig
# SPDX-License-Identifier: GPL-2.0-only
config AMD_SEV_SECRET
	tristate "AMD SEV secret area securityfs support"
	depends on AMD_MEM_ENCRYPT && EFI
	select SECURITYFS
	help
	  This is a driver for accessing the AMD SEV secret area via
	  securityfs.

	  To compile this driver as a module, choose M here.
	  The module will be called sev_secret.
```

## fs/configfs/Kconfig
```kconfig
# SPDX-License-Identifier: GPL-2.0-only
config CONFIGFS_FS
	tristate "Userspace-driven configuration filesystem"
	select SYSFS
	help
	  configfs is a RAM-based filesystem that provides the converse
	  of sysfs's functionality. Where sysfs is a filesystem-based
	  view of kernel objects, configfs is a filesystem-based manager
	  of kernel objects, or config_items.

	  Both sysfs and configfs can and should exist together on the
	  same system. One is not a replacement for the other.

config CONFIGFS_KUNIT_TEST
	bool "Configfs Kunit test" if !KUNIT_ALL_TESTS
	depends on CONFIGFS_FS && KUNIT=y
	default KUNIT_ALL_TESTS
	help
	  Run the configfs unit tests at boot time. For more information, see
	  also the Kunit documentation in Documentation/dev-tools/kunit/.
```

## fs/crypto/Kconfig
```kconfig
# SPDX-License-Identifier: GPL-2.0-only
config FS_ENCRYPTION
	bool "FS Encryption (Per-file encryption)"
	select CRYPTO
	select CRYPTO_HASH
	select CRYPTO_SKCIPHER
	select CRYPTO_LIB_SHA256
	select KEYS
	help
	  Enable encryption of files and directories.  This
	  feature is similar to ecryptfs, but it is more memory
	  efficient since it avoids caching the encrypted and
	  decrypted pages in the page cache.  Currently Ext4,
	  F2FS and UBIFS make use of this feature.

# Filesystems supporting encryption must select this if FS_ENCRYPTION.  This
# allows the algorithms to be built as modules when all the filesystems are.
config FS_ENCRYPTION_ALGS
	tristate
	imply CRYPTO_AES
	imply CRYPTO_CBC
	imply CRYPTO_CTS
	imply CRYPTO_ECB
	imply CRYPTO_HMAC
	imply CRYPTO_SHA512
	imply CRYPTO_XTS
	help
	  This pulls in the generic implementations of the various
	  cryptographic algorithms and chaining modes that filesystem
	  encryption relies on. These are 'soft' dependencies only, as
	  architectures may supersede these generic implementations with
	  special, optimized ones.

	  If unsure, keep the generic algorithms enabled, as they can
	  happily co-exist with per-architecture implementations.

config FS_ENCRYPTION_INLINE_CRYPT
	bool "Enable fscrypt to use inline crypto"
	depends on FS_ENCRYPTION && BLK_INLINE_ENCRYPTION
	help
	  Enable fscrypt to use inline encryption hardware if available.
```

## fs/namespacefs/Kconfig
```kconfig
# SPDX-License-Identifier: GPL-2.0-only
config NAMESPACE_FS
	bool "NameSpace Filesystem support"
	help
	  This option enables support for namespacefs - a pseudo filesystem
	  that allows to examine the hierarchy of namespaces.
```

## fs/srvfs/Kconfig
```kconfig
config SRV_FS
	tristate "Plan9-like /srv filesystem"
	select FS_BOXED_FILE
	help
	  If you don't know what this is about, say N.

	  To compile this as a module, choose M here: the module will be called
	  srv-fs.  Note that the file system of your root partition (the one
	  containing the directory /) cannot be compiled as a module.
```

## fs/unicode/Kconfig
```kconfig
# SPDX-License-Identifier: GPL-2.0-only
#
# UTF-8 normalization
#
# This config option will be automatically selected when UNICODE_UTF8_DATA
# is enabled. UNICODE config will provide all the UTF-8 core and normalization
# functions which will use UTF-8 data tables.
config UNICODE
	bool "UTF-8 normalization and casefolding support"

config UNICODE_UTF8_DATA
	tristate "UTF-8 support for native Case-Insensitive filesystems"
	select UNICODE
	help
	  Say M here to enable UTF-8 NFD normalization and NFD+CF casefolding
	  support as a loadable module or say Y for building it into the kernel.
	  It is currently supported by EXT4 and F2FS filesystems.

	  utf8data.h_shipped has a large database table which is an
	  auto-generated decodification trie for the unicode normalization
	  functions. Enabling UNICODE_UTF8_DATA as M will allow you to avoid
	  carrying this large table into the kernel and module will only be
	  loaded with the data tables whenever required by any filesystem.
	  If your filesystem requires to have the utf8-data during boot time
	  then you should have it built into the kernel by saying Y here to
	  avoid any boot failure.

config UNICODE_NORMALIZATION_SELFTEST
	tristate "Test UTF-8 normalization support"
	depends on UNICODE_UTF8_DATA
	default n
```

## lib/math/Kconfig
```kconfig
# SPDX-License-Identifier: GPL-2.0-only
config CORDIC
	tristate "CORDIC algorithm"
	help
	  This option provides an implementation of the CORDIC algorithm;
	  calculations are in fixed point. Module will be called cordic.

config PRIME_NUMBERS
	tristate "Simple prime number generator for testing"
	help
	  This option provides a simple prime number generator for test
	  modules.

	  If unsure, say N.

config RATIONAL
	bool

config MATH_KUNIT_TEST
	tristate "KUnit test for lib/math" if !KUNIT_ALL_TESTS
	default KUNIT_ALL_TESTS
	depends on KUNIT
```

## net/smc/Kconfig
```kconfig
# SPDX-License-Identifier: GPL-2.0-only
config SMC
	tristate "SMC socket protocol family"
	depends on INET && INFINIBAND
	help
	  SMC-R provides a "sockets over RDMA" solution making use of
	  RDMA over Converged Ethernet (RoCE) technology to upgrade
	  AF_INET TCP connections transparently.
	  The Linux implementation of the SMC-R solution is designed as
	  a separate socket family SMC.

	  Select this option if you want to run SMC socket applications

config SMC_DIAG
	tristate "SMC: socket monitoring interface"
	depends on SMC
	help
	  Support for SMC socket monitoring interface used by tools such as
	  smcss.

	  if unsure, say Y.

if SMC

config SMC_AUTO_FALLBACK
	bool "SMC: automatic fallback to TCP"
	default y
	help
	  Allow automatic fallback to TCP accroding to the pressure of SMC-R
	  handshake process.

	  If that's not what you except or unsure, say N.
endif
```

## security/integrity/digest_lists/Kconfig
```kconfig
# SPDX-License-Identifier: GPL-2.0-only
# Huawei Digest Lists
#
config DIGEST_LISTS
	bool "Digest Lists"
	select SECURITYFS
	select CRYPTO
	select CRYPTO_HASH_INFO
	help
	  Huawei Digest Lists provides reference values for file content and
	  metadata, that can be used for measurement and appraisal with IMA.
```

## security/ipe/Kconfig
```kconfig
# SPDX-License-Identifier: GPL-2.0-only
#
# Integrity Policy Enforcement (IPE) configuration
#

menuconfig SECURITY_IPE
	bool "Integrity Policy Enforcement (IPE)"
	depends on SECURITY && SECURITYFS
	select PKCS7_MESSAGE_PARSER
	select SYSTEM_DATA_VERIFICATION
	help
	  This option enables the Integrity Policy Enforcement subsystem
	  allowing systems to enforce integrity having no dependencies
	  on filesystem metadata, making its decisions based off of kernel-
	  resident features and data structures. A key feature of IPE is a
	  customizable policy to allow admins to reconfigure integrity
	  requirements on the fly.

	  If unsure, answer N.

if SECURITY_IPE

config IPE_BOOT_POLICY
	string "Integrity policy to apply on system startup"
	help
	  This option specifies a filepath to a IPE policy that is compiled
	  into the kernel. This policy will be enforced until a policy update
	  is deployed via the $securityfs/ipe/policies/$policy_name/active
	  interface.

	  If unsure, leave blank.

choice
	prompt "Hash algorithm used in auditing policies"
	default IPE_AUDIT_HASH_SHA1
	depends on AUDIT
	help
		Specify the hash algorithm used when auditing policies.
		The hash is used to uniquely identify a policy from other
		policies on the system.

		If unsure, leave default.

	config IPE_AUDIT_HASH_SHA1
		bool "sha1"
		depends on CRYPTO_SHA1
		help
			Use the SHA128 algorithm to hash policies
			in the audit records.

	config IPE_AUDIT_HASH_SHA256
		bool "sha256"
		depends on CRYPTO_SHA256
		help
			Use the SHA256 algorithm to hash policies
			in the audit records.

	config IPE_AUDIT_HASH_SHA384
		bool "sha384"
		depends on CRYPTO_SHA512
		help
			Use the SHA384 algorithm to hash policies
			in the audit records

	config IPE_AUDIT_HASH_SHA512
		bool "sha512"
		depends on CRYPTO_SHA512
		help
			Use the SHA512 algorithm to hash policies
			in the audit records
endchoice

config IPE_AUDIT_HASH_ALG
	string
	depends on AUDIT
	default "sha1" if IPE_AUDIT_HASH_SHA1
	default "sha256" if IPE_AUDIT_HASH_SHA256
	default "sha384" if IPE_AUDIT_HASH_SHA384
	default "sha512" if IPE_AUDIT_HASH_SHA512

source "security/ipe/modules/Kconfig"

config SECURITY_IPE_KUNIT_TEST
	bool "Build KUnit tests for IPE" if !KUNIT_ALL_TESTS
	depends on KUNIT=y
	default KUNIT_ALL_TESTS
	help
	  This builds the IPE KUnit tests.

	  KUnit tests run during boot and output the results to the debug log
	  in TAP format (https://testanything.org/). Only useful for kernel devs
	  running KUnit test harness and are not for inclusion into a
	  production build.

	  For more information on KUnit and unit tests in general please refer
	  to the KUnit documentation in Documentation/dev-tools/kunit/.

	  If unsure, say N.

endif
```

## security/ipe/modules/Kconfig
```kconfig
menu "IPE Trust Providers"

config IPE_PROP_BOOT_VERIFIED
	bool "Enable trust for initramfs"
	depends on SECURITY_IPE
	default N
	help
	  This option enables the property 'boot_verified' in IPE policy.
	  This property 'pins' the initial superblock when something
	  is evaluated as an execution. This property will evaluate
	  to true when the file being evaluated originates from this
	  superblock.

	  This property is useful to authorize a signed initramfs.

	  If unsure, answer N.

config IPE_PROP_DM_VERITY_SIGNATURE
	bool "Enable support for signed dm-verity volumes"
	depends on DM_VERITY_VERIFY_ROOTHASH_SIG
	default Y
	help
	  This option enables the property 'dmverity_signature' in
	  IPE policy. This property evaluates to TRUE when a file
	  is evaluated against a dm-verity volume that was mounted
	  with a signed root-hash.

	  If unsure, answer Y.

config IPE_PROP_DM_VERITY_ROOTHASH
	bool "Enable support for dm-verity volumes"
	depends on DM_VERITY
	default Y
	help
	  This option enables the property 'dmverity_roothash' in
	  IPE policy. This property evaluates to TRUE when a file
	  is evaluated against a dm-verity volume whose root hash
	  matches the supplied value.

	  If unsure, answer Y.

config IPE_PROP_FS_VERITY_SIGNATURE
	bool "Enable property for signed fs-verity files"
	depends on FS_VERITY_BUILTIN_SIGNATURES
	help
	  This option enables IPE's integration with FSVerity's
	  signed hashes. This enables the usage of the property,
	  "fsverity_signature" in IPE's policy.

	  if unsure, answer Y.

config IPE_PROP_FS_VERITY_DIGEST
	bool "Enable property for authorizing fs-verity files via digest"
	depends on FS_VERITY
	help
	  This option enables IPE's integration with FSVerity.
	  This enables the usage of the property "fsverity_digest" in IPE's
	  policy. This property allows authorization or revocation via a
	  a hex-string representing the digest of a fsverity file.

	  if unsure, answer Y.



endmenu
```
