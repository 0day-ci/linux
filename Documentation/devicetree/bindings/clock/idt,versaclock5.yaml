## Documentation/devicetree/bindings/display/bridge/ti,sn65dsi83.yaml
```yaml
# SPDX-License-Identifier: (GPL-2.0-only OR BSD-2-Clause)
%YAML 1.2
---
$id: http://devicetree.org/schemas/display/bridge/ti,sn65dsi83.yaml#
$schema: http://devicetree.org/meta-schemas/core.yaml#

title: SN65DSI83 and SN65DSI84 DSI to LVDS bridge chip

maintainers:
  - Marek Vasut <marex@denx.de>

description: |
  Texas Instruments SN65DSI83 1x Single-link MIPI DSI
  to 1x Single-link LVDS
  https://www.ti.com/lit/gpn/sn65dsi83
  Texas Instruments SN65DSI84 1x Single-link MIPI DSI
  to 1x Dual-link or 2x Single-link LVDS
  https://www.ti.com/lit/gpn/sn65dsi84

properties:
  compatible:
    oneOf:
      - const: ti,sn65dsi83
      - const: ti,sn65dsi84

  reg:
    const: 0x2d

  enable-gpios:
    maxItems: 1
    description: GPIO specifier for bridge_en pin (active high).

  ports:
    type: object
    additionalProperties: false

    properties:
      "#address-cells":
        const: 1

      "#size-cells":
        const: 0

      port@0:
        type: object
        additionalProperties: false

        description:
          Video port for MIPI DSI input

        properties:
          reg:
            const: 0

          endpoint:
            type: object
            additionalProperties: false
            properties:
              remote-endpoint: true
              data-lanes:
                description: array of physical DSI data lane indexes.

        required:
          - reg

      port@1:
        type: object
        additionalProperties: false

        description:
          Video port for LVDS output (panel or bridge).

        properties:
          reg:
            const: 1

          endpoint:
            type: object
            additionalProperties: false
            properties:
              remote-endpoint: true

        required:
          - reg

    required:
      - "#address-cells"
      - "#size-cells"
      - port@0
      - port@1

required:
  - compatible
  - reg
  - enable-gpios
  - ports

additionalProperties: false

examples:
  - |
    #include <dt-bindings/gpio/gpio.h>

    i2c {
      #address-cells = <1>;
      #size-cells = <0>;

      bridge@2d {
        compatible = "ti,sn65dsi83";
        reg = <0x2d>;

        enable-gpios = <&gpio2 1 GPIO_ACTIVE_HIGH>;

        ports {
          #address-cells = <1>;
          #size-cells = <0>;

          port@0 {
            reg = <0>;
            endpoint {
              remote-endpoint = <&dsi0_out>;
              data-lanes = <1 2 3 4>;
            };
          };

          port@1 {
            reg = <1>;
            endpoint {
              remote-endpoint = <&panel_in_lvds>;
            };
          };
        };
      };
    };
```

## Documentation/devicetree/bindings/display/bridge/toshiba,tc358764.yaml
```yaml
# SPDX-License-Identifier: (GPL-2.0-only OR BSD-2-Clause)
%YAML 1.2
---
$id: http://devicetree.org/schemas/display/bridge/toshiba,tc358764.yaml#
$schema: http://devicetree.org/meta-schemas/core.yaml#

title: Toshiba TC358764 MIPI-DSI to LVDS bridge

maintainers:
  - Andrzej Hajda <a.hajda@samsung.com>

description: |
  The TC358764 is bridge device which converts MIPI DSI or MIPI DPI to DP/eDP.

properties:
  compatible:
    enum:
      - toshiba,tc358764

  reg:
    description: Virtual channel number of a DSI peripheral
    maxItems: 1

  reset-gpios:
    description: GPIO connected to the reset pin.
    maxItems: 1

  vddc-supply:
    description: Core voltage supply, 1.2V

  vddio-supply:
    description: I/O voltage supply, 1.8V or 3.3V

  vddlvds-supply:
    description: LVDS1/2 voltage supply, 3.3V

  ports:
    $ref: /schemas/graph.yaml#/properties/ports

    properties:
      port@0:
        $ref: /schemas/graph.yaml#/properties/port
        description:
          Video port for MIPI DSI input, if the bridge DSI controlled

      port@1:
        $ref: /schemas/graph.yaml#/properties/port
        description:
          Video port for LVDS output (panel or connector).

    required:
      - port@1

required:
  - compatible
  - reg
  - vddc-supply
  - vddio-supply
  - vddlvds-supply
  - ports

additionalProperties: false

examples:
  - |
    #include <dt-bindings/gpio/gpio.h>

    i2c {
      #address-cells = <1>;
      #size-cells = <0>;

      bridge@0 {
        compatible = "toshiba,tc358764";
        reg = <0>;
        vddc-supply = <&vcc_1v2_reg>;
        vddio-supply = <&vcc_1v8_reg>;
        vddlvds-supply = <&vcc_3v3_reg>;
        reset-gpios = <&gpd1 6 GPIO_ACTIVE_LOW>;

        ports {
          #address-cells = <1>;
          #size-cells = <0>;

          port@1 {
            reg = <1>;
            lvds_ep: endpoint {
              remote-endpoint = <&panel_ep>;
            };
          };
        };
      };
    };

...
```

## Documentation/devicetree/bindings/display/bridge/toshiba,tc358767.yaml
```yaml
# SPDX-License-Identifier: (GPL-2.0-only OR BSD-2-Clause)
%YAML 1.2
---
$id: http://devicetree.org/schemas/display/bridge/toshiba,tc358767.yaml#
$schema: http://devicetree.org/meta-schemas/core.yaml#

title: Toshiba TC358767 MIPI-DSI or MIPI-DPI to DP/eDP bridge

maintainers:
  - Tomi Valkeinen <tomi.valkeinen@ti.com>

properties:
  compatible:
    enum:
      - toshiba,tc358767

  reg:
    description: I2C address of the bridge
    enum: [0x68, 0x0f]

  clocks:
    description:
      Reference clock input. The reference clock rate must be 13MHz, 19.2MHz,
      26MHz, or 38.4MHz.
    maxItems: 1

  clock-names:
    const: ref

  reset-gpios:
    description: GPIO connected to the RSTX signal.
    maxItems: 1

  shutdown-gpios:
    description: GPIO connected to the SD signal.
    maxItems: 1

  toshiba,hpd-pin:
    $ref: "/schemas/types.yaml#/definitions/uint32"
    description: TC356767 GPIO pin number to which HPD is connected
    enum:
      - 0
      - 1

  ports:
    $ref: /schemas/graph.yaml#/properties/ports

    properties:
      port@0:
        $ref: /schemas/graph.yaml#/properties/port
        description:
          Video port for MIPI DSI input

      port@1:
        $ref: /schemas/graph.yaml#/properties/port
        description:
          Video port for MIPI DPI input

      port@2:
        $ref: /schemas/graph.yaml#/properties/port
        description:
          Video port for DP/eDP output (panel or connector).

    oneOf:
      - required:
          - port@0
      - required:
          - port@1
    required:
      - port@2

required:
  - compatible
  - reg
  - clock-names
  - clocks
  - ports

additionalProperties: false

examples:
  - |
    #include <dt-bindings/gpio/gpio.h>

    i2c {
      #address-cells = <1>;
      #size-cells = <0>;

      bridge@68 {
        compatible = "toshiba,tc358767";
        reg = <0x68>;
        clock-names = "ref";
        clocks = <&edp_refclk>;
        reset-gpios = <&gpio3 24 GPIO_ACTIVE_LOW>;
        shutdown-gpios = <&gpio3 23 GPIO_ACTIVE_HIGH>;

        ports {
          #address-cells = <1>;
          #size-cells = <0>;

          port@1 {
            reg = <1>;
            bridge_in: endpoint {
              remote-endpoint = <&dpi_out>;
            };
          };

          port@2 {
            reg = <2>;
            bridge_out: endpoint {
              remote-endpoint = <&panel_in>;
            };
          };
        };
      };
    };

...
```
