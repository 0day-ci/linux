## Documentation/devicetree/bindings/clock/idt,versaclock5.yaml
```yaml
# SPDX-License-Identifier: (GPL-2.0-only OR BSD-2-Clause)
%YAML 1.2
---
$id: http://devicetree.org/schemas/clock/idt,versaclock5.yaml#
$schema: http://devicetree.org/meta-schemas/core.yaml#

title: Binding for IDT VersaClock 5 and 6 programmable I2C clock generators

description: |
  The IDT VersaClock 5 and VersaClock 6 are programmable I2C
  clock generators providing from 3 to 12 output clocks.

  When referencing the provided clock in the DT using phandle and clock
  specifier, the following mapping applies:

  - 5P49V5923:
    0 -- OUT0_SEL_I2CB
    1 -- OUT1
    2 -- OUT2

  - 5P49V5933:
    0 -- OUT0_SEL_I2CB
    1 -- OUT1
    2 -- OUT4

  - other parts:
    0 -- OUT0_SEL_I2CB
    1 -- OUT1
    2 -- OUT2
    3 -- OUT3
    4 -- OUT4

  The idt,(en|dis)able-shutdown and idt,output-enable-active-(high|low)
  properties control the SH (en_global_shutdown) and SP bits of the
  Primary Source and Shutdown Register, respectively. Their behavior is
  summarized by the following table:

  SH SP Output when the SD/OE pin is Low/High
  == == =====================================
   0  0 Active/Inactive
   0  1 Inactive/Active
   1  0 Active/Shutdown
   1  1 Inactive/Shutdown

  One of idt,(en|dis)able-shutdown and one of
  idt,output-enable-active-(high|low) should be specified.

maintainers:
  - Luca Ceresoli <luca@lucaceresoli.net>

properties:
  compatible:
    enum:
      - idt,5p49v5923
      - idt,5p49v5925
      - idt,5p49v5933
      - idt,5p49v5935
      - idt,5p49v6901
      - idt,5p49v6965

  reg:
    description: I2C device address
    enum: [ 0x68, 0x6a ]

  '#clock-cells':
    const: 1

  clock-names:
    minItems: 1
    maxItems: 2
    items:
      enum: [ xin, clkin ]
  clocks:
    minItems: 1
    maxItems: 2

  idt,xtal-load-femtofarads:
    minimum: 9000
    maximum: 22760
    description: Optional load capacitor for XTAL1 and XTAL2

  idt,enable-shutdown:
    $ref: /schemas/types.yaml#/definitions/flag
    description: |
      Enable the shutdown functionality. The chip will be shut down if
      the SD/OE pin is driven high. This corresponds to setting the SH
      bit of the Primary Source and Shutdown Register.

  idt,disable-shutdown:
    $ref: /schemas/types.yaml#/definitions/flag
    description: |
      Disable the shutdown functionality. The chip will never be shut
      down based on the value of the SD/OE pin. This corresponds to
      clearing the SH bit of the Primary Source and Shutdown Register.

  idt,output-enable-active-high:
    $ref: /schemas/types.yaml#/definitions/flag
    description: |
      This enables output when the SD/OE pin is high, and disables
      output when the SD/OE pin is low. This corresponds to setting the
      SP bit of the Primary Source and Shutdown Register.

  idt,output-enable-active-low:
    $ref: /schemas/types.yaml#/definitions/flag
    description: |
      This disables output when the SD/OE pin is high, and enables
      output when the SD/OE pin is low. This corresponds to clearing the
      SP bit of the Primary Source and Shutdown Register.

patternProperties:
  "^OUT[1-4]$":
    type: object
    description:
      Description of one of the outputs (OUT1..OUT4). See "Clock1 Output
      Configuration" in the Versaclock 5/6/6E Family Register Description
      and Programming Guide.
    properties:
      idt,mode:
        description:
          The output drive mode. Values defined in dt-bindings/clk/versaclock.h
        $ref: /schemas/types.yaml#/definitions/uint32
        minimum: 0
        maximum: 6
      idt,voltage-microvolt:
        description: The output drive voltage.
        enum: [ 1800000, 2500000, 3300000 ]
      idt,slew-percent:
        description: The Slew rate control for CMOS single-ended.
        enum: [ 80, 85, 90, 100 ]

required:
  - compatible
  - reg
  - '#clock-cells'

allOf:
  - if:
      properties:
        compatible:
          enum:
            - idt,5p49v5933
            - idt,5p49v5935
    then:
      # Devices with builtin crystal + optional external input
      properties:
        clock-names:
          const: clkin
        clocks:
          maxItems: 1
    else:
      # Devices without builtin crystal
      required:
        - clock-names
        - clocks
  - oneOf:
      - required:
          - idt,enable-shutdown
      - required:
          - idt,disable-shutdown
  - oneOf:
      - required:
          - idt,output-enable-active-high
      - required:
          - idt,output-enable-active-low

additionalProperties: false

examples:
  - |
    #include <dt-bindings/clk/versaclock.h>

    /* 25MHz reference crystal */
    ref25: ref25m {
        compatible = "fixed-clock";
        #clock-cells = <0>;
        clock-frequency = <25000000>;
    };

    i2c@0 {
        reg = <0x0 0x100>;
        #address-cells = <1>;
        #size-cells = <0>;

        /* IDT 5P49V5923 I2C clock generator */
        vc5: clock-generator@6a {
            compatible = "idt,5p49v5923";
            reg = <0x6a>;
            #clock-cells = <1>;

            /* Connect XIN input to 25MHz reference */
            clocks = <&ref25m>;
            clock-names = "xin";

            /* Set the SD/OE pin's settings */
            idt,disable-shutdown;
            idt,output-enable-active-low;

            OUT1 {
                idt,drive-mode = <VC5_CMOSD>;
                idt,voltage-microvolts = <1800000>;
                idt,slew-percent = <80>;
            };

            OUT4 {
                idt,drive-mode = <VC5_LVDS>;
            };
        };
    };

    /* Consumer referencing the 5P49V5923 pin OUT1 */
    consumer {
        /* ... */
        clocks = <&vc5 1>;
        /* ... */
    };

...
```

## Documentation/devicetree/bindings/clock/imxrt-clock.yaml
```yaml
# SPDX-License-Identifier: (GPL-2.0-only OR BSD-2-Clause)
%YAML 1.2
---
$id: http://devicetree.org/schemas/clock/imxrt-clock.yaml#
$schema: http://devicetree.org/meta-schemas/core.yaml#

title: Clock bindings for Freescale i.MXRT

maintainers:
  - Giulio Benetti <giulio.benetti@benettiengineering.com>
  - Jesse Taube <Mr.Bossman075@gmail.com>

description: |
  The clock consumer should specify the desired clock by having the clock
  ID in its "clocks" phandle cell. See include/dt-bindings/clock/imxrt*-clock.h
  for the full list of i.MXRT clock IDs.
properties:
  compatible:
    oneOf:
      - enum:
          - fsl,imxrt1050-ccm

  reg:
    maxItems: 1

  interrupts:
    maxItems: 1

  '#clock-cells':
    const: 1

required:
  - compatible
  - reg
  - interrupts
  - '#clock-cells'

additionalProperties: false

examples:
  - |
    ccm@400fc000 {
      compatible = "fsl,imxrt1050-ccm";
      reg = <0x400fc000 0x4000>;
      interrupts = <95>,<96>;
      clocks = <&osc>;
      clock-names = "osc";
      #clock-cells = <1>;
    };

    gpt: timer@401ec000 {
      compatible = "fsl,imx53-gpt", "fsl,imx31-gpt";
      reg = <0x401ec000 0x4000>;
      interrupts = <100>;
      clocks = <&clks IMXRT1050_CLK_OSC>;
      clock-names = "per";
    };
```

## Documentation/devicetree/bindings/clock/qcom,a53pll.yaml
```yaml
# SPDX-License-Identifier: (GPL-2.0-only OR BSD-2-Clause)
%YAML 1.2
---
$id: http://devicetree.org/schemas/clock/qcom,a53pll.yaml#
$schema: http://devicetree.org/meta-schemas/core.yaml#

title: Qualcomm A53 PLL Binding

maintainers:
  - Sivaprakash Murugesan <sivaprak@codeaurora.org>

description:
  The A53 PLL on few Qualcomm platforms is the main CPU PLL used used for
  frequencies above 1GHz.

properties:
  compatible:
    enum:
      - qcom,ipq6018-a53pll
      - qcom,msm8916-a53pll
      - qcom,msm8939-a53pll-c0
      - qcom,msm8939-a53pll-c1
      - qcom,msm8939-a53pll-cci

  reg:
    maxItems: 1

  '#clock-cells':
    const: 0

  clocks:
    items:
      - description: board XO clock

  clock-names:
    items:
      - const: xo

  clock-output-names:
    maxItems: 1

required:
  - compatible
  - reg
  - '#clock-cells'

additionalProperties: false

examples:
  #Example 1 - A53 PLL found on MSM8916 devices
  - |
    a53pll: clock@b016000 {
        compatible = "qcom,msm8916-a53pll";
        reg = <0xb016000 0x40>;
        #clock-cells = <0>;
    };
  #Example 2 - A53 PLL found on IPQ6018 devices
  - |
    a53pll_ipq: clock-controller@b116000 {
        compatible = "qcom,ipq6018-a53pll";
        reg = <0x0b116000 0x40>;
        #clock-cells = <0>;
        clocks = <&xo>;
        clock-names = "xo";
    };
  #Example 3 - A53 PLLs found on MSM8939 devices
  - |
    a53pll_c1: clock-controller@b016000 {
        compatible = "qcom,msm8939-a53pll-c1";
        reg = <0xb016000 0x40>;
        #clock-cells = <0>;
        clocks = <&xo_board>;
        clock-names = "xo";
        clock-output-names = "a53pll_c1";
    };

    a53pll_c0: clock-controller@b116000 {
        compatible = "qcom,msm8939-a53pll-c0";
        reg = <0xb116000 0x40>;
        #clock-cells = <0>;
        clocks = <&xo_board>;
        clock-names = "xo";
        clock-output-names = "a53pll_c0";
    };

    a53pll_cci: clock-controller@b1d0000 {
        compatible = "qcom,msm8939-a53pll-cci";
        reg = <0xb1d0000 0x40>;
        #clock-cells = <0>;
        clocks = <&xo_board>;
        clock-names = "xo";
        clock-output-names = "a53pll_cci";
    };
```

## Documentation/devicetree/bindings/clock/qcom,camcc-sm8450.yaml
```yaml
# SPDX-License-Identifier: (GPL-2.0-only OR BSD-2-Clause)
%YAML 1.2
---
$id: http://devicetree.org/schemas/clock/qcom,camcc-sm8450.yaml#
$schema: http://devicetree.org/meta-schemas/core.yaml#

title: Qualcomm Camera Clock & Reset Controller Binding for SM8450

maintainers:
  - Vladimir Zapolskiy <vladimir.zapolskiy@linaro.org>

description: |
  Qualcomm camera clock control module which supports the clocks, resets and
  power domains on SM8450.

  See also dt-bindings/clock/qcom,camcc-sm8450.h

properties:
  compatible:
    const: qcom,sm8450-camcc

  clocks:
    items:
      - description: Camera AHB clock from GCC
      - description: Board XO source
      - description: Board active XO source
      - description: Sleep clock source

  clock-names:
    items:
      - const: iface
      - const: bi_tcxo
      - const: bi_tcxo_ao
      - const: sleep_clk

  power-domains:
    maxItems: 1
    description:
      A phandle and PM domain specifier for the MMCX power domain.

  required-opps:
    description:
      A phandle to an OPP node describing required MMCX performance point.

  '#clock-cells':
    const: 1

  '#reset-cells':
    const: 1

  '#power-domain-cells':
    const: 1

  reg:
    maxItems: 1

required:
  - compatible
  - reg
  - clocks
  - clock-names
  - power-domains
  - required-opps
  - '#clock-cells'
  - '#reset-cells'
  - '#power-domain-cells'

additionalProperties: false

examples:
  - |
    #include <dt-bindings/clock/qcom,gcc-sm8450.h>
    #include <dt-bindings/clock/qcom,rpmh.h>
    #include <dt-bindings/power/qcom-rpmpd.h>
    clock-controller@ade0000 {
      compatible = "qcom,sm8450-camcc";
      reg = <0 0xade0000 0 0x20000>;
      clocks = <&gcc GCC_CAMERA_AHB_CLK>,
               <&rpmhcc RPMH_CXO_CLK>,
               <&rpmhcc RPMH_CXO_CLK_A>,
               <&sleep_clk>;
      clock-names = "iface", bi_tcxo", "bi_tcxo_ao", "sleep_clk";
      power-domains = <&rpmhpd SM8450_MMCX>;
      required-opps = <&rpmhpd_opp_low_svs>;
      #clock-cells = <1>;
      #reset-cells = <1>;
      #power-domain-cells = <1>;
    };
...
```

## Documentation/devicetree/bindings/clock/qcom,gcc-msm8994.yaml
```yaml
# SPDX-License-Identifier: GPL-2.0-only
%YAML 1.2
---
$id: "http://devicetree.org/schemas/clock/qcom,gcc-msm8994.yaml#"
$schema: "http://devicetree.org/meta-schemas/core.yaml#"

title: Qualcomm Global Clock & Reset Controller Binding for MSM8994

description: |
  Qualcomm global clock control module which supports the clocks, resets and
  power domains on MSM8994 and MSM8992.

  See also:
  - dt-bindings/clock/qcom,gcc-msm8994.h

maintainers:
  - Stephen Boyd <sboyd@kernel.org>
  - Taniya Das <tdas@codeaurora.org>

properties:
  compatible:
    enum:
      - qcom,gcc-msm8992
      - qcom,gcc-msm8994

  clocks:
    items:
      - description: XO source
      - description: Sleep clock source

  clock-names:
    items:
      - const: xo
      - const: sleep

  '#clock-cells':
    const: 1

  '#reset-cells':
    const: 1

  '#power-domain-cells':
    const: 1

  reg:
    maxItems: 1

  protected-clocks:
    description:
      Protected clock specifier list as per common clock binding.

  qcom,sdcc2-clk-src-40mhz:
    description: SDCC2_APPS clock source runs at 40MHz.
    type: boolean

required:
  - compatible
  - reg
  - '#clock-cells'
  - '#reset-cells'
  - '#power-domain-cells'

additionalProperties: false

examples:
  - |
    clock-controller@300000 {
      compatible = "qcom,gcc-msm8994";
      reg = <0x300000 0x90000>;
      #clock-cells = <1>;
      #reset-cells = <1>;
      #power-domain-cells = <1>;
      clocks = <&xo_board>, <&sleep_clk>;
      clock-names = "xo", "sleep";
    };
...
```

## Documentation/devicetree/bindings/clock/qcom,krait-cc.yaml
```yaml
# SPDX-License-Identifier: GPL-2.0-only OR BSD-2-Clause
%YAML 1.2
---
$id: http://devicetree.org/schemas/clock/qcom,krait-cc.yaml#
$schema: http://devicetree.org/meta-schemas/core.yaml#

title: Qualcomm Krait Clock Controller

maintainers:
  - Ansuel Smith <ansuelsmth@gmail.com>

description: |
  Qualcomm Krait Clock Controller used to correctly scale the CPU and the L2
  rates.

properties:
  compatible:
    enum:
      - qcom,krait-cc-v1
      - qcom,krait-cc-v2

  clocks:
    items:
      - description: phandle to hfpll for CPU0 mux
      - description: phandle to hfpll for CPU1 mux
      - description: phandle to hfpll for L2 mux
      - description: phandle to CPU0 aux clock
      - description: phandle to CPU1 aux clock
      - description: phandle to L2 aux clock
      - description: phandle to QSB fixed clk

  clock-names:
    items:
      - const: hfpll0
      - const: hfpll1
      - const: hfpll_l2
      - const: acpu0_aux
      - const: acpu1_aux
      - const: acpu_l2_aux
      - const: qsb

  '#clock-cells':
    const: 1

required:
  - compatible
  - clocks
  - clock-names
  - '#clock-cells'

additionalProperties: false

examples:
  - |
    clock-controller {
      compatible = "qcom,krait-cc-v1";
      clocks = <&hfpll0>, <&hfpll1>, <&hfpll_l2>,
               <&acpu0_aux>, <&acpu1_aux>, <&acpu_l2_aux>, <&qsb>;
      clock-names = "hfpll0", "hfpll1", "hfpll_l2",
                    "acpu0_aux", "acpu1_aux", "acpu_l2_aux", "qsb";
      #clock-cells = <1>;
    };
...
```
