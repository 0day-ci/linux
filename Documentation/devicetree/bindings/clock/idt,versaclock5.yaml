## Documentation/devicetree/bindings/clock/qcom,sc7280-lpasscorecc.yaml
```yaml
# SPDX-License-Identifier: (GPL-2.0-only OR BSD-2-Clause)
%YAML 1.2
---
$id: http://devicetree.org/schemas/clock/qcom,sc7280-lpasscorecc.yaml#
$schema: http://devicetree.org/meta-schemas/core.yaml#

title: Qualcomm LPASS Core & Audio Clock Controller Binding for SC7280

maintainers:
  - Taniya Das <tdas@codeaurora.org>

description: |
  Qualcomm LPASS core and audio clock control module which supports the
  clocks and power domains on SC7280.

  See also:
  - dt-bindings/clock/qcom,lpasscorecc-sc7280.h
  - dt-bindings/clock/qcom,lpassaudiocc-sc7280.h

properties:
  compatible:
    enum:
      - qcom,sc7280-lpassaoncc
      - qcom,sc7280-lpassaudiocc
      - qcom,sc7280-lpasscorecc
      - qcom,sc7280-lpasshm

  clocks:
    items:
      - description: gcc_cfg_noc_lpass_clk
      - description: Board XO source
      - description: lpass_aon_cc_main_rcg source clock

  clock-names:
    items:
      - const: iface
      - const: bi_tcxo
      - const: lpass_aon_cc_main_rcg

  power-domains:
    maxItems: 1

  '#clock-cells':
    const: 1

  '#power-domain-cells':
    const: 1

  reg:
    maxItems: 1

if:
  properties:
    compatible:
      contains:
        const: qcom,sc7280-lpasshm
then:
  properties:
    clocks:
      maxItems: 2

else:
  properties:
    clocks:
      minItems: 1


required:
  - compatible
  - reg
  - clocks
  - clock-names
  - '#clock-cells'
  - '#power-domain-cells'

additionalProperties: false

examples:
  - |
    #include <dt-bindings/clock/qcom,rpmh.h>
    #include <dt-bindings/clock/qcom,gcc-sc7280.h>
    #include <dt-bindings/clock/qcom,lpassaudiocc-sc7280.h>
    #include <dt-bindings/clock/qcom,lpasscorecc-sc7280.h>
    clock-controller@3c00000 {
      compatible = "qcom,sc7280-lpasshm";
      reg = <0x3c00000 0x28>;
      clocks = <&gcc GCC_CFG_NOC_LPASS_CLK>;
      clock-names = "iface";
      #clock-cells = <1>;
      #power-domain-cells = <1>;
    };

  - |
    #include <dt-bindings/clock/qcom,rpmh.h>
    #include <dt-bindings/clock/qcom,gcc-sc7280.h>
    #include <dt-bindings/clock/qcom,lpassaudiocc-sc7280.h>
    #include <dt-bindings/clock/qcom,lpasscorecc-sc7280.h>
    clock-controller@3900000 {
      compatible = "qcom,sc7280-lpasscorecc";
      reg = <0x3900000 0x50000>;
      clocks = <&gcc GCC_CFG_NOC_LPASS_CLK>, <&rpmhcc RPMH_CXO_CLK>;
      clock-names = "iface", "bi_tcxo";
      power-domains = <&lpass_hm LPASS_CORE_CC_LPASS_CORE_HM_GDSC>;
      #clock-cells = <1>;
      #power-domain-cells = <1>;
    };

  - |
    #include <dt-bindings/clock/qcom,rpmh.h>
    #include <dt-bindings/clock/qcom,gcc-sc7280.h>
    #include <dt-bindings/clock/qcom,lpassaudiocc-sc7280.h>
    #include <dt-bindings/clock/qcom,lpasscorecc-sc7280.h>
    clock-controller@3380000 {
      compatible = "qcom,sc7280-lpassaoncc";
      reg = <0x3380000 0x30000>;
      clocks = <&lpasscc LPASS_CORE_CC_CORE_CLK>, <&rpmhcc RPMH_CXO_CLK>;
      clock-names = "iface", "bi_tcxo";
      #clock-cells = <1>;
      #power-domain-cells = <1>;
    };

  - |
    #include <dt-bindings/clock/qcom,rpmh.h>
    #include <dt-bindings/clock/qcom,gcc-sc7280.h>
    #include <dt-bindings/clock/qcom,lpassaudiocc-sc7280.h>
    #include <dt-bindings/clock/qcom,lpasscorecc-sc7280.h>
    clock-controller@3300000 {
      compatible = "qcom,sc7280-lpassaudiocc";
      reg = <0x3300000 0x30000>;
      clocks = <&rpmhcc RPMH_CXO_CLK>,
               <&lpass_aon LPASS_AON_CC_MAIN_RCG_CLK_SRC>;
      clock-names = "bi_tcxo", "lpass_aon_cc_main_rcg";
      power-domains = <&lpass_aon LPASS_AON_CC_LPASS_AUDIO_HM_GDSC>;
      #clock-cells = <1>;
      #power-domain-cells = <1>;
    };
...
```

## Documentation/devicetree/bindings/clock/qcom,videocc.yaml
```yaml
# SPDX-License-Identifier: GPL-2.0-only
%YAML 1.2
---
$id: http://devicetree.org/schemas/clock/qcom,videocc.yaml#
$schema: http://devicetree.org/meta-schemas/core.yaml#

title: Qualcomm Video Clock & Reset Controller Binding

maintainers:
  - Taniya Das <tdas@codeaurora.org>

description: |
  Qualcomm video clock control module which supports the clocks, resets and
  power domains on SDM845/SC7180/SM8150/SM8250.

  See also:
    dt-bindings/clock/qcom,videocc-sc7180.h
    dt-bindings/clock/qcom,videocc-sdm845.h
    dt-bindings/clock/qcom,videocc-sm8150.h
    dt-bindings/clock/qcom,videocc-sm8250.h

properties:
  compatible:
    enum:
      - qcom,sc7180-videocc
      - qcom,sdm845-videocc
      - qcom,sm8150-videocc
      - qcom,sm8250-videocc

  clocks:
    items:
      - description: Board XO source

  clock-names:
    items:
      - const: bi_tcxo

  '#clock-cells':
    const: 1

  '#reset-cells':
    const: 1

  '#power-domain-cells':
    const: 1

  reg:
    maxItems: 1

  power-domains:
    description:
      A phandle and PM domain specifier for the MMCX power domain.
    maxItems: 1

  required-opps:
    description:
      Performance state to use for MMCX to enable register access.
    maxItems: 1

required:
  - compatible
  - reg
  - clocks
  - clock-names
  - '#clock-cells'
  - '#reset-cells'
  - '#power-domain-cells'

# Either both properties are present or both are absent
dependencies:
  power-domains:
    required:
      - required-opps
  required-opps:
    required:
      - power-domains

additionalProperties: false

examples:
  - |
    #include <dt-bindings/clock/qcom,rpmh.h>
    clock-controller@ab00000 {
      compatible = "qcom,sdm845-videocc";
      reg = <0x0ab00000 0x10000>;
      clocks = <&rpmhcc RPMH_CXO_CLK>;
      clock-names = "bi_tcxo";
      #clock-cells = <1>;
      #reset-cells = <1>;
      #power-domain-cells = <1>;
    };
...
```

## Documentation/devicetree/bindings/clock/renesas,8t49n241.yaml
```yaml
# SPDX-License-Identifier: (GPL-2.0-only OR BSD-2-Clause)
%YAML 1.2
---
$id: http://devicetree.org/schemas/clock/renesas,8t49n241.yaml#
$schema: http://devicetree.org/meta-schemas/core.yaml#

title: Binding for Renesas 8T49N241 Universal Frequency Translator

description: |
  The 8T49N241 has one fractional-feedback PLL that can be used as a
  jitter attenuator and frequency translator. It is equipped with one
  integer and three fractional output dividers, allowing the generation
  of up to four different output frequencies, ranging from 8kHz to 1GHz.
  These frequencies are completely independent of each other, the input
  reference frequencies and the crystal reference frequency. The device
  places virtually no constraints on input to output frequency conversion,
  supporting all FEC rates, including the new revision of ITU-T
  Recommendation G.709 (2009), most with 0ppm conversion error.
  The outputs may select among LVPECL, LVDS, HCSL or LVCMOS output levels.

  The driver can read a full register map from the DT, and will use that
  register map to initialize the attached part (via I2C) when the system
  boots. Any configuration not supported by the common clock framework
  must be done via the full register map, including optimized settings.

  The 8T49N241 accepts up to two differential or single-ended input clocks
  and a fundamental-mode crystal input. The internal PLL can lock to either
  of the input reference clocks or just to the crystal to behave as a
  frequency synthesizer. The PLL can use the second input for redundant
  backup of the primary input reference, but in this case, both input clock
  references must be related in frequency.

  All outputs are currently assumed to be LVDS, unless overridden in the
  full register map in the DT.

maintainers:
  - Alex Helms <alexander.helms.jy@renesas.com>
  - David Cater <david.cater.jc@renesas.com>

properties:
  compatible:
    enum:
      - renesas,8t49n241

  reg:
    description: I2C device address
    enum: [ 0x7c, 0x6c, 0x7d, 0x6d, 0x7e, 0x6e, 0x7f, 0x6f ]

  '#clock-cells':
    const: 1

  clock-names:
    minItems: 1
    maxItems: 3
    items:
      enum: [ xtal, clk0, clk1 ]

  clocks:
    minItems: 1
    maxItems: 3

  renesas,settings:
    description: Optional, complete register map of the device.
      Optimized settings for the device must be provided in full
      and are written during initialization.
    $ref: /schemas/types.yaml#/definitions/uint8-array
    minItems: 791
    maxItems: 791

required:
  - compatible
  - reg
  - '#clock-cells'
  - clocks
  - clock-names

additionalProperties: false

examples:
  - |
    /* 25MHz reference clock */
    clk0: clk0 {
      compatible = "fixed-clock";
      #clock-cells = <0>;
      clock-frequency = <25000000>;
    };

    i2c@0 {
        reg = <0x0 0x100>;
        #address-cells = <1>;
        #size-cells = <0>;

        renesas8t49n241_1: clock-generator@6c {
            compatible = "renesas,8t49n241";
            reg = <0x6c>;
            #clock-cells = <1>;

            clocks = <&clk0>;
            clock-names = "clk0";
        };
    };

    /* Consumer referencing the 8T49N241 Q1 */
    consumer {
        /* ... */
        clocks = <&renesas8t49n241_1 1>;
        /* ... */
    };
  - |
    /* 40MHz crystal */
    xtal: xtal {
      compatible = "fixed-clock";
      #clock-cells = <0>;
      clock-frequency = <40000000>;
    };

    i2c@0 {
        reg = <0x0 0x100>;
        #address-cells = <1>;
        #size-cells = <0>;

        renesas8t49n241_2: clock-generator@6c {
            compatible = "renesas,8t49n241";
            reg = <0x6c>;
            #clock-cells = <1>;

            clocks = <&xtal>;
            clock-names = "xtal";

            renesas,settings=[
                09 50 00 60 67 C5 6C FF 03 00 30 00 00 01 00 00
                01 07 00 00 07 00 00 77 6D 06 00 00 00 00 00 FF
                FF FF FF 00 3F 00 2A 00 16 33 33 00 01 00 00 D0
                00 00 00 00 00 00 00 00 00 04 00 00 00 02 00 00
                00 00 00 00 00 00 00 17 00 00 00 00 00 00 00 00
                00 00 00 00 00 00 00 00 00 00 00 00 00 00 00 00
                00 00 00 00 00 00 00 00 D7 0A 2B 20 00 00 00 0B
                00 00 00 00 00 00 00 00 00 00 27 00 00 00 00 00
                00 00 00 00 00 00 00 00 00 00 00 00 00 00 00 00
                00 00 00 00 00 00 00 00 00 00 00 00 00 00 00 00
                00 00 00 00 00 00 00 00 00 00 00 00 00 00 00 00
                00 00 00 00 00 00 00 00 00 00 00 00 00 00 00 00
                00 00 00 00 00 00 00 00 00 00 00 00 00 00 00 00
                00 00 00 00 00 00 00 00 00 00 00 00 00 00 00 00
                00 00 00 00 00 00 00 00 00 00 00 00 00 00 00 00
                00 00 00 00 00 00 00 00 00 00 00 00 00 00 00 00
                00 00 00 00 00 00 00 00 00 00 00 00 00 00 00 00
                00 00 00 00 00 00 00 00 00 00 00 00 00 00 00 00
                00 00 00 00 00 00 00 00 00 00 00 00 00 00 00 00
                00 00 00 00 00 00 00 00 00 00 00 00 00 00 00 00
                00 00 00 00 00 00 00 00 00 00 00 00 00 00 00 00
                00 00 00 00 00 00 00 00 00 00 00 00 00 00 00 00
                00 00 00 00 00 00 00 00 00 00 00 00 00 00 00 00
                00 00 00 00 00 00 00 00 00 00 00 00 00 00 00 00
                00 00 00 00 00 00 00 00 00 00 00 00 00 00 00 00
                00 00 00 00 00 00 00 00 00 00 00 00 00 00 00 00
                00 00 00 00 00 00 00 00 00 00 00 00 00 00 00 00
                00 00 00 00 00 00 00 00 00 00 00 00 00 00 00 00
                00 00 00 00 00 00 00 00 00 00 00 00 00 00 00 00
                00 00 00 00 00 00 00 00 00 00 00 00 00 00 00 00
                00 00 00 00 00 00 00 00 00 00 00 00 00 00 00 00
                00 00 00 00 00 00 00 00 00 00 00 00 00 00 00 00
                C3 00 08 01 00 00 00 00 00 00 00 00 00 30 00 00
                00 0A 00 00 00 00 00 00 00 00 00 00 00 00 00 00
                00 00 00 00 00 00 00 00 00 00 00 00 00 00 00 00
                00 00 00 00 00 00 00 00 00 00 00 00 00 00 00 00
                00 00 00 00 00 00 00 00 00 00 00 00 00 00 00 00
                00 00 00 00 00 00 00 00 00 00 00 00 00 00 00 00
                00 00 00 00 00 00 00 00 00 00 00 00 00 00 00 00
                00 00 00 00 00 00 00 00 00 00 00 00 00 00 00 00
                00 00 00 00 00 00 00 00 00 00 00 00 00 00 00 00
                00 00 00 00 00 00 00 00 00 00 00 00 00 00 00 00
                00 00 00 00 00 00 00 00 00 00 00 00 00 00 00 00
                00 00 00 00 00 00 00 00 00 00 00 00 00 00 00 00
                00 00 00 00 00 00 00 00 00 00 00 00 00 00 00 00
                00 00 00 00 00 00 00 00 00 00 00 00 00 00 00 00
                00 00 00 00 00 00 00 00 00 00 00 00 00 00 00 00
                00 00 00 00 00 00 00 00 00 00 00 00 00 00 00 00
                00 00 00 00 85 00 00 9C 01 D4 02 71 07 00 00 00
                00 83 00 10 02 08 8C
            ];
        };
    };

    /* Consumer referencing the 8T49N241 Q1 */
    consumer {
        /* ... */
        clocks = <&renesas8t49n241_2 1>;
        /* ... */
    };
```

## Documentation/devicetree/bindings/clock/sunplus,sp7021-clkc.yaml
```yaml
# SPDX-License-Identifier: (GPL-2.0-only OR BSD-2-Clause)
# Copyright (C) Sunplus Co., Ltd. 2021
%YAML 1.2
---
$id: http://devicetree.org/schemas/clock/sunplus,sp7021-clkc.yaml#
$schema: http://devicetree.org/meta-schemas/core.yaml#

title: Sunplus SP7021 SoC Clock Controller Binding

maintainers:
  - Qin Jian <qinjian@cqplus1.com>

properties:
  compatible:
    const: sunplus,sp7021-clkc

  "#clock-cells":
    const: 1

  reg:
    maxItems: 1

required:
  - compatible
  - "#clock-cells"
  - reg

additionalProperties: false

examples:
  - |
    clkc: clkc@9c000000 {
      compatible = "sunplus,sp7021-clkc";
      #clock-cells = <1>;
      reg = <0x9c000000 0x280>;
    };

...
```

## Documentation/devicetree/bindings/clock/ti,palmas-clk32k.yaml
```yaml
# SPDX-License-Identifier: GPL-2.0-only
%YAML 1.2
---
$id: http://devicetree.org/schemas/clock/ti,palmas-clk32k.yaml#
$schema: http://devicetree.org/meta-schemas/core.yaml#

title: Texas Instruments Palmas family of Power-Management ICs (clocks)

maintainers:
  - Michael Turquette <mturquette@baylibre.com>
  - Stephen Boyd <sboyd@kernel.org>

description:
  Palmas devices have two clock output pins for 32KHz, KG and KG_AUDIO. This binding uses the
  common clock binding ./clock-bindings.txt.

properties:
  compatible:
    enum:
      - ti,palmas-clk32kg
      - ti,palmas-clk32kgaudio

  "#clock-cells":
    const: 0

  ti,external-sleep-control:
    $ref: /schemas/types.yaml#/definitions/uint32
    description: |
      The external enable input pins controlled the enable/disable of clocks. The external enable
      input pins ENABLE1, ENABLE2 and NSLEEP. The valid values for the external pins are:

        PALMAS_EXT_CONTROL_PIN_ENABLE1 for ENABLE1 pin
        PALMAS_EXT_CONTROL_PIN_ENABLE2 for ENABLE2 pin
        PALMAS_EXT_CONTROL_PIN_NSLEEP for NSLEEP pin

      Option 0 or missing this property means the clock is enabled/disabled via register access
      and these pins do not have any control. The macros of external control pins for DTS are
      defined in dt-bindings/mfd/palmas.h.
    enum: [ 0, 1, 2, 3 ]

additionalProperties: false

required:
  - compatible
  - "#clock-cells"

examples:
  - |
    #include <dt-bindings/mfd/palmas.h>

    i2c {
      #address-cells = <1>;
      #size-cells = <0>;

      tps65913@58 {
        compatible = "ti,tps65913", "ti,palmas";
        reg = <0x58>;

        #interrupt-cells = <2>;
        interrupt-controller;

        clk32k {
          compatible = "ti,palmas-clk32kg";
          #clock-cells = <0>;
          ti,external-sleep-control = <PALMAS_EXT_CONTROL_PIN_NSLEEP>;
        };
      };
    };
```
