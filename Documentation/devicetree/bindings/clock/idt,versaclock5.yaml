## Documentation/devicetree/bindings/display/bridge/samsung,mipi-dsim.yaml
```yaml
# SPDX-License-Identifier: (GPL-2.0-only OR BSD-2-Clause)
%YAML 1.2
---
$id: http://devicetree.org/schemas/display/bridge/samsung,mipi-dsim.yaml#
$schema: http://devicetree.org/meta-schemas/core.yaml#

title: Samsung MIPI DSIM bridge controller

maintainers:
  - Inki Dae <inki.dae@samsung.com>
  - Joonyoung Shim <jy0922.shim@samsung.com>
  - Seung-Woo Kim <sw0312.kim@samsung.com>
  - Kyungmin Park <kyungmin.park@samsung.com>
  - Andrzej Hajda <a.hajda@samsung.com>
  - Jagan Teki <jagan@amarulasolutions.com>

description: |
  Samsung MIPI DSIM bridge controller can be found it on Exynos
  and i.MX8M Mini and Nano SoC's.

properties:
  compatible:
    enum:
      - samsung,exynos3250-mipi-dsi
      - samsung,exynos4210-mipi-dsi
      - samsung,exynos5410-mipi-dsi
      - samsung,exynos5422-mipi-dsi
      - samsung,exynos5433-mipi-dsi
      - fsl,imx8mm-mipi-dsim

  reg:
    maxItems: 1

  interrupts:
    maxItems: 1

  '#address-cells':
    const: 1

  '#size-cells':
    const: 0

  assigned-clock-parents: true
  assigned-clock-rates: true
  assigned-clocks: true

  clocks:
    minItems: 2
    maxItems: 5

  clock-names:
    minItems: 2
    maxItems: 5

  phys:
    maxItems: 1
    description: phandle to the phy module representing the DPHY

  phy-names:
    items:
      - const: dsim

  samsung,phy-type:
    $ref: /schemas/types.yaml#/definitions/uint32
    description: phandle to the samsung phy-type

  power-domains:
    description: phandle to the associated power domain
    maxItems: 1

  samsung,power-domain:
    $ref: /schemas/types.yaml#/definitions/phandle
    description: phandle to the associated samsung power domain
    maxItems: 1

  vddcore-supply:
    description: MIPI DSIM Core voltage supply (e.g. 1.1V)

  vddio-supply:
    description: MIPI DSIM I/O and PLL voltage supply (e.g. 1.8V)

  samsung,burst-clock-frequency:
    $ref: /schemas/types.yaml#/definitions/uint32
    description:
      DSIM high speed burst mode frequency.

  samsung,esc-clock-frequency:
    $ref: /schemas/types.yaml#/definitions/uint32
    description:
      DSIM escape mode frequency.

  samsung,pll-clock-frequency:
    $ref: /schemas/types.yaml#/definitions/uint32
    description:
      DSIM oscillator clock frequency.

  ports:
    $ref: /schemas/graph.yaml#/properties/ports

    properties:
      port@0:
        $ref: /schemas/graph.yaml#/$defs/port-base
        description:
          Input port node to receive pixel data from the
          display controller. Exactly one endpoint must be
          specified.
        properties:
          endpoint@0:
            $ref: /schemas/graph.yaml#/properties/endpoint
            description: sub-node describing the input from MIC or LCDIF

        unevaluatedProperties: false

      port@1:
        $ref: /schemas/graph.yaml#/properties/port
        description:
          DSI output port node to the panel or the next bridge
          in the chain

required:
  - '#address-cells'
  - '#size-cells'
  - clock-names
  - clocks
  - compatible
  - interrupts
  - phy-names
  - phys
  - reg
  - samsung,burst-clock-frequency
  - samsung,esc-clock-frequency
  - samsung,pll-clock-frequency

allOf:
  - $ref: ../dsi-controller.yaml#
  - if:
      properties:
        compatible:
          contains:
            const: fsl,imx8mm-mipi-dsim

    then:
      properties:
        clocks:
          minItems: 2

        clock-names:
          items:
            - const: bus_clk
            - const: sclk_mipi

        ports:
          required:
            - port@0
            - port@1

      required:
        - ports

  - if:
      properties:
        compatible:
          contains:
            const: samsung,exynos5433-mipi-dsi

    then:
      properties:
        clocks:
          minItems: 5

        clock-names:
          items:
            - const: bus_clk
            - const: phyclk_mipidphy0_bitclkdiv8
            - const: phyclk_mipidphy0_rxclkesc0
            - const: sclk_rgb_vclk_to_dsim0
            - const: sclk_mipi

        ports:
          required:
            - port@0

      required:
        - ports
        - vddcore-supply
        - vddio-supply

  - if:
      properties:
        compatible:
          contains:
            const: samsung,exynos5410-mipi-dsi

    then:
      properties:
        clocks:
          minItems: 2

        clock-names:
          items:
            - const: bus_clk
            - const: pll_clk

      required:
        - vddcore-supply
        - vddio-supply

  - if:
      properties:
        compatible:
          contains:
            const: samsung,exynos4210-mipi-dsi

    then:
      properties:
        clocks:
          minItems: 2

        clock-names:
          items:
            - const: bus_clk
            - const: sclk_mipi

      required:
        - vddcore-supply
        - vddio-supply

  - if:
      properties:
        compatible:
          contains:
            const: samsung,exynos3250-mipi-dsi

    then:
      properties:
        clocks:
          minItems: 2

        clock-names:
          items:
            - const: bus_clk
            - const: pll_clk

      required:
        - vddcore-supply
        - vddio-supply
        - samsung,phy-type

additionalProperties:
  type: object

examples:
  - |
    #include <dt-bindings/clock/imx8mm-clock.h>
    #include <dt-bindings/power/imx8mm-power.h>
    #include <dt-bindings/gpio/gpio.h>
    #include <dt-bindings/interrupt-controller/arm-gic.h>

    dsi@32e10000 {
       compatible = "fsl,imx8mm-mipi-dsim";
       reg = <0x32e10000 0x400>;
       clocks = <&clk IMX8MM_CLK_DSI_CORE>,
                <&clk IMX8MM_CLK_DSI_PHY_REF>;
       clock-names = "bus_clk", "sclk_mipi";
       assigned-clocks = <&clk IMX8MM_CLK_DSI_CORE>,
                         <&clk IMX8MM_VIDEO_PLL1_OUT>,
                         <&clk IMX8MM_CLK_DSI_PHY_REF>;
       assigned-clock-parents = <&clk IMX8MM_SYS_PLL1_266M>,
                         <&clk IMX8MM_VIDEO_PLL1_BYPASS>,
                         <&clk IMX8MM_VIDEO_PLL1_OUT>;
       assigned-clock-rates = <266000000>, <594000000>, <27000000>;
       interrupts = <GIC_SPI 18 IRQ_TYPE_LEVEL_HIGH>;
       phys = <&mipi_phy 0>;
       phy-names = "dsim";
       power-domains = <&dispmix_blk_ctl IMX8MM_BLK_CTL_PD_DISPMIX_MIPI_DSI>;
       samsung,burst-clock-frequency = <891000000>;
       samsung,esc-clock-frequency = <54000000>;
       samsung,pll-clock-frequency = <27000000>;
       status = "disabled";

       ports {
          #address-cells = <1>;
          #size-cells = <0>;

          port@0 {
             reg = <0>;
             #address-cells = <1>;
             #size-cells = <0>;

             dsi_in_lcdif: endpoint@0 {
                reg = <0>;
                remote-endpoint = <&lcdif_out_dsi>;
             };
          };

          port@1 {
             reg = <1>;

             dsi_out_panel: endpoint {
                remote-endpoint = <&panel_in_dsi>;
             };
          };
       };
    };

  - |
    #include <dt-bindings/clock/exynos5433.h>
    #include <dt-bindings/gpio/gpio.h>
    #include <dt-bindings/interrupt-controller/arm-gic.h>

    dsi@13900000 {
       compatible = "samsung,exynos5433-mipi-dsi";
       reg = <0x13900000 0xC0>;
       interrupts = <GIC_SPI 205 IRQ_TYPE_LEVEL_HIGH>;
       phys = <&mipi_phy 1>;
       phy-names = "dsim";
       clocks = <&cmu_disp CLK_PCLK_DSIM0>,
                <&cmu_disp CLK_PHYCLK_MIPIDPHY0_BITCLKDIV8>,
                <&cmu_disp CLK_PHYCLK_MIPIDPHY0_RXCLKESC0>,
                <&cmu_disp CLK_SCLK_RGB_VCLK_TO_DSIM0>,
                <&cmu_disp CLK_SCLK_DSIM0>;
       clock-names = "bus_clk",
                     "phyclk_mipidphy0_bitclkdiv8",
                     "phyclk_mipidphy0_rxclkesc0",
                     "sclk_rgb_vclk_to_dsim0",
                     "sclk_mipi";
       power-domains = <&pd_disp>;
       vddcore-supply = <&ldo6_reg>;
       vddio-supply = <&ldo7_reg>;
       samsung,burst-clock-frequency = <512000000>;
       samsung,esc-clock-frequency = <16000000>;
       samsung,pll-clock-frequency = <24000000>;
       pinctrl-names = "default";
       pinctrl-0 = <&te_irq>;
       status = "disabled";
       #address-cells = <1>;
       #size-cells = <0>;

       panel@0 {
          compatible = "samsung,s6e3ha2";
          reg = <0>;
          vdd3-supply = <&ldo27_reg>;
          vci-supply = <&ldo28_reg>;
          reset-gpios = <&gpg0 0 GPIO_ACTIVE_LOW>;
          enable-gpios = <&gpf1 5 GPIO_ACTIVE_HIGH>;
       };

       ports {
          #address-cells = <1>;
          #size-cells = <0>;

          port@0 {
             reg = <0>;

             dsi_to_mic: endpoint {
                remote-endpoint = <&mic_to_dsi>;
             };
          };
       };
    };
```

## Documentation/devicetree/bindings/display/bridge/sil,sii9022.yaml
```yaml
# SPDX-License-Identifier: (GPL-2.0-only OR BSD-2-Clause)
%YAML 1.2
---
$id: http://devicetree.org/schemas/display/bridge/sil,sii9022.yaml#
$schema: http://devicetree.org/meta-schemas/core.yaml#

title: Silicon Image sii902x HDMI bridge

maintainers:
  - Boris Brezillon <bbrezillon@kernel.org>

properties:
  compatible:
    oneOf:
      - items:
          - enum:
              - sil,sii9022-cpi
              - sil,sii9022-tpi
          - const: sil,sii9022
      - const: sil,sii9022

  reg:
    maxItems: 1

  interrupts:
    maxItems: 1
    description: Interrupt line used to inform the host about hotplug events.

  reset-gpios:
    maxItems: 1

  iovcc-supply:
    description: I/O Supply Voltage (1.8V or 3.3V)

  cvcc12-supply:
    description: Digital Core Supply Voltage (1.2V)

  '#sound-dai-cells':
    enum: [ 0, 1 ]
    description: |
      <0> if only i2s or spdif pin is wired,
      <1> if both are wired.
      HDMI audio is configured only if this property is found.
      If HDMI audio is configured the sii902x device becomes an I2S and/or
      spdif audio codec component (e.g. a digital audio sink), that can be used
      in configuring a full audio devices with simple-card or audio-graph-card
      binding. See their binding documents on how to describe the way the
      sii902x device is connected to the rest of the audio system:
      Documentation/devicetree/bindings/sound/simple-card.yaml
      Documentation/devicetree/bindings/sound/audio-graph-card.yaml
      Note: In case of the audio-graph-card binding the used port index should
      be 3.

  sil,i2s-data-lanes:
    $ref: /schemas/types.yaml#/definitions/uint32-array
    minItems: 1
    items:
      - enum: [ 0, 1, 2, 3 ]
      - enum: [ 0, 1, 2, 3 ]
      - enum: [ 0, 1, 2, 3 ]
      - enum: [ 0, 1, 2, 3 ]
    description:
      Each integer indicates which i2s pin is connected to which audio fifo.
      The first integer selects i2s audio pin for the first audio fifo#0 (HDMI
      channels 1&2), second for fifo#1 (HDMI channels 3&4), and so on. There
      are 4 fifos and 4 i2s pins (SD0 - SD3). Any i2s pin can be connected to
      any fifo, but there can be no gaps. E.g. an i2s pin must be mapped to
      fifo#0 and fifo#1 before mapping a channel to fifo#2. Default value is
      <0>, describing SD0 pin being routed to hdmi audio fifo #0.

  clocks:
    maxItems: 1
    description: MCLK input. MCLK can be used to produce HDMI audio CTS values.

  clock-names:
    const: mclk

  ports:
    type: object
    properties:
      port@0:
        type: object
        description: FIXME

      port@1:
        type: object
        description: FIXME

      port@2:
        type: object
        description: FIXME

      port@3:
        type: object
        description: FIXME

required:
  - compatible
  - reg

additionalProperties: false

examples:
  - |
    i2c {
        #address-cells = <1>;
        #size-cells = <0>;

        hdmi-bridge@39 {
            compatible = "sil,sii9022";
            reg = <0x39>;
            reset-gpios = <&pioA 1 0>;
            iovcc-supply = <&v3v3_hdmi>;
            cvcc12-supply = <&v1v2_hdmi>;

            #sound-dai-cells = <0>;
            sil,i2s-data-lanes = < 0 1 2 >;
            clocks = <&mclk>;
            clock-names = "mclk";

            ports {
                #address-cells = <1>;
                #size-cells = <0>;

                port@0 {
                    reg = <0>;
                    bridge_in: endpoint {
                        remote-endpoint = <&dc_out>;
                    };
                };
            };
        };
    };
```

## Documentation/devicetree/bindings/display/bridge/ti,dlpc3433.yaml
```yaml
# SPDX-License-Identifier: (GPL-2.0-only OR BSD-2-Clause)
%YAML 1.2
---
$id: http://devicetree.org/schemas/display/bridge/ti,dlpc3433.yaml#
$schema: http://devicetree.org/meta-schemas/core.yaml#

title: TI DLPC3433 Display Controller

maintainers:
  - Jagan Teki <jagan@amarulasolutions.com>
  - Christopher Vollo <chris@renewoutreach.org>

description: |
  The DLPC3433 or DLPC3438 controllers provide a convenient,
  multi-functional interface between system electronics and
  the DMD, enabling small form factor, low power, and high
  resolution HD displays.

properties:
  compatible:
    enum:
      - ti,dlpc3433

  reg:
    maxItems: 1
    description: virtual channel number of a DSI peripheral

  enable-gpios:
    description: PROJ_EN pin, chip powers up PROJ_EN is high.

  vcc_intf-supply:
    description: A 1.8V/3.3V supply that power the Host I/O.

  vcc_flsh-supply:
    description: A 1.8V/3.3V supply that power the Flash I/O.

  ports:
    $ref: /schemas/graph.yaml#/properties/ports

    properties:
      port@0:
        $ref: /schemas/graph.yaml#/$defs/port-base
        unevaluatedProperties: false
        description: Video port for MIPI DSI input.

        properties:
          endpoint:
            $ref: /schemas/media/video-interfaces.yaml#
            unevaluatedProperties: false

            properties:
              data-lanes:
                description: array of physical DSI data lane indexes.
                minItems: 1
                items:
                  - const: 1
                  - const: 2
                  - const: 3
                  - const: 4

      port@1:
        $ref: /schemas/graph.yaml#/properties/port
        description: Video port for DPI output (DMD Projector).

    required:
      - port@0
      - port@1

required:
  - compatible
  - reg
  - enable-gpios
  - ports

additionalProperties: false

examples:
  - |
    #include <dt-bindings/gpio/gpio.h>

    i2c1 {
        #address-cells = <1>;
        #size-cells = <0>;

        bridge@1d {
            compatible = "ti,dlpc3433";
            reg = <0x1d>;
            enable-gpios = <&gpio2 1 GPIO_ACTIVE_HIGH>;

            ports {
                #address-cells = <1>;
                #size-cells = <0>;

                port@0 {
                    reg = <0>;

                    bridge_in_dsi: endpoint {
                        remote-endpoint = <&dsi_out_bridge>;
                        data-lanes = <1 2 3 4>;
                    };
                };

                port@1 {
                    reg = <1>;

                    bridge_out_panel: endpoint {
                        remote-endpoint = <&panel_out_bridge>;
                    };
                };
            };
        };
    };
```
