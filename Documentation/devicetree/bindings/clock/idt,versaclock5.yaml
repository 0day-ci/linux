## Documentation/devicetree/bindings/clock/ti/ti,clksel.yaml
```yaml
# SPDX-License-Identifier: (GPL-2.0-only OR BSD-2-Clause)
%YAML 1.2
---
$id: http://devicetree.org/schemas/clock/ti/ti,clksel.yaml#
$schema: http://devicetree.org/meta-schemas/core.yaml#

title: Binding for TI clksel clock

maintainers:
  - Tony Lindgren <tony@atomide.com>

description: |
  The TI CLKSEL clocks consist of consist of a mux, divider, multiplier and
  gate bits.

properties:
  compatible:
    const: ti,clksel

  reg:
    maxItems: 1
    description: The CLKSEL register

  "#clock-cells":
    const: 1

required:
  - compatible
  - reg
  - "#clock-cells"

additionalProperties: true

examples:
  - |
    clksel_gfx_fclk: clock@52c {
      compatible = "ti,clksel";
      reg = <0x25c 0x4>;
      #clock-cells = <1>;
    };
...
```

## Documentation/devicetree/bindings/clock/toshiba,tmpv7708-pipllct.yaml
```yaml
# SPDX-License-Identifier: (GPL-2.0-only OR BSD-2-Clause)
%YAML 1.2
---
$id: http://devicetree.org/schemas/clock/toshiba,tmpv7708-pipllct.yaml#
$schema: http://devicetree.org/meta-schemas/core.yaml#

title: Toshiba Visconti5 TMPV7708 PLL Controller Device Tree Bindings

maintainers:
  - Nobuhiro Iwamatsu <nobuhiro1.iwamatsu@toshiba.co.jp>

description:
  Toshia Visconti5 PLL controller which supports the PLLs on TMPV7708.

properties:
  compatible:
    const: toshiba,tmpv7708-pipllct

  reg:
    maxItems: 1

  '#clock-cells':
    const: 1

  osc2-clk-frequency:
    description: Frequency of the OSC2 oscillator.

required:
  - compatible
  - reg
  - "#clock-cells"
  - osc2-clk-frequency

additionalProperties: false

examples:
  - |
    soc {
        #address-cells = <2>;
        #size-cells = <2>;

        pipllct: pipllct@24220000 {
            compatible = "toshiba,tmpv7708-pipllct";
            reg = <0 0x24220000 0 0x820>;
            #clock-cells = <1>;
            osc2-clk-frequency = <20000000>;
        };
    };
...
```

## Documentation/devicetree/bindings/clock/xlnx,zynqmp-clk.yaml
```yaml
# SPDX-License-Identifier: (GPL-2.0 OR BSD-2-Clause)
%YAML 1.2
---
$id: http://devicetree.org/schemas/clock/xlnx,zynqmp-clk.yaml#
$schema: http://devicetree.org/meta-schemas/core.yaml#

title: Xilinx Zynq Ultrascale+ MPSoC clock controller Device Tree Bindings

maintainers:
  - Michal Simek <michal.simek@xilinx.com>

description: |
  The clock controller is a h/w block of Zynq Ultrascale+ MPSoC clock
  tree. It reads required input clock frequencies from the devicetree and acts
  as clock provider for all clock consumers of PS clocks.

properties:
  compatible:
    const: xlnx,zynqmp-clk

  "#clock-cells":
    const: 1

  clocks:
    description: |
      List of clock specifiers which are external input
      clocks to the given clock controller.
    items:
      - description: PS reference clock
      - description: reference clock for video system
      - description: alternative PS reference clock
      - description: auxiliary reference clock
      - description: transceiver reference clock

  clock-names:
    items:
      - const: pss_ref_clk
      - const: video_clk
      - const: pss_alt_ref_clk
      - const: aux_ref_clk
      - const: gt_crx_ref_clk

required:
  - compatible
  - "#clock-cells"
  - clocks
  - clock-names

additionalProperties: false

examples:
  - |
    firmware {
      zynqmp_firmware: zynqmp-firmware {
        zynqmp_clk: clock-controller {
          #clock-cells = <1>;
          compatible = "xlnx,zynqmp-clk";
          clocks = <&pss_ref_clk>, <&video_clk>, <&pss_alt_ref_clk>, <&aux_ref_clk>, <&gt_crx_ref_clk>;
          clock-names = "pss_ref_clk", "video_clk", "pss_alt_ref_clk","aux_ref_clk", "gt_crx_ref_clk";
        };
      };
    };
...
```

## Documentation/devicetree/bindings/crypto/intel,ixp4xx-crypto.yaml
```yaml
# SPDX-License-Identifier: (GPL-2.0 OR BSD-2-Clause)
# Copyright 2018 Linaro Ltd.
%YAML 1.2
---
$id: "http://devicetree.org/schemas/crypto/intel,ixp4xx-crypto.yaml#"
$schema: "http://devicetree.org/meta-schemas/core.yaml#"

title: Intel IXP4xx cryptographic engine

maintainers:
  - Linus Walleij <linus.walleij@linaro.org>

description: |
  The Intel IXP4xx cryptographic engine makes use of the IXP4xx NPE
  (Network Processing Engine). Since it is not a device on its own
  it is defined as a subnode of the NPE, if crypto support is
  available on the platform.

properties:
  compatible:
    const: intel,ixp4xx-crypto

  intel,npe:
    $ref: /schemas/types.yaml#/definitions/uint32
    minimum: 0
    maximum: 3
    description: phandle to the NPE this ethernet instance is using
      and the instance to use in the second cell

  queue-rx:
    $ref: /schemas/types.yaml#/definitions/phandle-array
    maxItems: 1
    description: phandle to the RX queue on the NPE

  queue-txready:
    $ref: /schemas/types.yaml#/definitions/phandle-array
    maxItems: 1
    description: phandle to the TX READY queue on the NPE

required:
  - compatible
  - intel,npe
  - queue-rx
  - queue-txready

additionalProperties: false
```

## Documentation/devicetree/bindings/crypto/nintendo-aes.yaml
```yaml
# SPDX-License-Identifier: GPL-2.0
%YAML 1.2
---
$id: http://devicetree.org/schemas/crypto/nintendo-aes.yaml#
$schema: http://devicetree.org/meta-schemas/core.yaml#

title: Nintendo Wii and Wii U AES engine

maintainers:
  - Emmanuel Gil Peyrot <linkmauve@linkmauve.fr>

description: |+
  The AES engine in the Nintendo Wii and Wii U supports the following:
  -- Advanced Encryption Standard (AES) in CBC mode, with 128-bit keys

properties:
  compatible:
    items:
      - const: nintendo,hollywood-aes
      - const: nintendo,latte-aes

  reg:
    maxItems: 1

  interrupts:
    description: Not supported yet.
    maxItems: 1

required:
  - compatible
  - reg
  - interrupts

additionalProperties: false
```

## Documentation/devicetree/bindings/crypto/qcom-qce.txt
```
Qualcomm crypto engine driver

Required properties:

- compatible  : Supported versions are:
		- "qcom,ipq6018-qce", for ipq6018
		- "qcom,sdm845-qce", for sdm845
		- "qcom,sm8150-qce", for sm8150
		- "qcom,sm8250-qce", for sm8250
		- "qcom,sm8350-qce", for sm8350
- reg         : specifies base physical address and size of the registers map
- dmas        : DMA specifiers for tx and rx dma channels. For more see
                Documentation/devicetree/bindings/dma/dma.txt
- dma-names   : DMA request names should be "rx" and "tx"
- iommus      : phandle to apps_smmu node with sid mask

Optional properties:
- clocks	    : phandle to clock-controller plus clock-specifier pair
- clock-names	    : "iface" clocks register interface
                      "bus" clocks data transfer interface
                      "core" clocks rest of the crypto block
- interconnects	    : Interconnect path between qce crypto and main memory
- interconnect-names: should be "memory"

Example:
	crypto@fd45a000 {
		compatible = "qcom,crypto-v5.1";
		reg = <0xfd45a000 0x6000>;
		clocks = <&gcc GCC_CE2_AHB_CLK>,
			 <&gcc GCC_CE2_AXI_CLK>,
			 <&gcc GCC_CE2_CLK>;
		clock-names = "iface", "bus", "core";
		dmas = <&cryptobam 2>, <&cryptobam 3>;
		dma-names = "rx", "tx";
		interconnects = <&aggre2_noc MASTER_CRYPTO_CORE_0 &mc_virt SLAVE_EBI_CH0>;
		interconnect-names = "memory";
	};
```

## Documentation/devicetree/bindings/crypto/xlnx,zynqmp-sha3.yaml
```yaml
# SPDX-License-Identifier: (GPL-2.0-only OR BSD-2-Clause)
%YAML 1.2
---
$id: http://devicetree.org/schemas/crypto/xlnx,zynqmp-sha3.yaml#
$schema: http://devicetree.org/meta-schemas/core.yaml#

title: Xilinx ZynqMP SHA3 Hardware Accelerator Device Tree Bindings

maintainers:
  - Harsha Harsha<harsha.harsha@xilinx.com>

description: |
  The ZynqMP SHA3 hardened cryptographic accelerator is used to
  calculate the SHA3 hash for the given user data.

properties:
  compatible:
    const: xlnx,zynqmp-sha3-384

required:
  - compatible

additionalProperties: false

examples:
  - |
    xlnx_sha3_384: sha3-384 {
      compatible = "xlnx,zynqmp-sha3-384";
    };
...
```

## Documentation/devicetree/bindings/display/bridge/renesas,dsi.yaml
```yaml
# SPDX-License-Identifier: (GPL-2.0-only OR BSD-2-Clause)
%YAML 1.2
---
$id: http://devicetree.org/schemas/display/bridge/renesas,dsi.yaml#
$schema: http://devicetree.org/meta-schemas/core.yaml#

title: Renesas R-Car MIPI DSI Encoder

maintainers:
  - Biju Das <biju.das.jz@bp.renesas.com>

description: |
  This binding describes the MIPI DSI encoder embedded in the Renesas
  RZ/G2L family of SoC's. The encoder can operate in DSI mode with up
  to four data lanes.

properties:
  compatible:
    enum:
      - renesas,r9a07g044-mipi-dsi    # for RZ/G2L

  reg:
    items:
      - description: Link register
      - description: D-PHY register

  clocks:
    items:
      - description: DSI D-PHY PLL multiplied clock
      - description: DSI D-PHY system clock
      - description: DSI AXI bus clock
      - description: DSI Register access clock
      - description: DSI Video clock
      - description: DSI D_PHY Escape mode Receive clock

  clock-names:
    items:
      - const: pllclk
      - const: sysclk
      - const: aclk
      - const: pclk
      - const: vclk
      - const: lpclk

  power-domains:
    maxItems: 1

  resets:
    items:
      - description: MIPI_DSI_CMN_RSTB
      - description: MIPI_DSI_ARESET_N
      - description: MIPI_DSI_PRESET_N

  reset-names:
    items:
      - const: rst
      - const: arst
      - const: prst

  ports:
    $ref: /schemas/graph.yaml#/properties/ports

    properties:
      port@0:
        $ref: /schemas/graph.yaml#/properties/port
        description: Parallel input port

      port@1:
        $ref: /schemas/graph.yaml#/$defs/port-base
        unevaluatedProperties: false
        description: DSI output port

        properties:
          endpoint:
            $ref: /schemas/media/video-interfaces.yaml#
            unevaluatedProperties: false

            properties:
              data-lanes:
                minItems: 1
                maxItems: 4

            required:
              - data-lanes

    required:
      - port@0
      - port@1

required:
  - compatible
  - reg
  - clocks
  - clock-names
  - power-domains
  - resets
  - reset-names
  - ports

additionalProperties: false

examples:
  - |
    #include <dt-bindings/clock/r9a07g044-cpg.h>

    dsi0: dsi@10860000 {
        compatible = "renesas,r9a07g044-mipi-dsi";
        reg = <0x10860000 0x10000>,
              <0x10850000 0x10000>;
        power-domains = <&cpg>;
        clocks = <&cpg CPG_MOD R9A07G044_MIPI_DSI_PLLCLK>,
                 <&cpg CPG_MOD R9A07G044_MIPI_DSI_SYSCLK>,
                 <&cpg CPG_MOD R9A07G044_MIPI_DSI_ACLK>,
                 <&cpg CPG_MOD R9A07G044_MIPI_DSI_PCLK>,
                 <&cpg CPG_MOD R9A07G044_MIPI_DSI_VCLK>,
                 <&cpg CPG_MOD R9A07G044_MIPI_DSI_LPCLK>;
        clock-names = "pllclk", "sysclk", "aclk", "pclk", "vclk", "lpclk";
        resets = <&cpg R9A07G044_MIPI_DSI_CMN_RSTB>,
                 <&cpg R9A07G044_MIPI_DSI_ARESET_N>,
                 <&cpg R9A07G044_MIPI_DSI_PRESET_N>;
        reset-names = "rst", "arst", "prst";

        ports {
            #address-cells = <1>;
            #size-cells = <0>;

            port@0 {
                reg = <0>;
                dsi0_in: endpoint {
                    remote-endpoint = <&du_out_dsi0>;
                };
            };

            port@1 {
                reg = <1>;
                dsi0_out: endpoint {
                    data-lanes = <1 2 3 4>;
                    remote-endpoint = <&adv7535_in>;
                };
            };
        };
    };
...
```
