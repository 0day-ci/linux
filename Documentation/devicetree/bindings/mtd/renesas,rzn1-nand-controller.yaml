## Documentation/devicetree/bindings/net/dsa/realtek-mdio.txt
```
Realtek MDIO-based Switches
==========================

Realtek MDIO-based switches use MDIO protocol as opposed to Realtek
SMI-based switches. The realtek-mdio driver is an mdio driver and it must
be inserted inside an mdio node.

Required properties:

- compatible: must be exactly one of (same as realtek-smi):
      "realtek,rtl8365mb" (4+1 ports)
      "realtek,rtl8366"               (not supported yet)
      "realtek,rtl8366rb" (4+1 ports)
      "realtek,rtl8366s"  (4+1 ports) (not supported yet)
      "realtek,rtl8367"               (not supported yet)
      "realtek,rtl8367b"              (not supported yet)
      "realtek,rtl8367s"  (5+2 ports)
      "realtek,rtl8368s"  (8 port)    (not supported yet)
      "realtek,rtl8369"               (not supported yet)
      "realtek,rtl8370"   (8 port)    (not supported yet)

Required properties:
- reg: MDIO PHY ID to access the switch

Optional properties:
- realtek,disable-leds: if the LED drivers are not used in the
  hardware design this will disable them so they are not turned on
  and wasting power.

See net/dsa/dsa.txt for a list of additional required and optional properties
and subnodes of DSA switches.

Optional properties of dsa port:

- realtek,ext-int: defines the external interface number (0, 1, 2). By default, 1.

Examples:

An example for the RTL8367S:

&mdio0 {
	switch {
		compatible = "realtek,rtl8367s";
		reg = <29>;

		ports {
			#address-cells = <1>;
			#size-cells = <0>;
			reg = <0>;

			port@0 {
				reg = <0>;
				label = "lan4";
			};

			port@1 {
				reg = <1>;
				label = "lan3";
			};

			port@2 {
				reg = <2>;
				label = "lan2";
			};

			port@3 {
				reg = <3>;
				label = "lan1";
			};

			port@4 {
				reg = <4>;
				label = "wan";
			};

			port@7 {
				reg = <7>;
				ethernet = <&ethernet>;
				phy-mode = "rgmii";
				realtek,ext-int = <2>;
				tx-internal-delay-ps = <2000>;
				rx-internal-delay-ps = <0>;

				fixed-link {
					speed = <1000>;
					full-duplex;
				};
			};
		};
	};
};
```

## Documentation/devicetree/bindings/net/dsa/realtek-smi.yaml
```yaml
# SPDX-License-Identifier: (GPL-2.0-only OR BSD-2-Clause)
%YAML 1.2
---
$id: http://devicetree.org/schemas/net/dsa/realtek-smi.yaml#
$schema: http://devicetree.org/meta-schemas/core.yaml#

title: Realtek SMI-based Switches

allOf:
  - $ref: dsa.yaml#

maintainers:
  - Linus Walleij <linus.walleij@linaro.org>

description:
  The SMI "Simple Management Interface" is a two-wire protocol using
  bit-banged GPIO that while it reuses the MDIO lines MCK and MDIO does
  not use the MDIO protocol. This binding defines how to specify the
  SMI-based Realtek devices. The realtek-smi driver is a platform driver
  and it must be inserted inside a platform node.

properties:
  compatible:
    oneOf:
      - enum:
          - realtek,rtl8365mb
          - realtek,rtl8366
          - realtek,rtl8366rb
          - realtek,rtl8366s
          - realtek,rtl8367
          - realtek,rtl8367b
          - realtek,rtl8368s
          - realtek,rtl8369
          - realtek,rtl8370
    description: |
      realtek,rtl8365mb: 4+1 ports
      realtek,rtl8366:
      realtek,rtl8366rb:
      realtek,rtl8366s: 4+1 ports
      realtek,rtl8367:
      realtek,rtl8367b:
      realtek,rtl8368s: 8 ports
      realtek,rtl8369:
      realtek,rtl8370:  8+2 ports
  reg:
    maxItems: 1

  mdc-gpios:
    description: GPIO line for the MDC clock line.
    maxItems: 1

  mdio-gpios:
    description: GPIO line for the MDIO data line.
    maxItems: 1

  reset-gpios:
    description: GPIO to be used to reset the whole device
    maxItems: 1

  realtek,disable-leds:
    type: boolean
    description: |
      if the LED drivers are not used in the
      hardware design this will disable them so they are not turned on
      and wasting power.

  interrupt-controller:
    type: object
    description: |
      This defines an interrupt controller with an IRQ line (typically
      a GPIO) that will demultiplex and handle the interrupt from the single
      interrupt line coming out of one of the SMI-based chips. It most
      importantly provides link up/down interrupts to the PHY blocks inside
      the ASIC.
    
    properties:

      interrupt-controller:
        description: see interrupt-controller/interrupts.txt

      interrupts:
        description: TODO

      '#address-cells':
        const: 0

      '#interrupt-cells':
        const: 1

    required:
      - interrupt-parent
      - interrupt-controller
      - '#address-cells'
      - '#interrupt-cells'

  mdio:
    type: object
    description:
      This defines the internal MDIO bus of the SMI device, mostly for the
      purpose of being able to hook the interrupts to the right PHY and
      the right PHY to the corresponding port.

    properties:
      compatible:
        const: "realtek,smi-mdio"
      '#address-cells':
        const: 1
      '#size-cells':
        const: 0

    patternProperties:
      "^(ethernet-)?phy@[0-4]$":
        type: object

        allOf:
          - $ref: "http://devicetree.org/schemas/net/mdio.yaml#"

        properties:
          reg:
            maxItems: 1

        required:
          - reg

required:
  - compatible
  - mdc-gpios
  - mdio-gpios
  - reset-gpios

additionalProperties: true

examples:
  - |
    #include <dt-bindings/gpio/gpio.h>
    #include <dt-bindings/interrupt-controller/irq.h>

    switch {
            compatible = "realtek,rtl8366rb";
            /* 22 = MDIO (has input reads), 21 = MDC (clock, output only) */
            mdc-gpios = <&gpio0 21 GPIO_ACTIVE_HIGH>;
            mdio-gpios = <&gpio0 22 GPIO_ACTIVE_HIGH>;
            reset-gpios = <&gpio0 14 GPIO_ACTIVE_LOW>;

            switch_intc1: interrupt-controller {
                    /* GPIO 15 provides the interrupt */
                    interrupt-parent = <&gpio0>;
                    interrupts = <15 IRQ_TYPE_LEVEL_LOW>;
                    interrupt-controller;
                    #address-cells = <0>;
                    #interrupt-cells = <1>;
            };

            ports {
                    #address-cells = <1>;
                    #size-cells = <0>;
                    port@0 {
                            reg = <0>;
                            label = "lan0";
                            phy-handle = <&phy0>;
                    };
                    port@1 {
                            reg = <1>;
                            label = "lan1";
                            phy-handle = <&phy1>;
                    };
                    port@2 {
                            reg = <2>;
                            label = "lan2";
                            phy-handle = <&phy2>;
                    };
                    port@3 {
                            reg = <3>;
                            label = "lan3";
                            phy-handle = <&phy3>;
                    };
                    port@4 {
                            reg = <4>;
                            label = "wan";
                            phy-handle = <&phy4>;
                    };
                    port@5 {
                            reg = <5>;
                            label = "cpu";
                            ethernet = <&gmac0>;
                            phy-mode = "rgmii";
                            fixed-link {
                                    speed = <1000>;
                                    full-duplex;
                            };
                    };
            };

            mdio {
                    compatible = "realtek,smi-mdio";
                    #address-cells = <1>;
                    #size-cells = <0>;

                    phy0: ethernet-phy@0 {
                            reg = <0>;
                            interrupt-parent = <&switch_intc1>;
                            interrupts = <0>;
                    };
                    phy1: ethernet-phy@1 {
                            reg = <1>;
                            interrupt-parent = <&switch_intc1>;
                            interrupts = <1>;
                    };
                    phy2: ethernet-phy@2 {
                            reg = <2>;
                            interrupt-parent = <&switch_intc1>;
                            interrupts = <2>;
                    };
                    phy3: ethernet-phy@3 {
                            reg = <3>;
                            interrupt-parent = <&switch_intc1>;
                            interrupts = <3>;
                    };
                    phy4: ethernet-phy@4 {
                            reg = <4>;
                            interrupt-parent = <&switch_intc1>;
                            interrupts = <12>;
                    };
            };
    };

  - |
    #include <dt-bindings/gpio/gpio.h>
    #include <dt-bindings/interrupt-controller/irq.h>

    switch {
            compatible = "realtek,rtl8365mb";
            mdc-gpios = <&gpio1 16 GPIO_ACTIVE_HIGH>;
            mdio-gpios = <&gpio1 17 GPIO_ACTIVE_HIGH>;
            reset-gpios = <&gpio5 0 GPIO_ACTIVE_LOW>;

            switch_intc2: interrupt-controller {
                    interrupt-parent = <&gpio5>;
                    interrupts = <1 IRQ_TYPE_LEVEL_LOW>;
                    interrupt-controller;
                    #address-cells = <0>;
                    #interrupt-cells = <1>;
            };

            ports {
                    #address-cells = <1>;
                    #size-cells = <0>;
                    port@0 {
                            reg = <0>;
                            label = "swp0";
                            phy-handle = <&ethphy0>;
                    };
                    port@1 {
                            reg = <1>;
                            label = "swp1";
                            phy-handle = <&ethphy1>;
                    };
                    port@2 {
                            reg = <2>;
                            label = "swp2";
                            phy-handle = <&ethphy2>;
                    };
                    port@3 {
                            reg = <3>;
                            label = "swp3";
                            phy-handle = <&ethphy3>;
                    };
                    port@6 {
                            reg = <6>;
                            label = "cpu";
                            ethernet = <&fec1>;
                            phy-mode = "rgmii";
                            tx-internal-delay-ps = <2000>;
                            rx-internal-delay-ps = <2000>;

                            fixed-link {
                                    speed = <1000>;
                                    full-duplex;
                                    pause;
                            };
                    };
            };

            mdio {
                    compatible = "realtek,smi-mdio";
                    #address-cells = <1>;
                    #size-cells = <0>;

                    ethphy0: ethernet-phy@0 {
                            reg = <0>;
                            interrupt-parent = <&switch_intc2>;
                            interrupts = <0>;
                    };
                    ethphy1: ethernet-phy@1 {
                            reg = <1>;
                            interrupt-parent = <&switch_intc2>;
                            interrupts = <1>;
                    };
                    ethphy2: ethernet-phy@2 {
                            reg = <2>;
                            interrupt-parent = <&switch_intc2>;
                            interrupts = <2>;
                    };
                    ethphy3: ethernet-phy@3 {
                            reg = <3>;
                            interrupt-parent = <&switch_intc2>;
                            interrupts = <3>;
                    };
            };
    };
```

## Documentation/devicetree/bindings/net/engleder,tsnep.yaml
```yaml
# SPDX-License-Identifier: (GPL-2.0-only OR BSD-2-Clause)
%YAML 1.2
---
$id: http://devicetree.org/schemas/net/engleder,tsnep.yaml#
$schema: http://devicetree.org/meta-schemas/core.yaml#

title: TSN endpoint Ethernet MAC binding

maintainers:
  - Gerhard Engleder <gerhard@engleder-embedded.com>

allOf:
  - $ref: ethernet-controller.yaml#

properties:
  compatible:
    oneOf:
      - enum:
        - engleder,tsnep

  reg: true
  interrupts: true

  local-mac-address: true
  mac-address: true
  nvmem-cells: true
  nvmem-cells-names: true

  phy-connection-type: true
  phy-mode: true

  phy-handle: true

  '#address-cells':
    description: Number of address cells for the MDIO bus.
    const: 1

  '#size-cells':
    description: Number of size cells on the MDIO bus.
    const: 0

patternProperties:
  "^ethernet-phy@[0-9a-f]$":
    type: object
    $ref: ethernet-phy.yaml#

required:
  - compatible
  - reg
  - interrupts
  - phy-mode
  - phy-handle
  - '#address-cells'
  - '#size-cells'

additionalProperties: false

examples:
  - |
    axi {
        #address-cells = <2>;
        #size-cells = <2>;
        tnsep0: ethernet@a0000000 {
            compatible = "engleder,tsnep";
            reg = <0x0 0xa0000000 0x0 0x10000>;
            interrupts = <0 89 1>;
            interrupt-parent = <&gic>;
            local-mac-address = [00 00 00 00 00 00];
            phy-mode = "rgmii";
            phy-handle = <&phy0>;
            #address-cells = <1>;
            #size-cells = <0>;
            phy0: ethernet-phy@1 {
                reg = <1>;
            };
        };
    };
```

## Documentation/devicetree/bindings/net/hpe,gxp-umac-mdio.txt
```
* HPE GXP UMAC MDIO Interface Controller

Required properties:
- compatible: Must contain "hpe,gxp-umac-mdio".
- reg:  Specifies base physical address and size of the registers.
- interrupts: The interrupt number.
- Cells which are configuring the external phy interfaces. Numbered through relative addressing each phy is compatible with a standard ethernet-phy-ieee802.3 phy.

Example:

	mdio0: mdio@c0004080 {
		compatible = "hpe,gxp-umac-mdio";
		reg = <0xc0004080 0x10>;
		#address-cells = <1>;
		#size-cells = <0>;
		ext_phy0: ethernt-phy@0 {
			compatible = "ethernet-phy-ieee802.3-c22";
			phy-mode = "sgmii";
			reg = <0>;
		};
	};
```

## Documentation/devicetree/bindings/net/hpe,gxp-umac.txt
```
* HPE GXP UMAC Controller

Required properties:
- compatible: Must contain "hpe,gxp-umac".
- reg:  Specifies base physical address and size of the registers.
- interrupts: The interrupt number.
- interrupt-parent: specify main interrupt controller handler
- phy-handle: Phandle to a PHY on the MDIO bus.
- int-phy-handle: Phandle to PHY interrupt handler.

Example:

	umac0: umac@c0004000 {
		compatible = "hpe,gxp-umac";
		reg = <0xc0004000 0x80>;
		interrupts = <10>;
		interrupt-parent = <&vic0>;
		phy-handle = <&ext_phy0>;
		int-phy-handle = <&int_phy0>;
	};
```
