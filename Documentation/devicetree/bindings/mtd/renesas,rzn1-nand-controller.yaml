## Documentation/devicetree/bindings/net/idt,3243x-emac.yaml
```yaml
# SPDX-License-Identifier: GPL-2.0-only OR BSD-2-Clause
%YAML 1.2
---
$id: http://devicetree.org/schemas/net/idt,3243x-emac.yaml#
$schema: http://devicetree.org/meta-schemas/core.yaml#

title: IDT 79rc3243x Ethernet controller

description: Ethernet controller integrated into IDT 79RC3243x family SoCs

maintainers:
  - Thomas Bogendoerfer <tsbogend@alpha.franken.de>

allOf:
  - $ref: ethernet-controller.yaml#

properties:
  compatible:
    const: idt,3243x-emac

  reg:
    maxItems: 3

  reg-names:
    items:
      - const: korina_regs
      - const: korina_dma_rx
      - const: korina_dma_tx

  interrupts:
    items:
      - description: RX interrupt
      - description: TX interrupt

  interrupt-names:
    items:
      - const: korina_rx
      - const: korina_tx

  clocks:
    maxItems: 1

  clock-names:
    items:
      - const: mdioclk

required:
  - compatible
  - reg
  - reg-names
  - interrupts
  - interrupt-names

additionalProperties: false

examples:
  - |

    ethernet@60000 {
        compatible = "idt,3243x-emac";

        reg = <0x60000 0x10000>,
              <0x40000 0x14>,
              <0x40014 0x14>;
        reg-names = "korina_regs",
                    "korina_dma_rx",
                    "korina_dma_tx";

        interrupts-extended = <&rcpic3 0>, <&rcpic3 1>;
        interrupt-names = "korina_rx", "korina_tx";

        clocks = <&iclk>;
        clock-names = "mdioclk";
    };
```

## Documentation/devicetree/bindings/net/intel,ixp4xx-ethernet.yaml
```yaml
# SPDX-License-Identifier: (GPL-2.0 OR BSD-2-Clause)
# Copyright 2018 Linaro Ltd.
%YAML 1.2
---
$id: "http://devicetree.org/schemas/net/intel,ixp4xx-ethernet.yaml#"
$schema: "http://devicetree.org/meta-schemas/core.yaml#"

title: Intel IXP4xx ethernet

allOf:
  - $ref: "ethernet-controller.yaml#"

maintainers:
  - Linus Walleij <linus.walleij@linaro.org>

description: |
  The Intel IXP4xx ethernet makes use of the IXP4xx NPE (Network
  Processing Engine) and the IXP4xx Queue Mangager to process
  the ethernet frames. It can optionally contain an MDIO bus to
  talk to PHYs.

properties:
  compatible:
    const: intel,ixp4xx-ethernet

  reg:
    maxItems: 1
    description: Ethernet MMIO address range

  queue-rx:
    $ref: '/schemas/types.yaml#/definitions/phandle-array'
    maxItems: 1
    description: phandle to the RX queue on the NPE

  queue-txready:
    $ref: '/schemas/types.yaml#/definitions/phandle-array'
    maxItems: 1
    description: phandle to the TX READY queue on the NPE

  phy-mode: true

  phy-handle: true

  intel,npe:
    $ref: /schemas/types.yaml#/definitions/uint32
    enum: [0, 1, 2, 3]
    description: which NPE (Network Processing Engine) this ethernet
      instance is using

  mdio:
    type: object
    $ref: "mdio.yaml#"
    description: optional node for embedded MDIO controller

required:
  - compatible
  - reg
  - queue-rx
  - queue-txready

additionalProperties: false

examples:
  - |
    ethernet@c8009000 {
      compatible = "intel,ixp4xx-ethernet";
      reg = <0xc8009000 0x1000>;
      status = "disabled";
      queue-rx = <&qmgr 3>;
      queue-txready = <&qmgr 20>;
      intel,npe = <1>;
      phy-mode = "rgmii";
      phy-handle = <&phy1>;

      mdio {
        #address-cells = <1>;
        #size-cells = <0>;
        phy1: ethernet-phy@1 {
          reg = <1>;
        };
      };
    };
```

## Documentation/devicetree/bindings/net/intel,ixp4xx-hss.yaml
```yaml
# SPDX-License-Identifier: (GPL-2.0 OR BSD-2-Clause)
# Copyright 2021 Linaro Ltd.
%YAML 1.2
---
$id: "http://devicetree.org/schemas/net/intel,ixp4xx-hss.yaml#"
$schema: "http://devicetree.org/meta-schemas/core.yaml#"

title: Intel IXP4xx V.35 WAN High Speed Serial Link (HSS)

maintainers:
  - Linus Walleij <linus.walleij@linaro.org>

description: |
  The Intel IXP4xx HSS makes use of the IXP4xx NPE (Network
  Processing Engine) and the IXP4xx Queue Manager to process
  V.35 Wideband Modem (WAN) links.

properties:
  compatible:
    const: intel,ixp4xx-hss

  reg:
    maxItems: 1
    description: The HSS instance

  intel,npe-handle:
    $ref: '/schemas/types.yaml#/definitions/phandle-array'
    maxItems: 1
    description: phandle to the NPE this HSS instance is using
      and the instance to use in the second cell

  queue-chl-rxtrig:
    $ref: '/schemas/types.yaml#/definitions/phandle-array'
    maxItems: 1
    description: phandle to the RX trigger queue on the NPE

  queue-pkt-rx:
    $ref: '/schemas/types.yaml#/definitions/phandle-array'
    maxItems: 1
    description: phandle to the packet RX queue on the NPE

  queue-pkt-tx0:
    $ref: '/schemas/types.yaml#/definitions/phandle-array'
    maxItems: 1
    description: phandle to the packet TX0 queue on the NPE

  queue-pkt-tx1:
    $ref: '/schemas/types.yaml#/definitions/phandle-array'
    maxItems: 1
    description: phandle to the packet TX1 queue on the NPE

  queue-pkt-tx2:
    $ref: '/schemas/types.yaml#/definitions/phandle-array'
    maxItems: 1
    description: phandle to the packet TX2 queue on the NPE

  queue-pkt-tx3:
    $ref: '/schemas/types.yaml#/definitions/phandle-array'
    maxItems: 1
    description: phandle to the packet TX3 queue on the NPE

  queue-pkt-rxfree0:
    $ref: '/schemas/types.yaml#/definitions/phandle-array'
    maxItems: 1
    description: phandle to the packet RXFREE0 queue on the NPE

  queue-pkt-rxfree1:
    $ref: '/schemas/types.yaml#/definitions/phandle-array'
    maxItems: 1
    description: phandle to the packet RXFREE1 queue on the NPE

  queue-pkt-rxfree2:
    $ref: '/schemas/types.yaml#/definitions/phandle-array'
    maxItems: 1
    description: phandle to the packet RXFREE2 queue on the NPE

  queue-pkt-rxfree3:
    $ref: '/schemas/types.yaml#/definitions/phandle-array'
    maxItems: 1
    description: phandle to the packet RXFREE3 queue on the NPE

  queue-pkt-txdone:
    $ref: '/schemas/types.yaml#/definitions/phandle-array'
    maxItems: 1
    description: phandle to the packet TXDONE queue on the NPE

  cts-gpios:
    maxItems: 1
    description: Clear To Send (CTS) GPIO line

  rts-gpios:
    maxItems: 1
    description: Ready To Send (RTS) GPIO line

  dcd-gpios:
    maxItems: 1
    description: Data Carrier Detect (DCD) GPIO line

  dtr-gpios:
    maxItems: 1
    description: Data Terminal Ready (DTR) GPIO line

  clk-internal-gpios:
    maxItems: 1
    description: Clock internal GPIO line, driving this high will make the HSS
      use internal clocking as opposed to external clocking

required:
  - compatible
  - reg
  - intel,npe-handle
  - queue-chl-rxtrig
  - queue-pkt-rx
  - queue-pkt-tx0
  - queue-pkt-tx1
  - queue-pkt-tx2
  - queue-pkt-tx3
  - queue-pkt-rxfree0
  - queue-pkt-rxfree1
  - queue-pkt-rxfree2
  - queue-pkt-rxfree3
  - queue-pkt-txdone
  - cts-gpios
  - rts-gpios
  - dcd-gpios
  - dtr-gpios
  - clk-internal-gpios

additionalProperties: false
```

## Documentation/devicetree/bindings/net/litex,liteeth.yaml
```yaml
# SPDX-License-Identifier: GPL-2.0-or-later OR BSD-2-Clause
%YAML 1.2
---
$id: http://devicetree.org/schemas/net/litex,liteeth.yaml#
$schema: http://devicetree.org/meta-schemas/core.yaml#

title: LiteX LiteETH ethernet device

maintainers:
  - Joel Stanley <joel@jms.id.au>

description: |
  LiteETH is a small footprint and configurable Ethernet core for FPGA based
  system on chips.

  The hardware source is Open Source and can be found on at
  https://github.com/enjoy-digital/liteeth/.

properties:
  compatible:
    const: litex,liteeth

  reg:
    minItems: 3
    items:
      - description: MAC registers
      - description: MDIO registers
      - description: Packet buffer

  interrupts:
    maxItems: 1

  rx-fifo-depth:
    description: Receive FIFO size, in units of 2048 bytes

  tx-fifo-depth:
    description: Transmit FIFO size, in units of 2048 bytes

  mac-address:
    description: MAC address to use

required:
  - compatible
  - reg
  - interrupts

additionalProperties: false

examples:
  - |
    mac: ethernet@8020000 {
        compatible = "litex,liteeth";
        reg = <0x8021000 0x100
               0x8020800 0x100
               0x8030000 0x2000>;
        rx-fifo-depth = <2>;
        tx-fifo-depth = <2>;
        interrupts = <0x11 0x1>;
    };
...

#  vim: set ts=2 sw=2 sts=2 tw=80 et cc=80 ft=yaml :
```

## Documentation/devicetree/bindings/net/macb.txt
```
* Cadence MACB/GEM Ethernet controller

Required properties:
- compatible: Should be "cdns,[<chip>-]{macb|gem}"
  Use "cdns,at91rm9200-emac" Atmel at91rm9200 SoC.
  Use "cdns,at91sam9260-macb" for Atmel at91sam9 SoCs.
  Use "cdns,sam9x60-macb" for Microchip sam9x60 SoC.
  Use "cdns,np4-macb" for NP4 SoC devices.
  Use "cdns,at32ap7000-macb" for other 10/100 usage or use the generic form: "cdns,macb".
  Use "atmel,sama5d2-gem" for the GEM IP (10/100) available on Atmel sama5d2 SoCs.
  Use "atmel,sama5d29-gem" for GEM XL IP (10/100) available on Atmel sama5d29 SoCs.
  Use "atmel,sama5d3-macb" for the 10/100Mbit IP available on Atmel sama5d3 SoCs.
  Use "atmel,sama5d3-gem" for the Gigabit IP available on Atmel sama5d3 SoCs.
  Use "atmel,sama5d4-gem" for the GEM IP (10/100) available on Atmel sama5d4 SoCs.
  Use "cdns,zynq-gem" Xilinx Zynq-7xxx SoC.
  Use "cdns,zynqmp-gem" for Zynq Ultrascale+ MPSoC.
  Use "sifive,fu540-c000-gem" for SiFive FU540-C000 SoC.
  Use "microchip,sama7g5-emac" for Microchip SAMA7G5 ethernet interface.
  Use "microchip,sama7g5-gem" for Microchip SAMA7G5 gigabit ethernet interface.
  Or the generic form: "cdns,emac".
- reg: Address and length of the register set for the device
	For "sifive,fu540-c000-gem", second range is required to specify the
	address and length of the registers for GEMGXL Management block.
- interrupts: Should contain macb interrupt
- phy-mode: See ethernet.txt file in the same directory.
- clock-names: Tuple listing input clock names.
	Required elements: 'pclk', 'hclk'
	Optional elements: 'tx_clk'
	Optional elements: 'rx_clk' applies to cdns,zynqmp-gem
	Optional elements: 'tsu_clk'
- clocks: Phandles to input clocks.
- phy_names, phys: Required with ZynqMP SoC when in SGMII mode.
                   phy_names should be "sgmii-phy" and phys should
                   reference PS-GTR generic PHY device for this controller
                   instance. See ZynqMP example below.
- resets, reset-names: Recommended with ZynqMP, specify reset control for this
		       controller instance with zynqmp-reset driver.

Optional properties:
- mdio: node containing PHY children. If this node is not present, then PHYs
        will be direct children.

The MAC address will be determined using the optional properties
defined in ethernet.txt.

Optional properties for PHY child node:
- reset-gpios : Should specify the gpio for phy reset
- magic-packet : If present, indicates that the hardware supports waking
  up via magic packet.
- phy-handle : see ethernet.txt file in the same directory

Examples:

	macb0: ethernet@fffc4000 {
		compatible = "cdns,at32ap7000-macb";
		reg = <0xfffc4000 0x4000>;
		interrupts = <21>;
		phy-mode = "rmii";
		local-mac-address = [3a 0e 03 04 05 06];
		clock-names = "pclk", "hclk", "tx_clk";
		clocks = <&clkc 30>, <&clkc 30>, <&clkc 13>;
		ethernet-phy@1 {
			reg = <0x1>;
			reset-gpios = <&pioE 6 1>;
		};
	};

	gem1: ethernet@ff0c0000 {
		compatible = "cdns,zynqmp-gem", "cdns,gem";
		interrupt-parent = <&gic>;
		interrupts = <0 59 4>, <0 59 4>;
		reg = <0x0 0xff0c0000 0x0 0x1000>;
		clocks = <&zynqmp_clk LPD_LSBUS>, <&zynqmp_clk GEM1_REF>,
			 <&zynqmp_clk GEM1_TX>, <&zynqmp_clk GEM1_RX>,
			 <&zynqmp_clk GEM_TSU>;
		clock-names = "pclk", "hclk", "tx_clk", "rx_clk", "tsu_clk";
		#address-cells = <1>;
		#size-cells = <0>;
		#stream-id-cells = <1>;
		iommus = <&smmu 0x875>;
		power-domains = <&zynqmp_firmware PD_ETH_1>;
		resets = <&zynqmp_reset ZYNQMP_RESET_GEM1>;
		reset-names = "gem1_rst";
		status = "okay";
		phy-mode = "sgmii";
		phy-names = "sgmii-phy";
		phys = <&psgtr 1 PHY_TYPE_SGMII 1 1>;
		fixed-link {
			speed = <1000>;
			full-duplex;
			pause;
		};
	};
```

## Documentation/devicetree/bindings/net/mctp-i2c-generic.yaml
```yaml
# SPDX-License-Identifier: (GPL-2.0-only OR BSD-2-Clause)
%YAML 1.2
---
$id: http://devicetree.org/schemas/net/mctp-i2c-generic.yaml#
$schema: http://devicetree.org/meta-schemas/core.yaml#

title: Generic MCTP I2C transport binding

maintainers:
  - Matt Johnston <matt@codeconstruct.com.au>

description:
  An mctp-i2c-generic controller defines an MCTP endpoint on an existing I2C
  controller. MCTP I2C is specified by DMTF DSP0237.

  An mctp-i2c-generic controller must be attached to an I2C controller
  which supports slave functionality. Subordinate busses in a mux topology
  can be attached to the same mctp-i2c-generic controller with the bus-attach
  property. These will be presented to the host system as separate MCTP I2C
  instances.

properties:
  compatible:
    const: mctp-i2c-generic

  reg:
    maxItems: 1
    description:
      7 bit I2C address of the endpoint.
      I2C_OWN_SLAVE_ADDRESS flag must be set (described in i2c.txt)

  bus-attach:
    $ref: "/schemas/types.yaml#/definitions/phandle-array"
    description: |
      List of phandles of I2C busses to attach to. All busses must
      be in the same mux topology as the node's parent I2C controller.

      If no bus-attach property is specified then only the direct parent
      I2C bus is attached. Otherwise to include a direct parent bus it
      must be included in the bus-attach list if needed.

additionalProperties: false

required:
  - compatible
  - reg

examples:
  - |
    #include <dt-bindings/i2c/i2c.h>

    // simple attaching to a root adapter i2c0
    i2c0: i2cbus0 {
        #address-cells = <1>;
        #size-cells = <0>;

        mctp@50 {
            compatible = "mctp-i2c";
            reg = <(0x50 | I2C_OWN_SLAVE_ADDRESS)>;
        };
    };

    // attaching to a root adapter i2c5 and a child mux bus i2c14
    i2c5: i2cbus5 {
        #address-cells = <1>;
        #size-cells = <0>;

        mctp@50 {
            compatible = "mctp-i2c";
            reg = <(0x50 | I2C_OWN_SLAVE_ADDRESS)>;
            attach-bus = <&i2c5 &i2c14>;
        };
    };

    i2cmux0 {
      compatible = "i2c-mux";
      #address-cells = <1>;
      #size-cells = <0>;
      i2c-parent = <&i2c5>;
      mux-controls = <&mux>;

      i2c14: i2c@0 {
        reg = <0>;
      };

      i2c15: i2c@1 {
        reg = <1>;
      };
    };
```
