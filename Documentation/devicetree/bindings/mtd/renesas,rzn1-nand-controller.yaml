## Documentation/devicetree/bindings/net/mctp-i2c.yaml
```yaml
# SPDX-License-Identifier: (GPL-2.0-only OR BSD-2-Clause)
%YAML 1.2
---
$id: http://devicetree.org/schemas/net/mctp-i2c.yaml#
$schema: http://devicetree.org/meta-schemas/core.yaml#

title: MCTP I2C transport binding

maintainers:
  - Matt Johnston <matt@codeconstruct.com.au>

description:
  The MCTP I2C binding defines an MCTP endpoint on the I2C bus to
  communicate with I2C peripherals using MCTP (DMTF specification DSP0237).
  A single binding node can attach to multiple child busses in a mux topology.
  An mctp-i2c node's parent must be a hardware bus adapter which supports
  slave functionality. The reg address must include I2C_OWN_SLAVE_ADDRESS.

properties:
  compatible:
    const: mctp-i2c

  reg:
    maxItems: 1

  bus-attach:
    $ref: "/schemas/types.yaml#/definitions/phandle-array"
    description: |
      List of phandles of I2C busses to attach to. I2C mux busses may only
      be attached to an mctp-i2c binding on their parent root adapter in the
      mux topology.
      If no bus-attach property is specified then only the direct parent
      I2C bus is attached. Otherwise to include a direct parent bus it
      must be included in the bus-attach list if needed.


additionalProperties: true

required:
  - compatible
  - reg

examples:
  - |
    #include <dt-bindings/i2c/i2c.h>

    // simple attaching to a root adapter i2c0
    i2c0: i2cbus0 {
        #address-cells = <1>;
        #size-cells = <0>;

        mctp@50 {
            compatible = "mctp-i2c";
            reg = <(0x50 | I2C_OWN_SLAVE_ADDRESS)>;
        };
    };

    // attaching to a root adapter i2c5 and a child mux bus i2c14
    i2c5: i2cbus5 {
        #address-cells = <1>;
        #size-cells = <0>;

        mctp@50 {
            compatible = "mctp-i2c";
            reg = <(0x50 | I2C_OWN_SLAVE_ADDRESS)>;
            attach-bus = <&i2c5 &i2c14>;
        };
    };

    i2cmux0 {
      compatible = "i2c-mux-gpio";
      #address-cells = <1>;
      #size-cells = <0>;
      i2c-parent = <&i2c0>;
      i2c14: i2c@5 {
        reg = <0>;
      };
    };
```

## Documentation/devicetree/bindings/net/mdio-gpio.yaml
```yaml
# SPDX-License-Identifier: (GPL-2.0-only OR BSD-2-Clause)
%YAML 1.2
---
$id: http://devicetree.org/schemas/net/mdio-gpio.yaml#
$schema: http://devicetree.org/meta-schemas/core.yaml#

title: MDIO on GPIOs

maintainers:
  - Andrew Lunn <andrew@lunn.ch>
  - Florian Fainelli <f.fainelli@gmail.com>
  - Heiner Kallweit <hkallweit1@gmail.com>

allOf:
  - $ref: "mdio.yaml#"

properties:
  compatible:
    enum:
      - virtual,mdio-gpio
      - microchip,mdio-smi0

  "#address-cells":
    const: 1

  "#size-cells":
    const: 0

  gpios:
    minItems: 2
    description: |
      MDC and MDIO lines connected to GPIO controllers are listed in
      the gpios property as described in section VIII.1 in the
      following order: MDC, MDIO.

#Note: Each gpio-mdio bus should have an alias correctly numbered in "aliases"
#node.
unevaluatedProperties: false

examples:
  - |
    aliases {
        mdio-gpio0 = &mdio0;
    };

    mdio0: mdio {
      compatible = "virtual,mdio-gpio";
      #address-cells = <1>;
      #size-cells = <0>;
      gpios = <&qe_pio_a 11
               &qe_pio_c 6>;
      ethphy0: ethernet-phy@0 {
        reg = <0>;
      };
    };
...
```

## Documentation/devicetree/bindings/net/mscc,vsc7514-switch.yaml
```yaml
# SPDX-License-Identifier: GPL-2.0-only OR BSD-2-Clause
%YAML 1.2
---
$id: http://devicetree.org/schemas/net/mscc,vsc7514-switch.yaml#
$schema: http://devicetree.org/meta-schemas/core.yaml#

title: Microchip VSC7514 Ethernet switch controller

maintainers:
  - Vladimir Oltean <vladimir.oltean@nxp.com>
  - Claudiu Manoil <claudiu.manoil@nxp.com>
  - Alexandre Belloni <alexandre.belloni@bootlin.com>

description: |
  The VSC7514 Industrial IoT Ethernet switch contains four integrated dual media
  10/100/1000BASE-T PHYs, two 1G SGMII/SerDes, two 1G/2.5G SGMII/SerDes, and an
  option for either a 1G/2.5G SGMII/SerDes Node Processor Interface (NPI) or a
  PCIe interface for external CPU connectivity. The NPI/PCIe can operate as a
  standard Ethernet port.

  The device provides a rich set of Industrial Ethernet switching features such
  as fast protection switching, 1588 precision time protocol, and synchronous
  Ethernet. Advanced TCAM-based VLAN and QoS processing enable delivery of
  differentiated services. Security is assured through frame processing using
  Microsemi’s TCAM-based Versatile Content Aware Processor.

  In addition, the device contains a powerful 500 MHz CPU enabling full
  management of the switch.

properties:
  $nodename:
    pattern: "^switch@[0-9a-f]+$"

  compatible:
    const: mscc,vsc7514-switch

  reg:
    items:
      - description: system target
      - description: rewriter target
      - description: qs target
      - description: PTP target
      - description: Port0 target
      - description: Port1 target
      - description: Port2 target
      - description: Port3 target
      - description: Port4 target
      - description: Port5 target
      - description: Port6 target
      - description: Port7 target
      - description: Port8 target
      - description: Port9 target
      - description: Port10 target
      - description: QSystem target
      - description: Analyzer target
      - description: S0 target
      - description: S1 target
      - description: S2 target
      - description: fdma target

  reg-names:
    items:
      - const: sys
      - const: rew
      - const: qs
      - const: ptp
      - const: port0
      - const: port1
      - const: port2
      - const: port3
      - const: port4
      - const: port5
      - const: port6
      - const: port7
      - const: port8
      - const: port9
      - const: port10
      - const: qsys
      - const: ana
      - const: s0
      - const: s1
      - const: s2
      - const: fdma

  interrupts:
    minItems: 1
    items:
      - description: PTP ready
      - description: register based extraction
      - description: frame dma based extraction

  interrupt-names:
    minItems: 1
    items:
      - const: ptp_rdy
      - const: xtr
      - const: fdma

  mac-address: true

  ethernet-ports:
    type: object
    patternProperties:
      "^port@[0-9a-f]+$":
        type: object

        properties:
          '#address-cells':
            const: 1
          '#size-cells':
            const: 0

          reg:
            description: Switch port number

          phy-handle:
            description:
              phandle of a Ethernet PHY.  This is optional and if provided it
              points to the cuPHY used by the Ethernet SerDes.

        required:
          - reg
          - phy-handle

required:
  - compatible
  - reg
  - reg-names
  - interrupts
  - interrupt-names
  - ethernet-ports

additionalProperties: false

examples:
  - |
    switch@1010000 {
      compatible = "mscc,vsc7514-switch";
      reg = <0x1010000 0x10000>,
            <0x1030000 0x10000>,
            <0x1080000 0x100>,
            <0x10e0000 0x10000>,
            <0x11e0000 0x100>,
            <0x11f0000 0x100>,
            <0x1200000 0x100>,
            <0x1210000 0x100>,
            <0x1220000 0x100>,
            <0x1230000 0x100>,
            <0x1240000 0x100>,
            <0x1250000 0x100>,
            <0x1260000 0x100>,
            <0x1270000 0x100>,
            <0x1280000 0x100>,
            <0x1800000 0x80000>,
            <0x1880000 0x10000>,
            <0x1040000 0x10000>,
            <0x1050000 0x10000>,
            <0x1060000 0x10000>,
            <0x1a0 0x1c4>;
      reg-names = "sys", "rew", "qs", "ptp", "port0", "port1",
            "port2", "port3", "port4", "port5", "port6",
            "port7", "port8", "port9", "port10", "qsys",
            "ana", "s0", "s1", "s2", "fdma";
      interrupts = <18 21 16>;
      interrupt-names = "ptp_rdy", "xtr", "fdma";

      ethernet-ports {
        #address-cells = <1>;
        #size-cells = <0>;

        port0: port@0 {
          reg = <0>;
          phy-handle = <&phy0>;
        };
        port1: port@1 {
          reg = <1>;
          phy-handle = <&phy1>;
        };
      };
    };

...
#  vim: set ts=2 sw=2 sts=2 tw=80 et cc=80 ft=yaml :
```

## Documentation/devicetree/bindings/net/realtek,rtl8152.yaml
```yaml
# SPDX-License-Identifier: GPL-2.0-only OR BSD-2-Clause
%YAML 1.2
---
$id: http://devicetree.org/schemas/net/realtek,rtl8152.yaml#
$schema: http://devicetree.org/meta-schemas/core.yaml#

title: Realtek RTL8152/RTL8153 series USB ethernet

maintainers:
  - David Bauer <mail@david-bauer.net>

properties:
  compatible:
    oneOf:
      - items:
          - enum:
              - realtek,rtl8152
              - realtek,rtl8153

  reg:
    description: The device number on the USB bus

  realtek,led-data:
    $ref: /schemas/types.yaml#/definitions/uint32
    description: Value to be written to the LED configuration register.

required:
  - compatible
  - reg

examples:
  - |
    usb@100 {
      reg = <0x100 0x100>;
      #address-cells = <1>;
      #size-cells = <0>;

      usb-eth@2 {
        compatible = "realtek,rtl8153";
        reg = <0x2>;
        realtek,led-data = <0x87>;
      };
    };
```
