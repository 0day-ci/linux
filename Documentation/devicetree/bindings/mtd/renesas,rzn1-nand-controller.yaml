## Documentation/devicetree/bindings/net/dsa/nxp,sja1105.yaml
```yaml
# SPDX-License-Identifier: (GPL-2.0-only OR BSD-2-Clause)
%YAML 1.2
---
$id: http://devicetree.org/schemas/net/dsa/nxp,sja1105.yaml#
$schema: http://devicetree.org/meta-schemas/core.yaml#

title: NXP SJA1105 Automotive Ethernet Switch Family Device Tree Bindings

description:
  The SJA1105 SPI interface requires a CS-to-CLK time (t2 in UM10944.pdf) of at
  least one half of t_CLK. At an SPI frequency of 1MHz, this means a minimum
  cs_sck_delay of 500ns. Ensuring that this SPI timing requirement is observed
  depends on the SPI bus master driver.

allOf:
  - $ref: "dsa.yaml#"

maintainers:
  - Vladimir Oltean <vladimir.oltean@nxp.com>

properties:
  compatible:
    oneOf:
      - enum:
          - nxp,sja1105e
          - nxp,sja1105t
          - nxp,sja1105p
          - nxp,sja1105q
          - nxp,sja1105r
          - nxp,sja1105s

  reg:
    maxItems: 1

patternProperties:
  "^(ethernet-)?ports$":
    type: object

    patternProperties:
      "^(ethernet-)?port@[0-9]+$":
        type: object
        properties:

          # By default (unless otherwise specified) a port is configured as MAC
          # if it is driving a PHY (phy-handle is present) or as PHY if it is
          # PHY-less (fixed-link specified, presumably because it is connected
          # to a MAC). It is suggested to not use these bindings unless an
          # explicit override is necessary (for example, if SJA1105 ports are at
          # both ends of a MII/RMII PHY-less setup. In that case, one end would
          # need to have sja1105,role-mac, and the other sja1105,role-phy).
          sja1105,role-mac:
            $ref: /schemas/types.yaml#/definitions/flag
            description:
                Specifies whether the SJA1105 port is a clock source or sink
                for this interface, according to the applicable standard
                (applicable for MII and RMII, but not applicable for RGMII
                where there are separate TX and RX clocks). In the case of
                RGMII it affects the behavior regarding internal delays.
                If the port is configured in the role of an RGMII MAC, it will
                let the PHY apply internal RGMII delays according to the
                phy-mode property, otherwise it will apply the delays itself.

          sja1105,role-phy:
            $ref: /schemas/types.yaml#/definitions/flag
            description:
                See sja1105,role-mac.

required:
  - compatible
  - reg

unevaluatedProperties: false

examples:
  - |
    spi {
        #address-cells = <1>;
        #size-cells = <0>;

        ethernet-switch@1 {
            reg = <0x1>;
            #address-cells = <1>;
            #size-cells = <0>;
            compatible = "nxp,sja1105t";

            ethernet-ports {
                #address-cells = <1>;
                #size-cells = <0>;

                port@0 {
                    phy-handle = <&rgmii_phy6>;
                    phy-mode = "rgmii-id";
                    reg = <0>;
                    /* Implicit "sja1105,role-mac;" */
                };

                port@1 {
                    phy-handle = <&rgmii_phy3>;
                    phy-mode = "rgmii-id";
                    reg = <1>;
                    /* Implicit "sja1105,role-mac;" */
                };

                port@2 {
                    phy-handle = <&rgmii_phy4>;
                    phy-mode = "rgmii-id";
                    reg = <2>;
                    /* Implicit "sja1105,role-mac;" */
                };

                port@3 {
                    phy-mode = "rgmii-id";
                    reg = <3>;
                };

                port@4 {
                    ethernet = <&enet2>;
                    phy-mode = "rgmii";
                    reg = <4>;
                    /* Implicit "sja1105,role-phy;" */

                    fixed-link {
                        speed = <1000>;
                        full-duplex;
                    };
                };
            };
        };
    };
```

## Documentation/devicetree/bindings/net/dsa/qca8k.txt
```
* Qualcomm Atheros QCA8xxx switch family

Required properties:

- compatible: should be one of:
    "qca,qca8327"
    "qca,qca8334"
    "qca,qca8337"

- #size-cells: must be 0
- #address-cells: must be 1

Optional properties:

- reset-gpios: GPIO to be used to reset the whole device

Subnodes:

The integrated switch subnode should be specified according to the binding
described in dsa/dsa.txt. If the QCA8K switch is connect to a SoC's external
mdio-bus each subnode describing a port needs to have a valid phandle
referencing the internal PHY it is connected to. This is because there's no
N:N mapping of port and PHY id.
To declare the internal mdio-bus configuration, declare a mdio node in the
switch node and declare the phandle for the port referencing the internal
PHY is connected to. In this config a internal mdio-bus is registered and
the mdio MASTER is used as communication.

Don't use mixed external and internal mdio-bus configurations, as this is
not supported by the hardware.

A leds subnode can be declared to configure leds port behaviour.
The leds subnode must declare the port with the mdio reg that will have the
attached led. Each port can have a max of 3 different leds. (Refer to example)
A led can have 4 different settings:
- Always off
- Always on
- Blink at 4hz
- Hw_mode: This special mode follow control_rule rules and blink based on switch
event.
A sysfs entry for control_rule and hw_mode is provided for each led.
Control rule for phy0-3 are shared and refer to the same reg. That means that
phy0-3 will blink based on the same rules. Phy4 have its dedicated control_rules.

Each led can have the following binding:
The binding "default-state" can be declared to set them off by default or to
follow leds control_rule using the keep value. By default hw_mode is set as it's
the default switch setting.
The binding "qca,led_rules" can be used to declare the control_rule set on
switch setup. The following rules can be applied decalred in an array of string
in the dts:
- tx-blink: Led blink on tx traffic for the port
- rx-blink: Led blink on rx traffic for the port
- collision-blink: Led blink when a collision is detected for the port
- link-10M: Led is turned on when a link of 10M is detected for the port
- link-100M: Led is turned on when a link of 100M is detected for the port
- link-1000M: Led is turned on when a link of 1000M is detected for the port
- half-duplex: Led is turned on when a half-duplex link is detected for the port
- full-duplex: Led is turned on when a full-duplex link is detected for the port
- linkup-over: Led blinks only when the linkup led is on, ignore blink otherwise
- power-on-reset: Reset led on switch reset
- One of
	- blink-2hz: Led blinks at 2hz frequency
	- blink-4hz: Led blinks at 4hz frequency
	- blink-8hz: Led blinks at 8hz frequency
	- blink-auto: Led blinks at 2hz frequency with 10M, 4hz with 100M, 8hz
	  with 1000M
Due to the phy0-3 limitation, multiple use of 'qca8k_led_rules' will result in
the last defined one to be applied.

The CPU port of this switch is always port 0.

A CPU port node has the following optional node:

- fixed-link            : Fixed-link subnode describing a link to a non-MDIO
                          managed entity. See
                          Documentation/devicetree/bindings/net/fixed-link.txt
                          for details.

For QCA8K the 'fixed-link' sub-node supports only the following properties:

- 'speed' (integer, mandatory), to indicate the link speed. Accepted
  values are 10, 100 and 1000
- 'full-duplex' (boolean, optional), to indicate that full duplex is
  used. When absent, half duplex is assumed.

Examples:

for the external mdio-bus configuration:

	&mdio0 {
		phy_port1: phy@0 {
			reg = <0>;
		};

		phy_port2: phy@1 {
			reg = <1>;
		};

		phy_port3: phy@2 {
			reg = <2>;
		};

		phy_port4: phy@3 {
			reg = <3>;
		};

		phy_port5: phy@4 {
			reg = <4>;
		};

		switch@10 {
			compatible = "qca,qca8337";
			#address-cells = <1>;
			#size-cells = <0>;

			reset-gpios = <&gpio 42 GPIO_ACTIVE_LOW>;
			reg = <0x10>;

			ports {
				#address-cells = <1>;
				#size-cells = <0>;
				port@0 {
					reg = <0>;
					label = "cpu";
					ethernet = <&gmac1>;
					phy-mode = "rgmii";
					fixed-link {
						speed = 1000;
						full-duplex;
					};
				};

				port@1 {
					reg = <1>;
					label = "lan1";
					phy-handle = <&phy_port1>;
				};

				port@2 {
					reg = <2>;
					label = "lan2";
					phy-handle = <&phy_port2>;
				};

				port@3 {
					reg = <3>;
					label = "lan3";
					phy-handle = <&phy_port3>;
				};

				port@4 {
					reg = <4>;
					label = "lan4";
					phy-handle = <&phy_port4>;
				};

				port@5 {
					reg = <5>;
					label = "wan";
					phy-handle = <&phy_port5>;
				};
			};
		};
	};

for the internal master mdio-bus configuration:

	&mdio0 {
		switch@10 {
			compatible = "qca,qca8337";
			#address-cells = <1>;
			#size-cells = <0>;

			reset-gpios = <&gpio 42 GPIO_ACTIVE_LOW>;
			reg = <0x10>;

			ports {
				#address-cells = <1>;
				#size-cells = <0>;

				port@0 {
					reg = <0>;
					label = "cpu";
					ethernet = <&gmac1>;
					phy-mode = "rgmii";
					fixed-link {
						speed = 1000;
						full-duplex;
					};
				};

				port@1 {
					reg = <1>;
					label = "lan1";
					phy-mode = "internal";
					phy-handle = <&phy_port1>;
				};

				port@2 {
					reg = <2>;
					label = "lan2";
					phy-mode = "internal";
					phy-handle = <&phy_port2>;
				};

				port@3 {
					reg = <3>;
					label = "lan3";
					phy-mode = "internal";
					phy-handle = <&phy_port3>;
				};

				port@4 {
					reg = <4>;
					label = "lan4";
					phy-mode = "internal";
					phy-handle = <&phy_port4>;
				};

				port@5 {
					reg = <5>;
					label = "wan";
					phy-mode = "internal";
					phy-handle = <&phy_port5>;
				};
			};

			mdio {
				#address-cells = <1>;
				#size-cells = <0>;

				phy_port1: phy@0 {
					reg = <0>;
				};

				phy_port2: phy@1 {
					reg = <1>;
				};

				phy_port3: phy@2 {
					reg = <2>;
				};

				phy_port4: phy@3 {
					reg = <3>;
				};

				phy_port5: phy@4 {
					reg = <4>;
				};
			};
		};
	};

for the leds declaration example:

#include <dt-bindings/leds/common.h>

	&mdio0 {
		switch@10 {
			compatible = "qca,qca8337";
			#address-cells = <1>;
			#size-cells = <0>;

			reset-gpios = <&gpio 42 GPIO_ACTIVE_LOW>;
			reg = <0x10>;

			ports {
				#address-cells = <1>;
				#size-cells = <0>;

				port@0 {
					reg = <0>;
					label = "cpu";
					ethernet = <&gmac1>;
					phy-mode = "rgmii";
					fixed-link {
						speed = 1000;
						full-duplex;
					};
				};

				port@1 {
					reg = <1>;
					label = "lan1";
					phy-mode = "internal";
					phy-handle = <&phy_port1>;
				};

				port@2 {
					reg = <2>;
					label = "lan2";
					phy-mode = "internal";
					phy-handle = <&phy_port2>;
				};

				port@3 {
					reg = <3>;
					label = "lan3";
					phy-mode = "internal";
					phy-handle = <&phy_port3>;
				};

				port@4 {
					reg = <4>;
					label = "lan4";
					phy-mode = "internal";
					phy-handle = <&phy_port4>;
				};

				port@5 {
					reg = <5>;
					label = "wan";
					phy-mode = "internal";
					phy-handle = <&phy_port5>;
				};
			};

			mdio {
				#address-cells = <1>;
				#size-cells = <0>;

				phy_port1: phy@0 {
					reg = <0>;
				};

				phy_port2: phy@1 {
					reg = <1>;
				};

				phy_port3: phy@2 {
					reg = <2>;
				};

				phy_port4: phy@3 {
					reg = <3>;
				};

				phy_port5: phy@4 {
					reg = <4>;
				};
			};

			leds {
				#address-cells = <1>;
				#size-cells = <0>;

				phy@0 {
					#address-cells = <1>;
					#size-cells = <0>;

					reg = <0>;

					led@0 {
						reg = <0>;
						color = <LED_COLOR_ID_GREEN>;
						default-state = "keep";
						function = LED_FUNCTION_LAN;
						function-enumerator = <1>;
					};

					led@1 {
						reg = <1>;
						color = <LED_COLOR_ID_AMBER>;
						default-state = "keep";
						function = LED_FUNCTION_LAN;
						function-enumerator = <1>;
					};
				};

				phy@1 {
					#address-cells = <1>;
					#size-cells = <0>;

					reg = <1>;

					led@0 {
						reg = <0>;
						color = <LED_COLOR_ID_GREEN>;
						default-state = "keep";
						function = LED_FUNCTION_LAN;
						function-enumerator = <2>;
					};

					led@1 {
						reg = <1>;
						color = <LED_COLOR_ID_AMBER>;
						default-state = "keep";
						function = LED_FUNCTION_LAN;
						function-enumerator = <2>;
					};
				};

				phy@2 {
					#address-cells = <1>;
					#size-cells = <0>;

					reg = <2>;

					led@0 {
						reg = <0>;
						color = <LED_COLOR_ID_GREEN>;
						default-state = "keep";
						function = LED_FUNCTION_LAN;
						function-enumerator = <3>;
					};

					led@1 {
						reg = <1>;
						color = <LED_COLOR_ID_AMBER>;
						default-state = "keep";
						function = LED_FUNCTION_LAN;
						function-enumerator = <3>;
					};
				};

				phy@3 {
					#address-cells = <1>;
					#size-cells = <0>;

					reg = <3>;

					led@0 {
						reg = <0>;
						color = <LED_COLOR_ID_GREEN>;
						default-state = "keep";
						function = LED_FUNCTION_LAN;
						function-enumerator = <4>;
					};

					led@1 {
						reg = <1>;
						color = <LED_COLOR_ID_AMBER>;
						default-state = "keep";
						function = LED_FUNCTION_LAN;
						function-enumerator = <4>;
					};
				};

				phy@4 {
					#address-cells = <1>;
					#size-cells = <0>;

					reg = <4>;

					led@0 {
						reg = <0>;
						color = <LED_COLOR_ID_GREEN>;
						default-state = "keep";
						function = LED_FUNCTION_WAN;
						qca,led_rules = "tx-blink", "rx-blink", "link-1000M", "full-duplex", "linkup-over", "blink-8hz";
					};

					led@1 {
						reg = <1>;
						color = <LED_COLOR_ID_AMBER>;
						default-state = "keep";
						function = LED_FUNCTION_WAN;
					};
				};
			};
		};
	};
```
