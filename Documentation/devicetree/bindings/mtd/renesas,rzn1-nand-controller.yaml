## Documentation/devicetree/bindings/mtd/renesas,rzn1-nand-controller.yaml
```yaml
# SPDX-License-Identifier: (GPL-2.0-only OR BSD-2-Clause)
%YAML 1.2
---
$id: http://devicetree.org/schemas/mtd/renesas,rzn1-nand-controller.yaml#
$schema: http://devicetree.org/meta-schemas/core.yaml#

title: Renesas RZ/N1x NAND flash controller device tree bindings

maintainers:
  - Miquel Raynal <miquel.raynal@bootlin.com>

allOf:
  - $ref: "nand-controller.yaml"

properties:
  compatible:
    items:
      - enum:
          - renesas,r9a06g032-nand-controller
      - const: renesas,rzn1-nand-controller

  reg:
    maxItems: 1

  interrupts:
    maxItems: 1

  clocks:
    items:
      - description: APB host controller clock
      - description: External NAND bus clock

  clock-names:
    items:
      - const: hclk
      - const: eclk

  "#address-cells": true
  "#size-cells": true

required:
  - compatible
  - reg
  - clocks
  - clock-names
  - interrupts

unevaluatedProperties: false

examples:
  - |
    #include <dt-bindings/interrupt-controller/arm-gic.h>
    #include <dt-bindings/clock/r9a06g032-sysctrl.h>

    nand-controller@40102000 {
        compatible = "renesas,r9a06g032-nand-controller",
                     "renesas,rzn1-nand-controller";
        reg = <0x40102000 0x2000>;
        interrupts = <GIC_SPI 58 IRQ_TYPE_LEVEL_HIGH>;
        clocks = <&sysctrl R9A06G032_HCLK_NAND>, <&sysctrl R9A06G032_CLK_NAND>;
        clock-names = "hclk", "eclk";
        #address-cells = <1>;
        #size-cells = <0>;
    };
```

## Documentation/devicetree/bindings/mtd/spi-nand.yaml
```yaml
# SPDX-License-Identifier: (GPL-2.0 OR BSD-2-Clause)
%YAML 1.2
---
$id: http://devicetree.org/schemas/mtd/spi-nand.yaml#
$schema: http://devicetree.org/meta-schemas/core.yaml#

title: SPI NAND flash

maintainers:
  - Apurva Nandan <a-nandan@ti.com>

allOf:
  - $ref: "mtd.yaml#"

properties:
  compatible:
    oneOf:
      - const: spi-nand

  reg:
    items:
      description:
        should encode the chip-select line used to access the NAND chip

  spi-max-frequency: true
  spi-rx-bus-width: true
  spi-tx-bus-width: true

  partitions:
    type: object

  '#address-cells': true
  '#size-cells': true

patternProperties:
  # Note: use 'partitions' node for new users
  '^partition@':
    type: object

  "^otp(-[0-9]+)?$":
    type: object

additionalProperties: false

examples:
  - |
    spi {
        #address-cells = <1>;
        #size-cells = <0>;

        flash@6 {
            #address-cells = <1>;
            #size-cells = <1>;
            compatible = "spi-nand";
            reg = <0x6>;
            spi-max-frequency = <42000000>;

            partitions {
                compatible = "fixed-partitions";
                #address-cells = <1>;
                #size-cells = <1>;

                partition@0 {
                    label = "boot";
                    reg = <0 0x200000>;
                };

                partition@200000 {
                    label = "rootfs";
                    reg = <0x200000 0xce0000>;
                };
            };
        };
    };
```

## Documentation/devicetree/bindings/mtd/ti,gpmc-onenand.yaml
```yaml
# SPDX-License-Identifier: (GPL-2.0-only OR BSD-2-Clause)
%YAML 1.2
---
$id: http://devicetree.org/schemas/mtd/ti,gpmc-onenand.yaml#
$schema: http://devicetree.org/meta-schemas/core.yaml#

title: OneNAND over Texas Instruments GPMC bus.

maintainers:
  - Tony Lindgren <tony@atomide.com>
  - Roger Quadros <rogerq@kernel.org>

description:
  GPMC connected OneNAND (found on OMAP boards) are represented
  as child nodes of the GPMC controller.

properties:
  compatible:
    const: ti,omap2-onenand

  reg:
    items:
      - description: |
          Chip Select number, register offset and size of
          OneNAND register window.

  "#address-cells":
    const: 1

  "#size-cells":
    const: 1

  int-gpios:
    description: GPIO specifier for the INT pin.

allOf:
  - $ref: "../memory-controllers/ti,gpmc-child.yaml"

required:
  - compatible
  - reg
  - "#address-cells"
  - "#size-cells"

unevaluatedProperties: false

examples:
  - |
    gpmc: memory-controller@6e000000 {
      compatible = "ti,omap3430-gpmc";
      reg = <0x6e000000 0x02d0>;
      interrupts = <20>;
      gpmc,num-cs = <8>;
      gpmc,num-waitpins = <4>;
      clocks = <&l3s_clkctrl>;
      clock-names = "fck";
      #address-cells = <2>;
      #size-cells = <1>;

      ranges = <0 0 0x01000000 0x01000000>,   /* 16 MB for OneNAND */
               <1 0 0x02000000 0x01000000>;   /* 16 MB for smc91c96 */

      onenand@0,0 {
        compatible = "ti,omap2-onenand";
        reg = <0 0 0x20000>;    /* CS0, offset 0, IO size 128K */
        #address-cells = <1>;
        #size-cells = <1>;
      };
    };
```

## Documentation/devicetree/bindings/net/adi,adin1100.yaml
```yaml
# SPDX-License-Identifier: (GPL-2.0-only OR BSD-2-Clause)
%YAML 1.2
---
$id: http://devicetree.org/schemas/net/adi,adin1100.yaml#
$schema: http://devicetree.org/meta-schemas/core.yaml#

title: Analog Devices ADIN1100 PHY

maintainers:
  - Alexandru Tachici <alexandru.tachici@analog.com>

description:
  Bindings for Analog Devices Industrial Low Power 10BASE-T1L Ethernet PHY

allOf:
  - $ref: ethernet-phy.yaml#

examples:
  - |
    ethernet {
        #address-cells = <1>;
        #size-cells = <0>;

        10base-t1l-2.4vpp = <0>;

        ethernet-phy@0 {
            compatible = "ethernet-phy-id0283.bc81";
            reg = <0>;
        };
    };
```

## Documentation/devicetree/bindings/net/asix,ax88178.yaml
```yaml
# SPDX-License-Identifier: (GPL-2.0-only OR BSD-2-Clause)
%YAML 1.2
---
$id: http://devicetree.org/schemas/net/asix,ax88178.yaml#
$schema: http://devicetree.org/meta-schemas/core.yaml#

title: The device tree bindings for the USB Ethernet controllers

maintainers:
  - Oleksij Rempel <o.rempel@pengutronix.de>

description: |
  Device tree properties for hard wired USB Ethernet devices.

allOf:
  - $ref: ethernet-controller.yaml#

properties:
  compatible:
    items:
      - enum:
          - usb411,3d     # Buffalo LUA-U2-KTX
          - usb411,6e     # Buffalo LUA-U2-GT 10/100/1000
          - usb4bb,930    # IO-DATA ETG-US2
          - usb4f1,3008   # JVC MP-PRX1 Port Replicator
          - usb50d,5055   # Belkin F5D5055
          - usb557,2009   # ATEN UC210T
          - usb5ac,1402   # Apple USB Ethernet Adapter
          - usb66b,20f9   # USBLINK HG20F9
          - usb77b,2226   # Linksys USB200M
          - usb789,160    # Logitec LAN-GTJ/U2A
          - usb7aa,17     # corega FEther USB2-TX
          - usb7b8,420a   # Hawking UF200, TrendNet TU2-ET100
          - usb7d1,3c05   # DLink DUB-E100 H/W Ver B1
          - usb846,1040   # Netgear FA120
          - usb8dd,114    # Billionton Systems, GUSB2AM-1G-B
          - usb8dd,90ff   # Billionton Systems, USB2AR
          - usbb95,1720   # Intellinet, ST Lab USB Ethernet
          - usbb95,172a   # ASIX 88172a demo board
          - usbb95,1780   # ASIX AX88178 10/100/1000
          - usbb95,7720   # ASIX AX88772 10/100
          - usbb95,772a   # Cables-to-Go USB Ethernet Adapter
          - usbb95,772b   # ASIX AX88772B 10/100
          - usbb95,7e2b   # Asus USB Ethernet Adapter
          - usbdb0,a877   # ASIX 88772a
          - usbdf6,56     # Sitecom LN-031
          - usbdf6,61c    # Sitecom LN-028
          - usb1189,893   # Surecom EP-1427X-2
          - usb13b1,18    # Linksys USB200M Rev 2
          - usb14ea,ab11  # ABOCOM for pci
          - usb1557,7720  # 0Q0 cable ethernet
          - usb1631,6200  # goodway corp usb gwusb2e
          - usb1737,39    # Linksys USB1000
          - usb17ef,7203  # Lenovo U2L100P 10/100
          - usb2001,1a00  # DLink DUB-E100
          - usb2001,1a02  # DLink DUB-E100 H/W Ver C1
          - usb2001,3c05  # DLink DUB-E100 H/W Ver B1 Alternate
          - usb6189,182d  # Sitecom LN-029

  reg: true
  local-mac-address: true
  mac-address: true

required:
  - compatible
  - reg

additionalProperties: false

examples:
  - |
    usb@11270000 {
        reg = <0x11270000 0x1000>;
        #address-cells = <1>;
        #size-cells = <0>;

        ethernet@1 {
            compatible = "usbdb0,a877";
            reg = <1>;
            local-mac-address = [00 00 00 00 00 00];
        };
    };
  - |
    usb@11270000 {
        reg = <0x11270000 0x1000>;
        #address-cells = <1>;
        #size-cells = <0>;

        usb1@1 {
            compatible = "usb1234,5678";
            reg = <1>;
            #address-cells = <1>;
            #size-cells = <0>;

            ethernet@1 {
               compatible = "usbdb0,a877";
               reg = <1>;
            };
        };
    };
```

## Documentation/devicetree/bindings/net/can/bosch,c_can.yaml
```yaml
# SPDX-License-Identifier: (GPL-2.0-only OR BSD-2-Clause)
%YAML 1.2
---
$id: http://devicetree.org/schemas/net/can/bosch,c_can.yaml#
$schema: http://devicetree.org/meta-schemas/core.yaml#

title: Bosch C_CAN/D_CAN controller Device Tree Bindings

description: Bosch C_CAN/D_CAN controller for CAN bus

maintainers:
  - Dario Binacchi <dariobin@libero.it>

allOf:
  - $ref: can-controller.yaml#

properties:
  compatible:
    oneOf:
      - enum:
          - bosch,c_can
          - bosch,d_can
          - ti,dra7-d_can
          - ti,am3352-d_can
      - items:
          - enum:
              - ti,am4372-d_can
          - const: ti,am3352-d_can

  reg:
    maxItems: 1

  interrupts:
    maxItems: 1

  power-domains:
    description: |
      Should contain a phandle to a PM domain provider node and an args
      specifier containing the DCAN device id value. It's mandatory for
      Keystone 2 66AK2G SoCs only.
    maxItems: 1

  clocks:
    description: |
      CAN functional clock phandle.
    maxItems: 1

  clock-names:
    maxItems: 1

  syscon-raminit:
    description: |
      Handle to system control region that contains the RAMINIT register,
      register offset to the RAMINIT register and the CAN instance number (0
      offset).

required:
 - compatible
 - reg
 - interrupts
 - clocks

additionalProperties: false

examples:
  - |
    can@481d0000 {
        compatible = "bosch,d_can";
        reg = <0x481d0000 0x2000>;
        interrupts = <55>;
        interrupt-parent = <&intc>;
        status = "disabled";
    };
  - |
    can@0 {
        compatible = "ti,am3352-d_can";
        reg = <0x0 0x2000>;
        clocks = <&dcan1_fck>;
        clock-names = "fck";
        syscon-raminit = <&scm_conf 0x644 1>;
        interrupts = <55>;
        status = "disabled";
    };
```

## Documentation/devicetree/bindings/net/can/xilinx_can.yaml
```yaml
# SPDX-License-Identifier: (GPL-2.0-only OR BSD-2-Clause)
%YAML 1.2
---
$id: http://devicetree.org/schemas/net/can/xilinx_can.yaml#
$schema: http://devicetree.org/meta-schemas/core.yaml#

title:
  Xilinx Axi CAN/Zynq CANPS controller Binding

maintainers:
  - Appana Durga Kedareswara rao <appana.durga.rao@xilinx.com>

properties:
  compatible:
    oneOf:
      - const: xlnx,zynq-can-1.0
        description: For Zynq CAN controller
      - const: xlnx,axi-can-1.00.a
        description: For Axi CAN controller
      - const: xlnx,canfd-1.0
        description: For CAN FD controller
      - const: xlnx,canfd-2.0
        description: For CAN FD 2.0 controller

  reg:
    maxItems: 1

  interrupts:
    maxItems: 1

  clocks:
    description: |
      CAN functional clock phandle
    maxItems: 2

  tx-fifo-depth:
    description: |
      CAN Tx fifo depth (Zynq, Axi CAN).

  rx-fifo-depth:
    description: |
      CAN Rx fifo depth (Zynq, Axi CAN, CAN FD in sequential Rx mode)

  tx-mailbox-count:
    description: |
      CAN Tx mailbox buffer count (CAN FD)

  rx-mailbox-count:
    description: |
      CAN Rx mailbox buffer count (CAN FD in mailbox Rx  mode)

  clock-names:
    maxItems: 2

required:
  - compatible
  - reg
  - interrupts
  - clocks
  - clock-names

additionalProperties: false

allOf:
  - if:
      properties:
        compatible:
          contains:
            const: xlnx,zynq-can-1.0

    then:
      properties:
        clock-names:
          items:
            - const: can_clk
            - const: pclk
      required:
        - tx-fifo-depth
        - rx-fifo-depth

  - if:
      properties:
        compatible:
          contains:
            const: xlnx,axi-can-1.00.a

    then:
      properties:
        clock-names:
          items:
            - const: can_clk
            - const: s_axi_aclk
      required:
        - tx-fifo-depth
        - rx-fifo-depth

  - if:
      properties:
        compatible:
          contains:
            const: xlnx,canfd-1.0

    then:
      properties:
        clock-names:
          items:
            - const: can_clk
            - const: s_axi_aclk
      required:
        - tx-mailbox-count
        - rx-fifo-depth

examples:
  - |
    can@e0008000 {
        compatible = "xlnx,zynq-can-1.0";
        clocks = <&clkc 19>, <&clkc 36>;
        clock-names = "can_clk", "pclk";
        reg = <0xe0008000 0x1000>;
        interrupts = <0 28 4>;
        interrupt-parent = <&intc>;
        tx-fifo-depth = <0x40>;
        rx-fifo-depth = <0x40>;
    };
  - |
    axi-can@40000000 {
        compatible = "xlnx,axi-can-1.00.a";
        clocks = <&clkc 0>, <&clkc 1>;
        clock-names = "can_clk","s_axi_aclk" ;
        reg = <0x40000000 0x10000>;
        interrupt-parent = <&intc>;
        interrupts = <0 59 1>;
        tx-fifo-depth = <0x40>;
        rx-fifo-depth = <0x40>;
    };
  - |
    canfd@40000000 {
        compatible = "xlnx,canfd-1.0";
        clocks = <&clkc 0>, <&clkc 1>;
        clock-names = "can_clk", "s_axi_aclk";
        reg = <0x40000000 0x2000>;
        interrupt-parent = <&intc>;
        interrupts = <0 59 1>;
        tx-mailbox-count = <0x20>;
        rx-fifo-depth = <0x20>;
    };
```

## Documentation/devicetree/bindings/net/davicom,dm9051.yaml
```yaml
# SPDX-License-Identifier: (GPL-2.0-only OR BSD-2-Clause)
%YAML 1.2
---
$id: http://devicetree.org/schemas/net/davicom,dm9051.yaml#
$schema: http://devicetree.org/meta-schemas/core.yaml#

title: Davicom DM9051 SPI Ethernet Controller

maintainers:
  - Joseph CHANG <josright123@gmail.com>

description: |
  The DM9051 is a fully integrated and cost-effective low pin count single
  chip Fast Ethernet controller with a Serial Peripheral Interface (SPI).

properties:
  compatible:
    const: davicom,dm9051

  reg:
    maxItems: 1

  spi-max-frequency:
    maximum: 45000000

  interrupts:
    maxItems: 1

required:
  - compatible
  - reg
  - spi-max-frequency
  - interrupts

allOf:
  - $ref: ethernet-controller.yaml#

additionalProperties: false

examples:
  - |
    /* for Raspberry Pi with pin control stuff for GPIO irq */
    spi {
        #address-cells = <1>;
        #size-cells = <0>;
        dm9051@0 {
            compatible = "davicom,dm9051";
            reg = <0>; /* spi chip select */
            pinctrl-names = "default";
            pinctrl-0 = <&eth_int_pins>;
            interrupt-parent = <&gpio>;
            interrupts = <26 IRQ_TYPE_LEVEL_LOW>;
            spi-max-frequency = <31200000>;
        };
    };
    gpio {
        eth_int_pins {
            brcm,pins = <26>;
            brcm,function = <0>; /* in */
            brcm,pull = <0>; /* none */
        };
    };
```
