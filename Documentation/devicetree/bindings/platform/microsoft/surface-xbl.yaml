## Documentation/devicetree/bindings/platform/microsoft/surface-xbl.yaml
```yaml
# SPDX-License-Identifier: (GPL-2.0-only OR BSD-2-Clause)
%YAML 1.2
---
$id: http://devicetree.org/schemas/platform/microsoft/surface-xbl.yaml#
$schema: http://devicetree.org/meta-schemas/core.yaml#

title: Surface Extensible Bootloader for Microsoft Surface Duo

maintainers:
  - Jarrett Schultz <jaschultz@microsoft.com>

description: |
  Defined to expose information that is used during production when
  device is in manufacturing mode. Some of the information included
  in this imem section is -
    * board_id
    * battery_present
    * hw_init_retries
    * is_customer_mode
    * is_act_mode
    * pmic_reset_reason
    * touch_fw_version
    * ocp_error_location
  See sysfs documentation for more information.

properties:
  compatible:
    const: simple-mfd

  reg:
    maxItems: 1

additionalProperties: false

required:
  - compatible
  - reg
  - ranges
  - address-cells
  - size-cells

examples:
  - |
    / {
        compatible = "foo";
        model = "foo";
        #address-cells = <2>;
        #size-cells = <2>;

        imem@146bf000 {
          compatible = "simple-mfd";
          reg = <0x0 0x146bf000 0x0 0x1000>;
          ranges = <0x0 0x0 0x146bf000 0x1000>;
          #address-cells = <1>;
          #size-cells = <1>;
          status = "okay";

          xbl@a94 {
            compatible = "microsoft,sm8150-surface-duo-xbl";
            reg = <0xa94 0x100>;
            status = "okay";
          };
        };
      };
```

## Documentation/devicetree/bindings/power/energy-model.yaml
```yaml
# SPDX-License-Identifier: (GPL-2.0-only OR BSD-2-Clause)
%YAML 1.2
---
$id: http://devicetree.org/schemas/power/energy-model.yaml#
$schema: http://devicetree.org/meta-schemas/core.yaml#

title: Energy Model Bindings

maintainers:
  - Lukasz Luba <lukasz.luba@arm.com>

description: |+
  Devices work at specific performance states (frequencies). The power which
  is used at a given performance state is an important information. A framework
  which maintains this information is Energy Model. This document defines
  bindings for these Energy Model performance states applicable across wide
  range of devices. For illustration purpose, this document uses GPU as a device.

  This binding only supports frequency-power pairs.

select: true

properties:
  operating-points:
    $ref: /schemas/types.yaml#/definitions/uint32-matrix
    items:
      items:
        - description: Frequency in kHz
        - description: Power in uW


additionalProperties: true
examples:
    {
       gpu_energy_model: energy-model {
               compatible = "energy-model";
               energy-model-entries = <
                               200000 300000
                               297000 500000
                               400000 800000
                               500000 1400000
                               600000 2000000
                               800000 2800000
                               >;
       };
    };

    &gpu {
       energy-model = <&gpu_energy_model>;
    };
...
```

## Documentation/devicetree/bindings/power/fsl,imx-power-domain.yaml
```yaml
# SPDX-License-Identifier: (GPL-2.0-only OR BSD-2-Clause)
%YAML 1.2
---
$id: http://devicetree.org/schemas/power/fsl,imx-power-domain.yaml#
$schema: http://devicetree.org/meta-schemas/core.yaml#

title: Freescale i.MX 8mm, 8mn and 8mp Power Domain

maintainers:
  - Adrien Grassein <adrien.grassein@gmail.com>

description: |+
  i.MX processors include support for multiple power domains which are used
  to gate power to one or more peripherals on the processor.

allOf:
  - $ref: power-domain.yaml#

properties:
  compatible:
    enum:
      - fsl,imx8mm-pm-domain
      - fsl,imx8mn-pm-domain
      - fsl,imx8mp-pm-domain

  domain-name:
    $ref: /schemas/types.yaml#/definitions/string
    description: |
      Human readable string with domain name. Will be visible in userspace
      to let user to distinguish between multiple domains in SoC.

  domain-index:
    $ref: /schemas/types.yaml#/definitions/uint32
    description: |
      Power domain index. Valid values are defined in
      include/dt-bindings/power/imx8mm-power.h for i.MX 8mm
      include/dt-bindings/power/imx8mn-power.h for i.MX 8mn
      include/dt-bindings/power/imx8mp-power.h for i.MX 8mp

    maxItems: 1

  clocks:
    description: |
      A number of phandles to clocks that need to be enabled during domain
      power-up sequencing to ensure reset propagation into devices located
      inside this power domain.
    minItems: 1
    maxItems: 6

  power-supply:
    description:
      A phandle to a supply to enable when powering on the domain.

  fsl,active-wakeup:
    $ref: /schemas/types.yaml#/definitions/flag
    description:
      Instructs genpd to keep the PM domain powered on.

  fsl,rpm-always-on:
    $ref: /schemas/types.yaml#/definitions/flag
    description:
      Instructs genpd to always keep the PM domain powered on except
      for system suspend.

  "#power-domain-cells":
    const: 0

  power-domains:
    maxItems: 1

required:
  - compatible
  - domain-name
  - domain-index

additionalProperties: false

examples:
  - |
    #include <dt-bindings/power/imx8mm-power.h>
    #include <dt-bindings/clock/imx8mm-clock.h>

    hsiomix_pd: power-domain-hsio {
        compatible = "fsl,imx8mm-pm-domain";
        domain-index = <IMX8MM_POWER_DOMAIN_HSIOMIX>;
        #power-domain-cells = <0>;
        domain-name = "hsiomix";
        clocks = <&clk IMX8MM_CLK_USB1_CTRL_ROOT>;
    };
```

## Documentation/devicetree/bindings/power/power-zone.yaml
```yaml
# SPDX-License-Identifier: GPL-2.0
%YAML 1.2
---
$id: http://devicetree.org/schemas/power/power-zone.yaml#
$schema: http://devicetree.org/meta-schemas/core.yaml#

title: Power zones description

maintainers:
  - Daniel Lezcano <daniel.lezcano@linaro.org>

description: |+

  A System on Chip contains a multitude of active components and each
  of them is a source of heat. Even if a temperature sensor is not
  present, a source of heat can be controlled by acting on the
  consumed power via different techniques.

  A powerzone describes a component or a group of components where we
  can control the maximum power consumption. For instance, a group of
  CPUs via the performance domain, a LCD screen via the brightness,
  etc ...

  Different components when they are used together can significantly
  increase the overall temperature, so the description needs to
  reflect this dependency in order to assign a power budget for a
  group of powerzones.

  This description is done via a hierarchy and the DT reflects it. It
  does not represent the physical location or a topology, eg. on a
  big.Little system, the little CPUs may not be represented as they do
  not contribute significantly to the heat, however the GPU can be
  tied with the big CPUs as they usually have a connection for
  multimedia or game workloads.
    
properties:
  $nodename:
    const: powerzones
    description:
      A description

  compatible:
    const: powerzones

  "#powerzone-cells":
    description:
      Number of cells in powerzone specifier. Typically 0 for nodes
      representing but it can be any number in the future to describe
      parameters of the powerzone.

  powerzone:
    description:
      A phandle to a parent powerzone. If no powerzone attribute is set, the
      described powerzone is the topmost in the hierarchy.

required:
  - compatible


additionalProperties: true

examples:
  - |
    POWERZONES: powerzones {
      compatible = "powerzones";

      SOC_PZ: soc {
      };

      PKG_PZ: pkg {
        #powerzone-cells = <0>;
        powerzone = <&SOC_PZ>;
      };

      BIG_PZ: big {
        #powerzone-cells = <0>;
        powerzone = <&PKG_PZ>;
      };

      GPU_PZ: gpu {
        #powerzone-cells = <0>;
        powerzone = <&PKG_PZ>;
      };

      MULTIMEDIA_PZ: multimedia {
        #powerzone-cells = <0>;
        powerzone = <&SOC_PZ>;
      };
    };

  - |
    A57_0: big@0 {
      compatible = "arm,cortex-a57";
      reg = <0x0 0x0>;
      device_type = "cpu";
      #powerzone-cells = <0>;
      powerzone = <&BIG_PZ>;
    };

    A57_1: big@1 {
      compatible = "arm,cortex-a57";
      reg = <0x0 0x0>;
      device_type = "cpu";
      #powerzone-cells = <0>;
      powerzone = <&BIG_PZ>;
    };

    #include <dt-bindings/interrupt-controller/irq.h>
    #include <dt-bindings/interrupt-controller/arm-gic.h>

    gpu@ffe40000 {
      compatible = "amlogic,meson-g12a-mali", "arm,mali-bifrost";
      reg = <0xffe40000 0x10000>;
      interrupts = <GIC_SPI 160 IRQ_TYPE_LEVEL_HIGH>,
             <GIC_SPI 161 IRQ_TYPE_LEVEL_HIGH>,
             <GIC_SPI 162 IRQ_TYPE_LEVEL_HIGH>;
      interrupt-names = "job", "mmu", "gpu";
      clocks = <&clk 1>;
      #powerzone-cells = <0>;
      powerzone = <&GPU_PZ>;
    };
...
```

## Documentation/devicetree/bindings/power/powerzones.yaml
```yaml
# SPDX-License-Identifier: GPL-2.0
%YAML 1.2
---
$id: http://devicetree.org/schemas/power/powerzones.yaml#
$schema: http://devicetree.org/meta-schemas/core.yaml#

title: Power zones description

maintainers:
  - Daniel Lezcano <daniel.lezcano@linaro.org>

description: |+

  A System on Chip contains a multitude of active components and each
  of them is a source of heat. Even if a temperature sensor is not
  present, a source of heat can be controlled by acting on the
  consumed power via different techniques.

  A powerzone describes a component or a group of components where we
  can control the maximum power consumption. For instance, a group of
  CPUs via the performance domain, a LCD screen via the brightness,
  etc ...

  Different components when they are used together can significantly
  increase the overall temperature, so the description needs to
  reflect this dependency in order to assign a power budget for a
  group of powerzones.

  This description is done via a hierarchy and the DT reflects it. It
  does not represent the physical location or a topology, eg. on a
  big.Little system, the little CPUs may not be represented as they do
  not contribute significantly to the heat, however the GPU can be
  tied with the big CPUs as they usually have a connection for
  multimedia or game workloads.
    
properties:
  $nodename:
    const: powerzones

patternProperties:
  "^(powerzone)([@-].*)?$":
    type: object
    description:
      A node representing a powerzone acting as an aggregator for all
      its children powerzones.

    properties:
      "#powerzone-cells":
        description:
          Number of cells in powerzone specifier. Typically 0 for nodes
          representing but it can be any number in the future to
          describe parameters of the powerzone.

      powerzones:
        description:
          A phandle to a parent powerzone. If no powerzone attribute is
          set, the described powerzone is the topmost in the hierarchy.

    required:
      - "#powerzone-cells"

additionalProperties: false

examples:
  - |
    powerzones {

      SOC_PZ: powerzone-soc {
        #powerzone-cells = <0>;
      };

      PKG_PZ: powerzone-pkg {
        #powerzone-cells = <0>;
        powerzones = <&SOC_PZ>;
      };

      GPU_PZ: powerzone-gpu {
        #powerzone-cells = <0>;
        powerzones = <&PKG_PZ>;
      };
    };

  - |
    A57_0: big@0 {
      compatible = "arm,cortex-a57";
      reg = <0x0 0x0>;
      device_type = "cpu";
      powerzones = <&PKG_PZ>;
    };

    A57_1: big@1 {
      compatible = "arm,cortex-a57";
      reg = <0x0 0x0>;
      device_type = "cpu";
      powerzones = <&PKG_PZ>;
    };
...
```

## Documentation/devicetree/bindings/power/reset/gpio-poweroff.yaml
```yaml
# SPDX-License-Identifier: (GPL-2.0-only or BSD-2-Clause)
%YAML 1.2
---
$id: http://devicetree.org/schemas/power/reset/gpio-poweroff.yaml#
$schema: http://devicetree.org/meta-schemas/core.yaml#

title: Driver a GPIO line that can be used to turn the power off

maintainers:
  - Sebastian Reichel <sre@kernel.org>

description:
  The driver supports both level triggered and edge triggered power off.
  At driver load time, the driver will request the given gpio line and
  install a handler to power off the system. If the optional properties
  'input' is not found, the GPIO line will be driven in the inactive
  state. Otherwise its configured as an input.

  When the power-off handler is called, the gpio is configured as an
  output, and drive active, so triggering a level triggered power off
  condition. This will also cause an inactive->active edge condition, so
  triggering positive edge triggered power off. After a delay of 100ms,
  the GPIO is set to inactive, thus causing an active->inactive edge,
  triggering negative edge triggered power off. After another 100ms
  delay the GPIO is driver active again. If the power is still on and
  the CPU still running after a 3000ms delay, a WARN_ON(1) is emitted.

properties:
  compatible:
    const: gpio-poweroff

  gpios: true

  input:
    description: |
      Initially configure the GPIO line as an input. Only reconfigure
      it to an output when the power-off handler is called. If this optional
      property is not specified, the GPIO is initialized as an output in its inactive state.

  active-delay-ms:
    default: 100
    description: Delay to wait after driving gpio active

  inactive-delay-ms:
    default: 100
    description: Delay to wait after driving gpio inactive

  timeout-ms:
    default: 3000
    description: Time to wait before asserting a WARN_ON(1).

required:
  - compatible
  - gpios

additionalProperties: false

examples:
  - |
    gpio-poweroff {
        compatible = "gpio-poweroff";
        gpios = <&gpio 4 0>;
        timeout-ms = <3000>;
    };
```

## Documentation/devicetree/bindings/power/reset/qcom,pon.yaml
```yaml
# SPDX-License-Identifier: GPL-2.0-only OR BSD-2-Clause
%YAML 1.2
---
$id: http://devicetree.org/schemas/power/reset/qcom,pon.yaml#
$schema: http://devicetree.org/meta-schemas/core.yaml#

title: Qualcomm PON Device

maintainers:
  - Vinod Koul <vkoul@kernel.org>

description: |
  The Power On device for Qualcomm PM8xxx is MFD supporting pwrkey
  and resin along with the Android reboot-mode.

properties:
  compatible:
    enum:
      - qcom,pm8916-pon
      - qcom,pms405-pon
      - qcom,pm8998-pon

  reg:
    maxItems: 1

  qcom,pon-reboot-not-used:
    description: Support of reboot mode passing through PON register is not used
    type: boolean

patternProperties:
  "^mode-.+":
    $ref: /schemas/types.yaml#/definitions/uint32
    description: Vendor-specific mode value written to the mode register

required:
  - compatible
  - reg

additionalProperties: false

examples:
  - |
    pmic {
        #address-cells = <1>;
        #size-cells = <0>;

        pon@800 {
            compatible = "qcom,pm8916-pon";
            reg = <0x800>;
            mode-bootloader = <0x2>;
            mode-recovery = <0x1>;
        };
    };
```
