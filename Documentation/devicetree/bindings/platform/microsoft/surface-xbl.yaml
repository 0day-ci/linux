## Documentation/devicetree/bindings/power/rockchip-io-domain.yaml
```yaml
# SPDX-License-Identifier: GPL-2.0
%YAML 1.2
---
$id: http://devicetree.org/schemas/power/rockchip-io-domain.yaml#
$schema: http://devicetree.org/meta-schemas/core.yaml#

title: Rockchip SRAM for IO Voltage Domains

maintainers:
  - Heiko Stuebner <heiko@sntech.de>

description: |
  IO domain voltages on some Rockchip SoCs are variable but need to be
  kept in sync between the regulators and the SoC using a special
  register.

  A specific example using rk3288
    If the regulator hooked up to a pin like SDMMC0_VDD is 3.3V then
    bit 7 of GRF_IO_VSEL needs to be 0. If the regulator hooked up to
    that same pin is 1.8V then bit 7 of GRF_IO_VSEL needs to be 1.

  Said another way, this driver simply handles keeping bits in the SoCs
  General Register File (GRF) in sync with the actual value of a voltage
  hooked up to the pins.

  Note that this driver specifically does not include
    any logic for deciding what voltage we should set regulators to
    any logic for deciding whether regulators (or internal SoC blocks)
    should have power or not have power

  If there were some other software that had the smarts of making
  decisions about regulators, it would work in conjunction with this
  driver. When that other software adjusted a regulators voltage then
  this driver would handle telling the SoC about it. A good example is
  vqmmc for SD. In that case the dw_mmc driver simply is told about a
  regulator. It changes the regulator between 3.3V and 1.8V at the
  right time. This driver notices the change and makes sure that the
  SoC is on the same page.

  You specify supplies using the standard regulator bindings by including
  a phandle the relevant regulator. All specified supplies must be able
  to report their voltage. The IO Voltage Domain for any non-specified
  supplies will be not be touched.

properties:
  compatible:
    enum:
      - rockchip,px30-io-voltage-domain
      - rockchip,px30-pmu-io-voltage-domain
      - rockchip,rk3188-io-voltage-domain
      - rockchip,rk3228-io-voltage-domain
      - rockchip,rk3288-io-voltage-domain
      - rockchip,rk3328-io-voltage-domain
      - rockchip,rk3368-io-voltage-domain
      - rockchip,rk3368-pmu-io-voltage-domain
      - rockchip,rk3399-io-voltage-domain
      - rockchip,rk3399-pmu-io-voltage-domain
      - rockchip,rv1108-io-voltage-domain
      - rockchip,rv1108-pmu-io-voltage-domain

required:
  - compatible

patternProperties:
  ".*-supply$": true

additionalProperties: false

allOf:
  - if:
      properties:
        compatible:
          contains:
            const: rockchip,px30-io-voltage-domain

    then:
      properties:
        vccio1-supply:
          description: The supply connected to VCCIO1.
        vccio2-supply:
          description: The supply connected to VCCIO2.
        vccio3-supply:
          description: The supply connected to VCCIO3.
        vccio4-supply:
          description: The supply connected to VCCIO4.
        vccio5-supply:
          description: The supply connected to VCCIO5.
        vccio6-supply:
          description: The supply connected to VCCIO6.
        vccio-oscgpi-supply:
          description: The supply connected to VCCIO_OSCGPI.

  - if:
      properties:
        compatible:
          contains:
            const: rockchip,px30-pmu-io-voltage-domain

    then:
      properties:
        pmuio1-supply:
          description: The supply connected to PMUIO1.
        pmuio2-supply:
          description: The supply connected to PMUIO2.

  - if:
      properties:
        compatible:
          contains:
            const: rockchip,rk3188-io-voltage-domain

    then:
      properties:
        ap0-supply:
          description: The supply connected to AP0_VCC.
        ap1-supply:
          description: The supply connected to AP1_VCC.
        cif-supply:
          description: The supply connected to CIF_VCC.
        flash-supply:
          description: The supply connected to FLASH_VCC.
        lcdc0-supply:
          description: The supply connected to LCD0_VCC.
        lcdc1-supply:
          description: The supply connected to LCD1_VCC.
        vccio0-supply:
          description: The supply connected to VCCIO0.
        vccio1-supply:
          description: The supply connected to VCCIO1. Also labeled as VCCIO2.

  - if:
      properties:
        compatible:
          contains:
            const: rockchip,rk3228-io-voltage-domain

    then:
      properties:
        vccio1-supply:
          description: The supply connected to VCCIO1.
        vccio2-supply:
          description: The supply connected to VCCIO2.
        vccio3-supply:
          description: The supply connected to VCCIO3.
        vccio4-supply:
          description: The supply connected to VCCIO4.

  - if:
      properties:
        compatible:
          contains:
            const: rockchip,rk3288-io-voltage-domain

    then:
      properties:
        audio-supply:
          description: The supply connected to APIO4_VDD.
        bb-supply:
          description: The supply connected to APIO5_VDD.
        dvp-supply:
          description: The supply connected to DVPIO_VDD.
        flash0-supply:
          description: The supply connected to FLASH0_VDD. Typically for eMMC.
        flash1-supply:
          description: The supply connected to FLASH1_VDD. Also known as SDIO1.
        gpio30-supply:
          description: The supply connected to APIO1_VDD.
        gpio1830-supply:
          description: The supply connected to APIO2_VDD.
        lcdc-supply:
          description: The supply connected to LCDC_VDD.
        sdcard-supply:
          description: The supply connected to SDMMC0_VDD.
        wifi-supply:
          description: The supply connected to APIO3_VDD. Also known as SDIO0.

  - if:
      properties:
        compatible:
          contains:
            const: rockchip,rk3328-io-voltage-domain

    then:
      properties:
        vccio1-supply:
          description: The supply connected to VCCIO1.
        vccio2-supply:
          description: The supply connected to VCCIO2.
        vccio3-supply:
          description: The supply connected to VCCIO3.
        vccio4-supply:
          description: The supply connected to VCCIO4.
        vccio5-supply:
          description: The supply connected to VCCIO5.
        vccio6-supply:
          description: The supply connected to VCCIO6.
        pmuio-supply:
          description: The supply connected to PMUIO.

  - if:
      properties:
        compatible:
          contains:
            const: rockchip,rk3368-io-voltage-domain

    then:
      properties:
        audio-supply:
          description: The supply connected to APIO3_VDD.
        dvp-supply:
          description: The supply connected to DVPIO_VDD.
        flash0-supply:
          description: The supply connected to FLASH0_VDD. Typically for eMMC.
        gpio30-supply:
          description: The supply connected to APIO1_VDD.
        gpio1830-supply:
          description: The supply connected to APIO4_VDD.
        sdcard-supply:
          description: The supply connected to SDMMC0_VDD.
        wifi-supply:
          description: The supply connected to APIO2_VDD. Also known as SDIO0.

  - if:
      properties:
        compatible:
          contains:
            const: rockchip,rk3368-pmu-io-voltage-domain

    then:
      properties:
        pmu-supply:
          description: The supply connected to PMUIO_VDD.
        vop-supply:
          description: The supply connected to LCDC_VDD.

  - if:
      properties:
        compatible:
          contains:
            const: rockchip,rk3399-io-voltage-domain

    then:
      properties:
        audio-supply:
          description: The supply connected to APIO5_VDD.
        bt656-supply:
          description: The supply connected to APIO2_VDD.
        gpio1830-supply:
          description: The supply connected to APIO4_VDD.
        sdmmc-supply:
          description: The supply connected to SDMMC0_VDD.

  - if:
      properties:
        compatible:
          contains:
            const: rockchip,rk3399-pmu-io-voltage-domain

    then:
      properties:
        pmu1830-supply:
          description: The supply connected to PMUIO2_VDD.

  - if:
      properties:
        compatible:
          contains:
            const: rockchip,rv1108-io-voltage-domain

    then:
      properties:
        vccio1-supply:
          description: The supply connected to VCCIO1.
        vccio2-supply:
          description: The supply connected to VCCIO2.
        vccio3-supply:
          description: The supply connected to VCCIO3.
        vccio5-supply:
          description: The supply connected to VCCIO5.
        vccio6-supply:
          description: The supply connected to VCCIO6.

  - if:
      properties:
        compatible:
          contains:
            const: rockchip,rv1108-pmu-io-voltage-domain

    then:
      properties:
        pmu-supply:
          description: The supply connected to PMUIO.

examples:
  - |
    io-domains {
      compatible = "rockchip,rk3288-io-voltage-domain";
      audio-supply = <&vcc18_codec>;
      bb-supply = <&vcc33_io>;
      dvp-supply = <&vcc_18>;
      flash0-supply = <&vcc18_flashio>;
      gpio1830-supply = <&vcc33_io>;
      gpio30-supply = <&vcc33_pmuio>;
      lcdc-supply = <&vcc33_lcd>;
      sdcard-supply = <&vccio_sd>;
      wifi-supply = <&vcc18_wl>;
    };
```

## Documentation/devicetree/bindings/powerpc/nintendo/wiiu.yaml
```yaml
# SPDX-License-Identifier: GPL-2.0-only OR BSD-2-Clause
%YAML 1.2
---

$id: http://devicetree.org/schemas/powerpc/nintendo/wiiu.yaml#
$schema: http://devicetree.org/meta-schemas/core.yaml#

title: Nintendo Wii U bindings

maintainers:
  - Ash Logan <ash@heyquark.com>
  - Emmanuel Gil Peyrot <linkmauve@linkmauve.fr>

description: |
  Nintendo Wii U video game console binding.

properties:
  $nodename:
    const: "/"
  compatible:
    oneOf:
      - description: Nintendo Wii U video game console
        items:
          - const: nintendo,wiiu

additionalProperties: true

...
```

## Documentation/devicetree/bindings/powerpc/nintendo/wiiu/espresso-pic.yaml
```yaml
# SPDX-License-Identifier: (GPL-2.0-only OR BSD-2-Clause)
%YAML 1.2
---
$id: http://devicetree.org/schemas/powerpc/nintendo/wiiu/espresso-pic.yaml#
$schema: http://devicetree.org/meta-schemas/core.yaml#

title: Nintendo Wii U "Espresso" interrupt controller

maintainers:
  - Ash Logan <ash@heyquark.com>
  - Emmanuel Gil Peyrot <linkmauve@linkmauve.fr>

description: |
  Interrupt controller found on the Nintendo Wii U for the "Espresso" processor.

properties:
  compatible:
    oneOf:
      - description: Nintendo Wii U "Espresso" interrupt controller
        items:
          - const: nintendo,espresso-pic
  '#interrupt-cells':
    # Interrupt numbers 0-32 in one cell
    const: 1
  interrupt-controller: true
  reg:
    items:
      - description: Core registers

additionalProperties: false

examples:
  - |
    espresso_pic: pic@c000078 {
            #interrupt-cells = <1>;
            interrupt-controller;

            compatible = "nintendo,espresso-pic";
            reg = <0x0c000078 0x18>;
    };

...
```

## Documentation/devicetree/bindings/powerpc/nintendo/wiiu/gpu7.yaml
```yaml
# SPDX-License-Identifier: (GPL-2.0-only OR BSD-2-Clause)
%YAML 1.2
---
$id: http://devicetree.org/schemas/powerpc/nintendo/wiiu/gpu7.yaml#
$schema: http://devicetree.org/meta-schemas/core.yaml#

title: Nintendo Wii U Latte "GPU7" graphics processor

maintainers:
  - Ash Logan <ash@heyquark.com>
  - Emmanuel Gil Peyrot <linkmauve@linkmauve.fr>

description: |
  GPU7 graphics processor, also known as "GX2", found in the Latte multifunction chip of the
  Nintendo Wii U.

properties:
  compatible:
    oneOf:
      - description: Nintendo Wii U Latte "GPU7" graphics processor
        items:
          - const: nintendo,latte-gpu7
  reg:
    items:
      - description: GpuF0MMReg registers
  interrupts:
    items:
      - description: Main interrupt, connected via Espresso PIC

# This will likely get bound to the Radeon driver one day, which will neccesitate extra properties
additionalProperties: true

examples:
  - |
    gpu7@c200000 {
            compatible = "nintendo,latte-gpu7";
            reg = <0x0c200000 0x80000>;
            interrupts = <2>;
            interrupt-parent = <&espresso_pic>;
    };
...
```

## Documentation/devicetree/bindings/powerpc/nintendo/wiiu/latte-ahci.yaml
```yaml
# SPDX-License-Identifier: (GPL-2.0-only OR BSD-2-Clause)
%YAML 1.2
---
$id: http://devicetree.org/schemas/powerpc/nintendo/wiiu/latte-ahci.yaml#
$schema: http://devicetree.org/meta-schemas/core.yaml#

title: Nintendo Wii U Latte AHCI controller

maintainers:
  - Ash Logan <ash@heyquark.com>
  - Emmanuel Gil Peyrot <linkmauve@linkmauve.fr>

description: |
  Nintendo Wii U AHCI SATA controller, as found in the Latte chip.

properties:
  compatible:
    oneOf:
      - description: Nintendo Wii U Latte AHCI controller
        items:
          - const: nintendo,latte-ahci
  reg:
    items:
      - description: |
          HBA memory registers. Note that unlike the spec, space for only 6 ports exist, with 2 vendor
          registers afterwards, thus register space should be 0x408 long (0x100+0x80*6+0x8).
  interrupts:
    items:
      - description: Main HBA interrupt
      - description: Vendor debugging interrupt

additionalProperties: false

examples:
  - |
    sata: ahci@d160400 {
          compatible = "nintendo,latte-ahci";
          reg = <0x0d160400 0x408>;

          interrupt-parent = <&latte_pic>;
          interrupts = <38>, <28>;
    };
...
```

## Documentation/devicetree/bindings/powerpc/nintendo/wiiu/latte-dsp.yaml
```yaml
# SPDX-License-Identifier: (GPL-2.0-only OR BSD-2-Clause)
%YAML 1.2
---
$id: http://devicetree.org/schemas/powerpc/nintendo/wiiu/latte-dsp.yaml#
$schema: http://devicetree.org/meta-schemas/core.yaml#

title: Nintendo Wii U Latte DSP

maintainers:
  - Ash Logan <ash@heyquark.com>
  - Emmanuel Gil Peyrot <linkmauve@linkmauve.fr>

description: |
  Nintendo Wii U digital signal processor, as found in the Latte chip.

properties:
  compatible:
    oneOf:
      - description: Nintendo Wii U Latte DSP
        items:
          - const: nintendo,latte-dsp
  reg:
    items:
      - description: DSP registers

# Once more is known about this device more properties will likely be added
additionalProperties: true

examples:
  - |
    latte_dsp: dsp@c005000 {
         compatible = "nintendo,latte-dsp";
         reg = <0x0c005000 0x200>;
    };
...
```

## Documentation/devicetree/bindings/powerpc/nintendo/wiiu/latte-pic.yaml
```yaml
# SPDX-License-Identifier: (GPL-2.0-only OR BSD-2-Clause)
%YAML 1.2
---
$id: http://devicetree.org/schemas/powerpc/nintendo/wiiu/latte-pic.yaml#
$schema: http://devicetree.org/meta-schemas/core.yaml#

title: Nintendo Wii U Latte interrupt controller

maintainers:
  - Ash Logan <ash@heyquark.com>
  - Emmanuel Gil Peyrot <linkmauve@linkmauve.fr>

description: |
  Interrupt controller found on the Nintendo Wii U for the "Latte" devices.

properties:
  compatible:
    oneOf:
      - description: Nintendo Wii U Latte interrupt controller
        items:
          - const: nintendo,latte-pic
  '#interrupt-cells':
    # Interrupt numbers 0-64 in one cell.
    const: 1
  interrupt-controller: true
  reg:
    items:
      - description: Core registers
  interrupts:
    items:
      - description: Cascade interrupt for Espresso PIC

additionalProperties: false

examples:
  - |
    latte_pic: pic@d800440 {
         #interrupt-cells = <1>;
         interrupt-controller;

         compatible = "nintendo,latte-pic";
         reg = <0x0d800440 0x30>;
         interrupt-parent = <&espresso_pic>;
         interrupts = <24>;
    };
...
```
