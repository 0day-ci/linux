## Documentation/devicetree/bindings/powerpc/nintendo/wiiu/latte-sdhci.yaml
```yaml
# SPDX-License-Identifier: (GPL-2.0-only OR BSD-2-Clause)
%YAML 1.2
---
$id: http://devicetree.org/schemas/powerpc/nintendo/wiiu/latte-sdhci.yaml#
$schema: http://devicetree.org/meta-schemas/core.yaml#

title: Nintendo Wii U Latte SD Host controller

maintainers:
  - Ash Logan <ash@heyquark.com>
  - Emmanuel Gil Peyrot <linkmauve@linkmauve.fr>

description: |
  SDHCI hosts found on the Nintendo Wii U's Latte SoC for SD cards and SDIO devices.

properties:
  compatible:
    oneOf:
      - description: Nintendo Wii U Latte SDHCI
        items:
          - const: nintendo,latte-sdhci
          - const: sdhci
  reg:
    items:
      - description: Core registers
  interrupts:
    items:
      - description: SDHCI interrupt

additionalProperties: false

examples:
  - |
    sdcard_0: sdhci@d070000 {
          compatible = "nintendo,latte-sdhci","sdhci";
          reg = <0x0d070000 0x200>;
          interrupts = <7>;
          interrupt-parent = <&latte_pic>;
    };
...
```

## Documentation/devicetree/bindings/powerpc/nintendo/wiiu/latte.yaml
```yaml
# SPDX-License-Identifier: (GPL-2.0-only OR BSD-2-Clause)
%YAML 1.2
---
$id: http://devicetree.org/schemas/powerpc/nintendo/wiiu/latte.yaml#
$schema: http://devicetree.org/meta-schemas/core.yaml#

title: Latte system bus

maintainers:
  - Ash Logan <ash@heyquark.com>
  - Emmanuel Gil Peyrot <linkmauve@linkmauve.fr>

description: |
  Latte multi-function SoC, containing many of the devices found on the Nintendo Wii U.

properties:
  compatible:
    oneOf:
      - description: Nintendo Wii U "Latte" SoC
        items:
          - const: nintendo,latte

additionalProperties: true

...
```

## Documentation/devicetree/bindings/pwm/aspeed,ast2600-pwm.yaml
```yaml
# SPDX-License-Identifier: (GPL-2.0-only OR BSD-2-Clause)
# Copyright (C) 2021 ASPEED, Inc.
%YAML 1.2
---
$id: http://devicetree.org/schemas/pwm/aspeed,ast2600-pwm.yaml#
$schema: http://devicetree.org/meta-schemas/core.yaml#

title: ASPEED AST2600 PWM controller

maintainers:
  - Billy Tsai <billy_tsai@aspeedtech.com>

description: |
  The ASPEED PWM controller can support upto 16 PWM outputs.

properties:
  compatible:
    enum:
      - aspeed,ast2600-pwm

  "#pwm-cells":
    const: 3

  reg:
    maxItems: 1

additionalProperties: false

examples:
  - |
    // The PWM should be a subnode of a "aspeed,ast2600-pwm-tach" compatible
    // node.
    pwm_tach: pwm_tach@1e610000 {
      compatible = "aspeed,ast2600-pwm-tach", "syscon", "simple-mfd";
      #address-cells = <1>;
      #size-cells = <1>;
      reg = <0x1e610000 0x100>;

      pwm: pwm@0 {
        compatible = "aspeed,ast2600-pwm";
        #pwm-cells = <3>;
        reg = <0x0 0x100>;
      };
    };
```

## Documentation/devicetree/bindings/pwm/hpe,gxp-fan.txt
```
* HPE GXP Fan Controller

Required properties:
- compatible: Must contain "hpe,gxp-fan-ctrl".
- reg: Physical base address and length of the controller's registers.
- xreg_handle: Phandle to the xregister controller for fan control.
- fn2_handle: Phandle to the FN2 interface.

Example:
	fanctrl: fanctrl@c1000c00 {
			compatible = "hpe,gxp-fan-ctrl";
			reg = <0xc1000c00 0x200>;
			xreg_handle = <&xreg>;
			fn2_handle = <&fn2>;
	};
```

## Documentation/devicetree/bindings/pwm/ipq-pwm.yaml
```yaml
# SPDX-License-Identifier: (GPL-2.0-only OR BSD-2-Clause)
%YAML 1.2
---
$id: http://devicetree.org/schemas/pwm/ipq-pwm.yaml#
$schema: http://devicetree.org/meta-schemas/core.yaml#

title: Qualcomm IPQ6018 PWM controller

maintainers:
  - Baruch Siach <baruch@tkos.co.il>

properties:
  "#pwm-cells":
    const: 2

  compatible:
    const: qcom,ipq6018-pwm

  reg:
    description: Offset of PWM register in the TCSR block.
    maxItems: 1

  clocks:
    maxItems: 1

required:
  - compatible
  - reg
  - clocks
  - "#pwm-cells"

additionalProperties: false

examples:
  - |
    #include <dt-bindings/clock/qcom,gcc-ipq6018.h>

    syscon@1937000 {
        compatible = "qcom,tcsr-ipq6018", "syscon", "simple-mfd";
        reg = <0x01937000 0x21000>;
        #address-cells = <1>;
        #size-cells = <1>;
        ranges = <0 0x1937000 0x21000>;

        pwm: pwm@a010 {
            compatible = "qcom,ipq6018-pwm";
            reg = <0xa010 0x20>;
            clocks = <&gcc GCC_ADSS_PWM_CLK>;
            assigned-clocks = <&gcc GCC_ADSS_PWM_CLK>;
            assigned-clock-rates = <100000000>;
            #pwm-cells = <2>;
        };
    };
```

## Documentation/devicetree/bindings/pwm/pwm-qcom.yaml
```yaml
# SPDX-License-Identifier: GPL-2.0-only OR BSD-2-Clause
%YAML 1.2
---
$id: http://devicetree.org/schemas/pwm/pwm-qcom.yaml#
$schema: http://devicetree.org/meta-schemas/core.yaml#

title: Qualcomm Technologies, Inc. PMIC PWM bindings

maintainers:
  - Fenglin Wu <fenglinw@codeaurora.org>

description:
  PWM modules inside Qualcomm Technologies, Inc. PMICs can be accessed through
  SPMI bus and normally one PMIC would have multiple PWM modules with adjacent
  SPMI address space.

Properties:
  compatible:
    const: qcom,pwm

  reg:
    description:
      The SPMI address base of the PWM module, if there are multiple PWM
      modules present with adjacent SPMI address space, only need to specify
      the address base of the 1st PWM module.

  "#pwm-cells":
     # See pwm.yaml in this directory for a description of the cells format.
     const: 2

  qcom,num-channels:
    description:
      The number of the PWM channels (modules) with the adjacent SPMI address
      space following the address base in "reg" property.

required:
  - compatible
  - reg
  - "#pwm-cells"
  - qcom,num-channels

additionalProperties: false

examples:
  - |
    pm8350c_pwm: pwms@e800 {
        compatible = "qcom,pwm";
        reg = <0xe800>;
        #pwm-cells = <2>;
        qcom,num-channels = <4>;
    };
```

## Documentation/devicetree/bindings/pwm/pwm-rockchip.yaml
```yaml
# SPDX-License-Identifier: GPL-2.0
%YAML 1.2
---
$id: http://devicetree.org/schemas/pwm/pwm-rockchip.yaml#
$schema: http://devicetree.org/meta-schemas/core.yaml#

title: Rockchip PWM controller

maintainers:
  - Heiko Stuebner <heiko@sntech.de>

properties:
  compatible:
    oneOf:
      - const: rockchip,rk2928-pwm
      - const: rockchip,rk3288-pwm
      - const: rockchip,vop-pwm
      - items:
          - enum:
              - rockchip,rv1108-pwm
          - const: rockchip,rk3288-pwm

  reg:
    maxItems: 1

  clocks:
    minItems: 1
    maxItems: 2
    description:
      For older hardware (rk2928, rk3066, rk3188, rk3228, rk3288, rk3399)
        There is one clock that is used both to derive the functional clock
        for the device and as the bus clock.
      For newer hardware (rk3328 and future SoCs) that is also specified
      with clock names.
        "pwm" is used to derive the functional clock for the device.
        "pclk" is used as the APB bus clock.

  clock-names:
    minItems: 1
    items:
      - const: pwm
      - const: pclk

  "#pwm-cells":
    enum: [2, 3]
    description:
      Must be 2 (rk2928) or 3 (rk3288).
      See pwm.yaml for a description of the cell format.

additionalProperties: false

required:
  - compatible
  - reg
  - clocks
  - "#pwm-cells"

examples:
  - |
    #include <dt-bindings/clock/rk3188-cru-common.h>
    pwm0: pwm@20030000 {
      compatible = "rockchip,rk2928-pwm";
      reg = <0x20030000 0x10>;
      clocks = <&cru PCLK_PWM01>;
      #pwm-cells = <2>;
    };
```

## Documentation/devicetree/bindings/pwm/pwm-sunplus.yaml
```yaml
# SPDX-License-Identifier: (GPL-2.0-only OR BSD-2-Clause)
# Copyright (C) Sunplus Co., Ltd. 2021
%YAML 1.2
---
$id: http://devicetree.org/schemas/pwm/pwm-sunplus.yaml#
$schema: http://devicetree.org/meta-schemas/core.yaml#

title: Sunplus SoC PWM Controller

maintainers:
  - Hammer Hsieh <hammer.hsieh@sunplus.com>

properties:
  '#pwm-cells':
    const: 2

  compatible:
    items:
      - const: sunplus,sp7021-pwm

  reg:
    maxItems: 1

  clocks:
    maxItems: 1

  resets:
    maxItems: 1

required:
  - '#pwm-cells'
  - compatible
  - reg
  - clocks

additionalProperties: false

examples:
  - |
    pwm: pwm@9c007a00 {
      #pwm-cells = <2>;
      compatible = "sunplus,sp7021-pwm";
      reg = <0x9c007a00 0x80>;
      clocks = <&clkc 0xa2>;
    };
```

## Documentation/devicetree/bindings/pwm/xlnx,axi-timer.yaml
```yaml
# SPDX-License-Identifier: GPL-2.0 OR BSD-2-Clause
%YAML 1.2
---
$id: http://devicetree.org/schemas/pwm/xlnx,axi-timer.yaml#
$schema: http://devicetree.org/meta-schemas/core.yaml#

title: Xilinx LogiCORE IP AXI Timer Device Tree Binding

maintainers:
  - Sean Anderson <sean.anderson@seco.com>

properties:
  compatible:
    oneOf:
      - items:
        - const: xlnx,axi-timer-2.0
        - const: xlnx,xps-timer-1.00.a
      - const: xlnx,xps-timer-1.00.a

  clocks:
    maxItems: 1

  clock-names:
    const: s_axi_aclk

  reg:
    maxItems: 1

  xlnx,count-width:
    $ref: /schemas/types.yaml#/definitions/uint32
    minimum: 8
    maximum: 32
    description:
      The width of the counter(s), in bits.

  xlnx,gen0-assert:
    $ref: /schemas/types.yaml#/definitions/uint32
    enum: [ 0, 1 ]
    default: 1
    deprecated: true
    description:
      The polarity of the generateout0 signal. 0 for active-low, 1 for active-high.

  xlnx,gen0-active-low:
    $ref: /schemas/types.yaml#/definitions/flag
    description:
      The generate0 signal is active-low.

  xlnx,gen1-assert:
    $ref: /schemas/types.yaml#/definitions/uint32
    enum: [ 0, 1 ]
    default: 1
    deprecated: true
    description:
      The polarity of the generateout1 signal. 0 for active-low, 1 for active-high.

  xlnx,gen1-active-low:
    $ref: /schemas/types.yaml#/definitions/flag
    description:
      The generate1 signal is active-low.

  xlnx,one-timer-only:
    $ref: /schemas/types.yaml#/definitions/uint32
    enum: [ 0, 1 ]
    deprecated: true
    description:
      Whether only one timer is present in this block.

  xlnx,single-timer:
    $ref: /schemas/types.yaml#/definitions/flag
    description:
      Only one timer is present in this block.

  xlnx,pwm:
    $ref: /schemas/types.yaml#/definitions/flag
    description:
      This timer should be configured as a PWM.

required:
  - compatible
  - reg
  - xlnx,count-width

allOf:
  - if:
      required:
        - clocks
    then:
      required:
        - clock-names

  - if:
      required:
        - xlnx,gen0-active-low
    then:
      not:
        required:
          - xlnx,gen0-assert

  - if:
      required:
        - xlnx,gen0-active-low
    then:
      not:
        required:
          - xlnx,gen0-assert

  - if:
      required:
        - xlnx,one-timer-only
    then:
      not:
        required:
          - xlnx,single-timer

additionalProperties: true

examples:
  - |
    axi_timer_0: timer@800e0000 {
        clock-names = "s_axi_aclk";
        clocks = <&zynqmp_clk 71>;
        compatible = "xlnx,axi-timer-2.0", "xlnx,xps-timer-1.00.a";
        reg = <0x800e0000 0x10000>;
        xlnx,count-width = <0x20>;
        xlnx,gen0-assert = <0x1>;
        xlnx,gen1-assert = <0x1>;
        xlnx,one-timer-only = <0x0>;
        xlnx,trig0-assert = <0x1>;
        xlnx,trig1-assert = <0x1>;
    };

  - |
    axi_timer_0: timer@800e0000 {
        clock-names = "s_axi_aclk";
        clocks = <&zynqmp_clk 71>;
        compatible = "xlnx,axi-timer-2.0", "xlnx,xps-timer-1.00.a";
        reg = <0x800e0000 0x10000>;
        xlnx,count-width = <0x20>;
        xlnx,gen0-active-low;
        xlnx,single-timer;
    };
```

## Documentation/devicetree/bindings/regulator/da9063-regulator.yaml
```yaml
# SPDX-License-Identifier: (GPL-2.0-only OR BSD-2-Clause)
%YAML 1.2
---
$id: http://devicetree.org/schemas/regulator/da9063-regulator.yaml#
$schema: http://devicetree.org/meta-schemas/core.yaml#

title: Regulator driver for Dialog DA9063/DA9063L Power Management Integrated Circuit (PMIC)

maintainers:
  - Support Opensource <support.opensource@diasemi.com>

description: |
  This module is part of the DA9063 MFD device. For more details, see
  Documentation/devicetree/bindings/mfd/da9063.yaml.

  The regulator controller is represented as a sub-node of the PMIC node
  on the device tree.

  This node defines the settings for the LDOs and BUCKs.
  The DA9063(L) regulators are bound using their names listed below:

  bcore1    : BUCK CORE1
  bcore2    : BUCK CORE2
  bpro      : BUCK PRO
  bmem      : BUCK MEM
  bio       : BUCK IO
  bperi     : BUCK PERI
  ldo1      : LDO_1	(DA9063 only)
  ldo2      : LDO_2	(DA9063 only)
  ldo3      : LDO_3
  ldo4      : LDO_4	(DA9063 only)
  ldo5      : LDO_5	(DA9063 only)
  ldo6      : LDO_6	(DA9063 only)
  ldo7      : LDO_7
  ldo8      : LDO_8
  ldo9      : LDO_9
  ldo10     : LDO_10	(DA9063 only)
  ldo11     : LDO_11

  The component follows the standard regulator framework and the bindings
  details of individual regulator device can be found in:
  Documentation/devicetree/bindings/regulator/regulator.txt

properties:
  compatible:
    const: dlg,da9063-regulator

required:
  - compatible

additionalProperties: false
```

## Documentation/devicetree/bindings/regulator/maxim,max77686.yaml
```yaml
# SPDX-License-Identifier: GPL-2.0-only OR BSD-2-Clause
%YAML 1.2
---
$id: http://devicetree.org/schemas/regulator/maxim,max77686.yaml#
$schema: http://devicetree.org/meta-schemas/core.yaml#

title: Maxim MAX77686 Power Management IC regulators

maintainers:
  - Chanwoo Choi <cw00.choi@samsung.com>
  - Krzysztof Kozlowski <krzysztof.kozlowski@canonical.com>

description: |
  This is a part of device tree bindings for Maxim MAX77686 Power Management
  Integrated Circuit (PMIC).

  The Maxim MAX77686 provides high-efficiency Buck and 26 Low-DropOut (LDO)
  regulators.

  See also Documentation/devicetree/bindings/mfd/maxim,max77686.yaml for
  additional information and example.

patternProperties:
  # 26 LDOs
  "^LDO([1-9]|1[0-9]|2[0-6])$":
    type: object
    $ref: regulator.yaml#
    description: |
      Properties for single LDO regulator.
      Regulators which can be turned off during system suspend:
        LDO2, LDO6-8, LDO10-12, LDO14-16

    properties:
      regulator-name: true

      maxim,ena-gpios:
        maxItems: 1
        description: |
          GPIO specifier to enable the GPIO control (on/off) for regulator.

    required:
      - regulator-name

    unevaluatedProperties: false

    allOf:
      - if:
          properties:
            $nodename:
              pattern: "^(LDO20|LDO21|LDO22|BUCK8|BUCK9)$"
        then:
          properties:
            maxim,ena-gpios: true
        else:
          properties:
            maxim,ena-gpios: false

  # 9 bucks
  "^BUCK[1-9]$":
    type: object
    $ref: regulator.yaml#
    description: |
      Properties for single BUCK regulator.
      Regulators which can be turned off during system suspend:
      BUCK[1-4]

    properties:
      regulator-name: true

      maxim,ena-gpios:
        maxItems: 1
        description: |
          GPIO specifier to enable the GPIO control (on/off) for regulator.

    required:
      - regulator-name

    unevaluatedProperties: false

    allOf:
      - if:
          properties:
            $nodename:
              pattern: "^(LDO20|LDO21|LDO22|BUCK8|BUCK9)$"
        then:
          properties:
            maxim,ena-gpios: true
        else:
          properties:
            maxim,ena-gpios: false

additionalProperties: false
```
