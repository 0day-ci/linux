## Documentation/devicetree/bindings/spi/fsl,spi-fsl-dspi.yaml
```yaml
# SPDX-License-Identifier: (GPL-2.0-only OR BSD-2-Clause)
%YAML 1.2
---
$id: http://devicetree.org/schemas/spi/fsl,spi-fsl-dspi.yaml#
$schema: http://devicetree.org/meta-schemas/core.yaml#

title: Freescale DSPI Controller

maintainers:
  - Vladimir Oltean <olteanv@gmail.com>

allOf:
  - $ref: "spi-controller.yaml#"

properties:
  compatible:
    oneOf:
      - enum:
          - fsl,vf610-dspi
          - fsl,ls1021a-v1.0-dspi
          - fsl,ls1028a-dspi
          - fsl,ls2085a-dspi
          - fsl,lx2160a-dspi
      - items:
          - enum:
              - fsl,ls1012a-dspi
              - fsl,ls1028a-dspi
              - fsl,ls1043a-dspi
              - fsl,ls1046a-dspi
              - fsl,ls1088a-dspi
          - const: fsl,ls1021a-v1.0-dspi
      - items:
          - enum:
              - fsl,ls2080a-dspi
              - fsl,lx2160a-dspi
          - const: fsl,ls2085a-dspi

  reg:
    maxItems: 1
    description: Offset and length of registers

  interrupts:
    maxItems: 1

  clocks:
    items:
      - description: SoC dspi clock

  clock-names:
    items:
      - const: dspi

  pinctrl-names:
    minItems: 1
    items:
      - const: default
    description:
      Names for the pin configuration must be "default"

  dmas:
    maxItems: 2

  dma-names:
    items:
      - const: tx
      - const: rx

  spi-num-chipselects:
    maxItems: 1
    description: Number of the chipselect signals

  bus-num:
    items:
      - description: Slave chip chipselect signal number

patternProperties:
  "@[0-9a-f]+":
    type: object

    properties:
      fsl,spi-cs-sck-delay:
        description:
          Delay in nanoseconds between activating chip select and the start of
          clock signal, at the start of a transfer.
        $ref: /schemas/types.yaml#/definitions/uint32

      fsl,spi-sck-cs-delay:
        description:
          Delay in nanoseconds between stopping the clock signal and
          deactivating chip select, at the end of a transfer.
        $ref: /schemas/types.yaml#/definitions/uint32

required:
  - compatible
  - reg
  - interrupts
  - clocks
  - clock-names
  - spi-num-chipselects

unevaluatedProperties: false

examples:
  - |
    #include <dt-bindings/clock/fsl,qoriq-clockgen.h>
    #include <dt-bindings/interrupt-controller/arm-gic.h>

    soc {
        #address-cells = <2>;
        #size-cells = <2>;

        spi@2100000 {
            compatible = "fsl,ls1028a-dspi", "fsl,ls1021a-v1.0-dspi";
            #address-cells = <1>;
            #size-cells = <0>;
            reg = <0x0 0x2100000 0x0 0x10000>;
            interrupts = <GIC_SPI 26 IRQ_TYPE_LEVEL_HIGH>;
            clock-names = "dspi";
            clocks = <&clockgen QORIQ_CLK_PLATFORM_PLL QORIQ_CLK_PLL_DIV(2)>;
            dmas = <&edma0 0 62>, <&edma0 0 60>;
            dma-names = "tx", "rx";
            spi-num-chipselects = <4>;
            little-endian;

            flash@0 {
                compatible = "jedec,spi-nor";
                spi-max-frequency = <10000000>;
                reg = <0>;
            };
        };
    };
```

## Documentation/devicetree/bindings/spi/hpe,gxp-spifi.txt
```
* HPE GXP SPI FLASH INTERFACE

Required properties:
  - compatible : Must contain: "hpe,gxp-spifi"
  - reg : the first contains the control register location and length,
          the second contains the memory window mapping address and length,
		  the third contains the configuration register location and length
  - interrupts: The interrupt number.
  - #address-cells : must be 1 corresponding to chip select child binding
  - #size-cells : must be 0 corresponding to chip select child binding

The child nodes are the SPI flash modules which must have a compatible
property as specified in bindings/mtd/jedec,spi-nor.txt

Example:
	spifi0: spifi@c0000200 {
		compatible = "hpe,gxp-spifi";
		reg = <0xc0000200 0x80>, <0xc000c000 0x100>, <0xf8000000 0x8000000>;
		interrupts = <20>;
		interrupt-parent = <&vic0>;
		#address-cells = <1>;
		#size-cells = <0>;

		flash@0 {
			compatible = "jedec,spi-nor";
			reg = <0>;
			partitions {
				compatible = "fixed-partitions";
				#address-cells = <1>;
				#size-cells = <1>;

				u-boot@0 {
					label = "u-boot";
					reg = <0x0 0x60000>;
				};
				u-boot-env@60000 {
					label = "u-boot-env";
					reg = <0x60000 0x20000>;
				};
				kernel@80000 {
					label = "kernel";
					reg = <0x80000 0x4c0000>;
				};
				rofs@540000 {
					label = "rofs";
					reg = <0x540000 0x1740000>;
				};
				rwfs@1c80000 {
					label = "rwfs";
					reg = <0x1c80000 0x250000>;
				};
				section@1edf000{
					label = "section";
					reg = <0x1ed0000 0x130000>;
				};
			};
		};

		flash@1 {
			compatible = "jedec,spi-nor";
			reg = <1>;
			partitions {
				compatible = "fixed-partitions";
				#address-cells = <1>;
				#size-cells = <1>;
				host-prime@0 {
					label = "host-prime";
					reg = <0x0 0x02000000>;
				};
				host-second@2000000 {
					label = "host-second";
					reg = <0x02000000 0x02000000>;
				};
			};
		};
	};
```

## Documentation/devicetree/bindings/spi/spi-nxp-fspi.yaml
```yaml
# SPDX-License-Identifier: (GPL-2.0-only OR BSD-2-Clause)
%YAML 1.2
---
$id: http://devicetree.org/schemas/spi/spi-nxp-fspi.yaml#
$schema: http://devicetree.org/meta-schemas/core.yaml#

title: NXP Flex Serial Peripheral Interface (FSPI)

maintainers:
  - Ashish Kumar <ashish.kumar@nxp.com>

allOf:
  - $ref: "/schemas/spi/spi-controller.yaml#"

properties:
  compatible:
    enum:
      - nxp,lx2160a-fspi
      - nxp,imx8mm-fspi
      - nxp,imx8mp-fspi
      - nxp,imx8qxp-fspi
      - nxp,imx8dxl-fspi

  reg:
    items:
      - description: register location and length
      - description: memory mapping address and length

  reg-names:
    items:
      - const: fspi_base
      - const: fspi_mmap

  interrupts:
    maxItems: 1

  clocks:
    items:
      - description: SPI Bus clock
      - description: SPI Serial clock

  clock-names:
    items:
      - const: fspi_en
      - const: fspi

required:
  - compatible
  - reg
  - reg-names
  - interrupts
  - clocks
  - clock-names

unevaluatedProperties: false

examples:
  - |
    #include <dt-bindings/interrupt-controller/arm-gic.h>
    #include <dt-bindings/clock/fsl,qoriq-clockgen.h>

    soc {
        #address-cells = <2>;
        #size-cells = <2>;

        fspi0: spi@20c0000 {
            compatible = "nxp,lx2160a-fspi";
            reg = <0x0 0x20c0000 0x0 0x10000>,
                  <0x0 0x20000000 0x0 0x10000000>;
            reg-names = "fspi_base", "fspi_mmap";
            interrupts = <0 25 0x4>; /* Level high type */
            clocks = <&clockgen 4 3>, <&clockgen 4 3>;
            clock-names = "fspi_en", "fspi";
            #address-cells = <1>;
            #size-cells = <0>;

            mt35xu512aba0: flash@0 {
                compatible = "jedec,spi-nor";
                reg = <0>;
            };

            mt35xu512aba1: flash@1 {
                compatible = "jedec,spi-nor";
                reg = <1>;
            };
        };
    };
```

## Documentation/devicetree/bindings/spi/spi-slave-props.yaml
```yaml
# SPDX-License-Identifier: (GPL-2.0 OR BSD-2-Clause)
%YAML 1.2
---
$id: http://devicetree.org/schemas/spi/spi-slave-props.yaml#
$schema: http://devicetree.org/meta-schemas/core.yaml#

title: Slave-specific properties for a SPI bus.

description: |
  Many SPI controllers need to add properties to slave devices. This could be
  the delay in clock or data lines, etc. These properties are controller
  specific but need to be defined in the slave node because they are per-slave
  and there can be multiple slaves attached to a controller.

  If these properties are not added to the slave binding, then the dtbs check
  emits a warning. But these properties do not make much sense in the slave
  binding because they are controller-specific and they will just pollute every
  slave binding. So this binding is added to collect all such properties from
  all such controllers. Slave bindings should simply refer to this binding and
  they should be rid of the warnings.

maintainers:
  - Pratyush Yadav <p.yadav@ti.com>

properties:
  # cdns,qspi-nor.yaml
  cdns,read-delay:
    $ref: /schemas/types.yaml#/definitions/uint32
    description:
      Delay for read capture logic, in clock cycles.

  cdns,tshsl-ns:
    description:
      Delay in nanoseconds for the length that the master mode chip select
      outputs are de-asserted between transactions.

  cdns,tsd2d-ns:
    description:
      Delay in nanoseconds between one chip select being de-activated
      and the activation of another.

  cdns,tchsh-ns:
    description:
      Delay in nanoseconds between last bit of current transaction and
      deasserting the device chip select (qspi_n_ss_out).

  cdns,tslch-ns:
    description:
      Delay in nanoseconds between setting qspi_n_ss_out low and
      first bit transfer.

additionalProperties: true
```

## Documentation/devicetree/bindings/spi/spi-sunplus-sp7021.yaml
```yaml
# SPDX-License-Identifier: (GPL-2.0 OR BSD-2-Clause)
# Copyright (C) Sunplus Co., Ltd. 2021
%YAML 1.2
---
$id: http://devicetree.org/schemas/spi/spi-sunplus-sp7021.yaml#
$schema: http://devicetree.org/meta-schemas/core.yaml#

title: Sunplus sp7021 SPI controller

allOf:
  - $ref: "spi-controller.yaml"

maintainers:
  - lh.kuo <lh.kuo@sunplus.com>

properties:
  compatible:
    enum:
      - sunplus,sp7021-spi-controller

  reg:
    items:
      - description: Base address and length of the SPI master registers
      - description: Base address and length of the SPI slave registers

  reg-names:
    items:
      - const: spi_master
      - const: spi_slave

  interrupt-names:
    items:
      - const: dma_w_intr
      - const: mas_risc_intr
      - const: slave_risc_intr

  interrupts:
    minItems: 3

  clocks:
    maxItems: 1

  clocks-names:
    items:
      - const: sys_pll

  resets:
    maxItems: 1

  pinctrl-names:
    description:
      A pinctrl state named "default" must be defined.
    const: default

  pinctrl-0:
    description:
      A phandle to the default pinctrl state.

required:
  - compatible
  - reg
  - reg-names
  - interrupts
  - interrupt-names
  - clocks
  - clocks-names
  - resets
  - pinctrl-names
  - pinctrl-0

additionalProperties: false

examples:
  - |
    #include <dt-bindings/clock/sp-sp7021.h>
    #include <dt-bindings/reset/sp-sp7021.h>
    #include <dt-bindings/interrupt-controller/irq.h>
    spi_controller0: spi@9C002D80 {
        compatible = "sunplus,sp7021-spi-controller";
        reg = <0x9C002D80 0x80>, <0x9C002E00 0x80>;
        reg-names = "spi_master", "spi_slave";
        interrupt-parent = <&intc>;
        interrupt-names = "dma_w_intr",
                          "mas_risc_intr",
                          "slave_risc_intr";
        interrupts = <144 IRQ_TYPE_LEVEL_HIGH>,
                     <146 IRQ_TYPE_LEVEL_HIGH>,
                     <145 IRQ_TYPE_LEVEL_HIGH>;
        clocks = <&clkc SPI_COMBO_0>;
        clocks-names = "sys_pll";
        resets = <&rstc RST_SPI_COMBO_0>;
        pinctrl-names = "default";
        pinctrl-0 = <&pins_spi0>;
    };
...
```

## Documentation/devicetree/bindings/spmi/qcom,spmi-pmic-arb.yaml
```yaml
# SPDX-License-Identifier: GPL-2.0
%YAML 1.2
---
$id: http://devicetree.org/schemas/spmi/qcom,spmi-pmic-arb.yaml#
$schema: http://devicetree.org/meta-schemas/core.yaml#

title: Qualcomm SPMI Controller (PMIC Arbiter)

maintainers:
  - Bjorn Andersson <bjorn.andersson@linaro.org>

description: |
  The SPMI PMIC Arbiter is found on Snapdragon chipsets. It is an SPMI
  controller with wrapping arbitration logic to allow for multiple on-chip
  devices to control a single SPMI master.

  The PMIC Arbiter can also act as an interrupt controller, providing
  interrupts to slave devices. See
  Documentation/devicetree/bindings/spmi/spmi.yaml for the generic SPMI
  controller binding requirements for child nodes. See
  Documentation/devicetree/bindings/interrupt-controller/interrupts.txt for
  generic interrupt controller binding documentation.

allOf:
  - $ref: spmi.yaml#

properties:

  $nodename:
    pattern: "spmi@[0-9a-f]"

  compatible:
    const: qcom,spmi-pmic-arb

  reg:
    minItems: 3
    items:
      - description: SPMI core registers
      - description: SPMI interrupt controller registers
      - description: SPMI configuration registers
      - description: SPMI tx-channel per virtual slave registers, for V2 PMIC Arbiter
      - description: SPMI rx-channel (called observer) per virtual slave registers, for V2 PMIC Arbiter

  reg-names:
    minItems: 3
    items:
      - const: core
      - const: intr
      - const: cnfg
      - const: chnls
      - const: obsrvr

  interrupts:
    maxItems: 1

  interrupt-names:
    items:
      - const: periph_irq

  qcom,ee:
    description: |
      indicates the active Execution Environment identifier. Valid values 0 to 5
    $ref: /schemas/types.yaml#/definitions/uint32-array

  qcom,channel:
    description: |
      PMIC Arb which provides channels to use for accesses. Valid values 0 to 5
    $ref: /schemas/types.yaml#/definitions/uint32-array

required:
  - compatible
  - reg
  - reg-names
  - interrupts
  - interrupt-names
  - qcom,ee
  - qcom,channel

patternProperties:
  "@[0-9a-f]$":
    type: object

    description: |
      PMIC properties, which are specific to the used SPMI PMIC device(s).

unevaluatedProperties: false

examples:
  - |
    bus {
      #address-cells = <2>;
      #size-cells = <2>;

      spmi: spmi@fff24000 {
        compatible = "qcom,spmi-pmic-arb";
        #address-cells = <2>;
        #size-cells = <0>;
        reg-names = "core", "intr", "cnfg";
        reg = <0x0 0xfc4cf000 0x0 0x1000>,
              <0x0 0xfc4cb000 0x0 0x1000>,
              <0x0 0xfc4ca000 0x0 0x1000>;

        interrupt-names = "periph_irq";
        interrupts = <0 190 0>;

        qcom,ee = <0>;
        qcom,channel = <0>;

        pmic@0 {
          reg = <0 0>;
          /* pmic properties */
        };
      };
    };
```

## Documentation/devicetree/bindings/staging/arm,zynpu.yaml
```yaml
# SPDX-License-Identifier: (GPL-2.0-only OR BSD-2-Clause)
%YAML 1.2
---
$id: http://devicetree.org/schemas/staging/arm,zynpu.yaml#
$schema: http://devicetree.org/meta-schemas/core.yaml#

title: ARM ZHOUYI AI accelerator bindings

maintainers:
  - Cai Huoqing <caihuoqing@baidu.com>

description:
  Supports ZHOUYI AI accelerator in ARM SOC.

properties:
  compatible:
    const: armchina,zhouyi-v1

  reg:
    maxItems: 1

  device_type:
    const: zynpu

  cma-reserved-bytes:
    default: 0

  interrupts:
    maxItems: 1

  clocks:
    maxItems: 3

required:
  - compatible
  - reg
  - device_type
  - cma-reserved-bytes
  - interrupts
  - clocks

additionalProperties: false

examples:
  - |
    #include <dt-bindings/interrupt-controller/arm-gic.h>
    soc {
        #address-cells = <2>;
        #size-cells = <2>;
        zynpu@03050000 {
            compatible = "armchina,zhouyi-v1";
            reg = <0x0 0x03050000 0x0 0x1000>;
            device_type = "zynpu";
            cma-reserved-bytes = <0x2600000>;
            interrupts = <GIC_SPI 64 IRQ_TYPE_EDGE_RISING>;
            clocks = <&clk_zynpu>,
                     <&clk_pll_zynpu>,
                     <&clk_zynpu_slv>;
        };
    };
...
```
