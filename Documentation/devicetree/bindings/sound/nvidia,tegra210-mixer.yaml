## Documentation/devicetree/bindings/sound/ti,tlv320adc3xxx.yaml
```yaml
# SPDX-License-Identifier: (GPL-2.0-only OR BSD-2-Clause)
%YAML 1.2
---
$id: http://devicetree.org/schemas/sound/ti,tlv320adc3xxx.yaml#
$schema: http://devicetree.org/meta-schemas/core.yaml#

title: Texas Instruments TLV320ADC3001/TLV320ADC3101 Stereo ADC

maintainers:
  - Ricard Wanderlof <ricardw@axis.com>

description: |
  Texas Instruments TLV320ADC3001 and TLV320ADC3101 Stereo ADC
  https://www.ti.com/product/TLV320ADC3001
  https://www.ti.com/product/TLV320ADC3101

properties:
  compatible:
    enum:
      - ti,tlv320adc3001
      - ti,tlv320adc3101

  reg:
    maxItems: 1
    description: I2C address

  "#sound-dai-cells":
    const: 0

  gpios:
    maxItems: 1
    description: GPIO pin used for codec reset (RESET pin)

  clocks:
    maxItems: 1
    description: Master clock (MCLK)

  ti,pll-mode:
    $ref: /schemas/types.yaml#/definitions/uint32
    enum:
      - 0 # ADC3XXX_PLL_DONT_SET - leave mode unchanged
      - 1 # ADC3XXX_PLL_ENABLE - use the on-chip PLL
      - 2 # ADC3XXX_PLL_BYPASS - do not use the on-chip PLL
      - 3 # ADC3XXX_PLL_AUTO - use on-chip PLL if possible
    default: 0
    description: |
      Set on-chip PLL mode.
      ADC3XXX_PLL_DONT_SET is intended for use when setting the clock mod
      via the clock id in a machine driver and it is not to be changed
      from the previous setting.
      ADC3XXX_PLL_AUTO will enable  on-chip PLL if possible, depending on the
      master clock and sample rate combination.

  ti,dmdin-gpio1:
    $ref: /schemas/types.yaml#/definitions/uint32
    enum:
      - 0 # ADC3XXX_GPIO_DISABLED       - I/O buffers powered down and not used
      - 1 # ADC3XXX_GPIO_INPUT          - Various non-GPIO input functions
      - 2 # ADC3XXX_GPIO_GPI            - General purpose input
      - 3 # ADC3XXX_GPIO_GPO            - General purpose output
      - 4 # ADC3XXX_GPIO_CLKOUT         - Clock source set in CLKOUT_MUX reg
      - 5 # ADC3XXX_GPIO_INT1           - INT1 output
      - 6 # ADC3XXX_GPIO_SECONDARY_BCLK - Codec interface secondary BCLK
      - 7 # ADC3XXX_GPIO_SECONDARY_WCLK - Codec interface secondary WCLK
    default: 0
    description: |
      Configuration for DMDIN/GPIO1 pin.

      When ADC3XXX_GPIO_GPO is configured, this causes corresponding the
      ALSA control "GPIOx Output" to appear, as a switch control.

      Note that there is currently no support for reading the GPIO pins as
      inputs.

  ti,dmclk-gpio2:
    $ref: /schemas/types.yaml#/definitions/uint32
    enum:
      - 0 # ADC3XXX_GPIO_DISABLED       - I/O buffers powered down and not used
      - 1 # ADC3XXX_GPIO_INPUT          - Various non-GPIO input functions
      - 2 # ADC3XXX_GPIO_GPI            - General purpose input
      - 3 # ADC3XXX_GPIO_GPO            - General purpose output
      - 4 # ADC3XXX_GPIO_CLKOUT         - Clock source set in CLKOUT_MUX reg
      - 5 # ADC3XXX_GPIO_INT1           - INT1 output
      - 6 # ADC3XXX_GPIO_SECONDARY_BCLK - Codec interface secondary BCLK
      - 7 # ADC3XXX_GPIO_SECONDARY_WCLK - Codec interface secondary WCLK
    default: 0
    description: |
      Configuration for DMCLK/GPIO2 pin.

      When ADC3XXX_GPIO_GPO is configured, this causes corresponding the
      ALSA control "GPIOx Output" to appear, as a switch control.

      Note that there is currently no support for reading the GPIO pins as
      inputs.

required:
  - compatible
  - reg

additionalProperties: false

examples:
  - |

    #include <dt-bindings/gpio/gpio.h>
    #include <dt-bindings/sound/tlv320adc3xxx.h>

    i2c {
        #address-cells = <1>;
        #size-cells = <0>;
        tlv320adc3101: tlv320adc3101@18 {
            compatible = "ti,tlv320adc3101";
            reg = <0x18>;
            gpios = <&gpio_pc 3 GPIO_ACTIVE_LOW>;
            clocks = <&audio_mclk>;
            ti,pll-mode = <ADC3XXX_PLL_BYPASS>;
            ti,dmdin-gpio1 = <ADC3XXX_GPIO_GPO>;
        };
    };

    audio_mclk: clock {
        compatible = "fixed-clock";
        #clock-cells = <0>;
        clock-frequency = <24576000>;
    };
...
```

## Documentation/devicetree/bindings/spi/cadence-quadspi.yaml
```yaml
# SPDX-License-Identifier: GPL-2.0-only
%YAML 1.2
---
$id: http://devicetree.org/schemas/spi/cadence-quadspi.yaml#
$schema: http://devicetree.org/meta-schemas/core.yaml#

title: Cadence Quad SPI controller

maintainers:
  - Ramuthevar Vadivel Murugan <vadivel.muruganx.ramuthevar@linux.intel.com>
  - Brad Larson <brad@pensando.io>

properties:
  compatible:
    contains:
      enum:
        - cdns,qspi-nor       # Generic default
        - ti,k2g-qspi         # TI 66AK2G SoC
        - ti,am654-ospi       # TI AM654 SoC
        - intel,lgm-qspi      # Intel LGM SoC
        - pensando,cdns-qspi  # Pensando Elba SoC

  '#address-cells':
    const: 1

  '#size-cells':
    const: 0

  reg:
    minItems: 2
    maxItems: 2
    description: |
      Contains two entries, each of which is a tuple consisting of a
      physical address and length. The first entry is the address and
      length of the controller register set. The second entry is the
      address and length of the QSPI Controller data area.

  interrupts:
    maxItems: 1
    description: Unit interrupt specifier for the controller interrupt

  clocks:
    description: phandle to the Quad SPI clock

  cdns,fifo-depth:
    $ref: /schemas/types.yaml#/definitions/uint32
    description: Size of the data FIFO in words

  cdns,fifo-width:
    $ref: /schemas/types.yaml#/definitions/uint32
    description: Bus width of the data FIFO in bytes

  cdns,trigger-address:
    $ref: /schemas/types.yaml#/definitions/uint32
    description: 32-bit indirect AHB trigger address

  cdns,is-decoded-cs:
    $ref: /schemas/types.yaml#/definitions/flag
    description: Flag to indicate whether decoder is used or not

  cdns,rclk-en:
    description:
      Flag to indicate that QSPI return clock is used to latch the
      read data rather than the QSPI clock. Make sure that QSPI return
      clock is populated on the board before using this property
    $ref: /schemas/types.yaml#/definitions/flag

  # Subnodes of the Cadence Quad SPI controller are spi slave nodes 
  # with additional custom properties
  cdns,read-delay:
    $ref: /schemas/types.yaml#/definitions/uint32
    description: Delay for read capture logic, in clock cycles

  cdns,tshsl-ns:
    $ref: /schemas/types.yaml#/definitions/uint32
    description:
      Delay in nanoseconds for the length that the master mode chip
      select outputs are de-asserted between transactions

  cdns,tsd2d-ns:
    $ref: /schemas/types.yaml#/definitions/uint32
    description:
      Delay in nanoseconds between one chip select being de-activated
      and the activation of another.

  cdns,tchsh-ns:
    $ref: /schemas/types.yaml#/definitions/uint32
    description:
      Delay in nanoseconds between last bit of current transaction and
      deasserting the device chip select (qspi_n_ss_out).

  cdns,tslch-ns:
    $ref: /schemas/types.yaml#/definitions/uint32
    description:
      Delay in nanoseconds between setting qspi_n_ss_out low and first
      bit transfer.

  resets:
    items:
      - description: qspi reset
      - description: qspi-ocp reset

  reset-names:
    items:
      - const: qspi
      - const: qspi-ocp

required:
  - compatible
  - reg
  - interrupts
  - clocks
  - cdns,fifo-depth
  - cdns,fifo-width
  - cdns,trigger-address

patternProperties:
  "^.*@[0-9]+$":
    type: object

additionalProperties: false

examples:
  - |
    #include <dt-bindings/reset/altr,rst-mgr-a10.h>
    qspi: spi@ff705000 {
        compatible = "cdns,qspi-nor";
        #address-cells = <1>;
        #size-cells = <0>;
        reg = <0xff705000 0x1000>,
              <0xffa00000 0x1000>;
        interrupts = <0 151 4>;
        clocks = <&qspi_clk>;
        cdns,is-decoded-cs;
        cdns,fifo-depth = <128>;
        cdns,fifo-width = <4>;
        cdns,trigger-address = <0x00000000>;
        resets = <&rst QSPI_RESET>, <&rst QSPI_OCP_RESET>;
        reset-names = "qspi", "qspi-ocp";

        flash0: mt25q@0 {
                compatible = "jdec,spi-nor";
                reg = <0>;
                spi-max-frequency = <40000000>;
                spi-rx-bus-width = <2>;
                m25p,fast-read;
                cdns,read-delay = <0>;
                cdns,tshsl-ns = <0>;
                cdns,tsd2d-ns = <0>;
                cdns,tchsh-ns = <0>;
                cdns,tslch-ns = <0>;
        };
    };
```

## Documentation/devicetree/bindings/spi/cdns,xspi.yaml
```yaml
# SPDX-License-Identifier: (GPL-2.0 OR BSD-2-Clause)
# Copyright 2020-21 Cadence
%YAML 1.2
---
$id: "http://devicetree.org/schemas/spi/cdns,xspi.yaml#"
$schema: "http://devicetree.org/meta-schemas/core.yaml#"

title: Cadence XSPI Controller

maintainers:
  - Parshuram Thombare <pthombar@cadence.com>

description: |
  The XSPI controller allows SPI protocol communication in
  single, dual, quad or octal wire transmission modes for
  read/write access to slaves such as SPI-NOR flash.

properties:
  compatible:
    const: cdns,xspi-nor-fpga

  reg:
    items:
      - description: address and length of the controller register set
      - description: address and length of the Slave DMA data port
      - description: address and length of the auxiliary registers

  reg-names:
    items:
      - const: xspi-iobase
      - const: xspi-sdmabase
      - const: xspi-auxbase

  interrupts:
    maxItems: 1

  cdns,dqs-last-data-drop:
    type: boolean
    description: |
      This parameter should be set when the Flash Device being used
      issues data on negative edge of Flash clock and returns them with
      DQS and the PHY is configured to sample data in DQS mode.
      If this param is set the controller internally requests this redundant
      data at the end of the transfer cleaning up the PHY FIFO.

  cdns,phy-data-select-oe-start:
    $ref: /schemas/types.yaml#/definitions/uint32
    description: |
      Adjusts the starting point of the DQ pad output enable window.
      Lower numbers pull the rising edge earlier in time and larger
      numbers cause the rising edge to be delayed. Each bit changes
      the output enable time by a 1/2 cycle resolution.

  cdns,phy-data-select-oe-end:
    $ref: /schemas/types.yaml#/definitions/uint32
    description: |
      Adjusts the ending point of the DQ pad output enable window.
      Lower numbers pull the falling edge earlier in time and larger
      numbers cause the falling edge to be delayed. Each bit changes
      the output enable time by a 1/2 cycle resolution.

  cdns,phy-dqs-select-oe-start:
    $ref: /schemas/types.yaml#/definitions/uint32
    description: |
      Adjusts the starting point of the DQS pad output enable window.
      Lower numbers pull the rising edge earlier in time and larger
      numbers cause the rising edge to be delayed. Each bit changes
      the output enable time by a 1/2 cycle resolution.

  cdns,phy-dqs-select-oe-end:
    $ref: /schemas/types.yaml#/definitions/uint32
    description: |
      Adjusts the ending point of the DQS pad output enable window.
      Lower numbers pull the falling edge earlier in time and larger
      numbers cause the falling edge to be delayed. Each bit changes
      the output enable time by a 1/2 cycle resolution.

  cdns,phy-gate-cfg-close:
    $ref: /schemas/types.yaml#/definitions/uint32
    description: |
      Normally the gate is closing then all bits of dfi_cebar are high
      or when dfi_rd_pre_post_amble and rebar_dfi are high. This parameter
      allows to extend the closing of the DQS gate. Recommended zero.

  cdns,phy-gate-cfg:
    $ref: /schemas/types.yaml#/definitions/uint32
    description: |
      Coarse adjust of gate open time. This value is the number of cycles
      to delay the dfi_rddata_en signal prior to opening the gate in
      full cycle increments. Decreasing this value pulls the gate earlier
      in time. This field should be programmed such that the gate signal
      lands in the valid DQS gate window.

  cdns,phy-rd-del-select:
    $ref: /schemas/types.yaml#/definitions/uint32
    description: |
      Defines the read data delay. Holds the number of cycles to delay
      the dfi_rddata_en signal prior to enabling the read FIFO.
      After this delay, the read pointers begin incrementing the read FIFO.

  cdns,phy-clk-wr-delay:
    $ref: /schemas/types.yaml#/definitions/uint32
    description: |
      Controls the clk_wr delay line which adjusts the write DQ bit
      timing in 1/256th steps of the clock period in normal DLL
      locked mode. In bypass mode this field directly programs
      the number of delay elements.

  cdns,phy-use-lpbk-dqs:
    type: boolean
    description: |
      This parameter chooses lpbk_dqs to capture data for reads.
      Instead memory DQS will be used.

  cdns,phy-use-ext-lpbk-dqs:
    type: boolean
    description: |
      This parameter chooses external lpbk_dqs for data capture
      (lpbk_dqs connected to the lpbk_dqs_IO pad). When not used
      mem_rebar_pad is used for data read capture.

required:
  - compatible
  - reg
  - interrupts
  - cdns,phy-data-select-oe-start
  - cdns,phy-data-select-oe-end
  - cdns,phy-dqs-select-oe-start
  - cdns,phy-dqs-select-oe-end
  - cdns,phy-gate-cfg-close
  - cdns,phy-gate-cfg
  - cdns,phy-rd-del-select
  - cdns,phy-clk-wr-delay

examples:
  - |
    #include <dt-bindings/interrupt-controller/irq.h>

    xspi: spi@a0010000 {
        #address-cells = <1>;
        #size-cells = <0>;
        compatible = "cdns,xspi-nor-fpga";
        reg = <0x0 0xa0010000 0x0 0x10000>,
              <0x0 0xb0000000 0x0 0x10000>,
              <0x0 0xa0020000 0x0 0x10000>;
        interrupts = <0 90 IRQ_TYPE_LEVEL_HIGH>;
        interrupt-parent = <&gic>;
        cdns,dqs-last-data-drop;
        cdns,phy-data-select-oe-start = <0>;
        cdns,phy-data-select-oe-end = <4>;
        cdns,phy-dqs-select-oe-start = <0>;
        cdns,phy-dqs-select-oe-end = <1>;
        cdns,phy-gate-cfg-close = <3>;
        cdns,phy-gate-cfg = <0>;
        cdns,phy-rd-del-select = <5>;
        cdns,phy-clk-wr-delay = <64>;
        cdns,phy-use-lpbk-dqs;
        cdns,phy-use-ext-lpbk-dqs;
        mt35xu512@0 {
            compatible = "spi-nor", "micron,mt35xu512";
            spi-max-frequency = <75000000>;
            reg = <0>;
        };
        mt35xu512@1 {
            compatible = "spi-nor", "micron,mt35xu512";
            spi-max-frequency = <75000000>;
            reg = <1>;
        };
    };
```
