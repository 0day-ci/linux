## Documentation/devicetree/bindings/sound/nvidia,tegra210-mixer.yaml
```yaml
# SPDX-License-Identifier: (GPL-2.0-only OR BSD-2-Clause)
%YAML 1.2
---
$id: http://devicetree.org/schemas/sound/nvidia,tegra210-mixer.yaml#
$schema: http://devicetree.org/meta-schemas/core.yaml#

title: Tegra210 Mixer Device Tree Bindings

description: |
  The Mixer supports mixing of up to ten 7.1 audio input streams and
  generate five outputs (each of which can be any combination of the
  ten input streams).

maintainers:
  - Jon Hunter <jonathanh@nvidia.com>
  - Mohan Kumar <mkumard@nvidia.com>
  - Sameer Pujar <spujar@nvidia.com>

properties:
  $nodename:
    pattern: "^mixer@[0-9a-f]*$"

  compatible:
    oneOf:
      - const: nvidia,tegra210-amixer
      - items:
          - enum:
              - nvidia,tegra194-amixer
              - nvidia,tegra186-amixer
          - const: nvidia,tegra210-amixer

  reg:
    maxItems: 1

  sound-name-prefix:
    const: "MIXER"
    $ref: /schemas/types.yaml#/definitions/string

  ports:
    $ref: /schemas/graph.yaml#/properties/ports
    description: |
      Mixer has ten inputs and five outputs. Accordingly ACIF (Audio Client
      Interfaces) RX and TX port nodes are defined to represent MIXER inputs
      and outputs respectively. These are connected to corresponding ports
      on AHUB.

    patternProperties:
      '^port@[0-9]':
        $ref: audio-graph-port.yaml#
        unevaluatedProperties: false

required:
  - compatible
  - reg

additionalProperties: false

examples:
  - |

    mixer@702dbb00 {
        compatible = "nvidia,tegra210-amixer";
        reg = <0x702dbb00 0x800>;
        sound-name-prefix = "MIXER";
    };

...
```

## Documentation/devicetree/bindings/sound/nvidia,tegra210-mvc.yaml
```yaml
# SPDX-License-Identifier: (GPL-2.0-only OR BSD-2-Clause)
%YAML 1.2
---
$id: http://devicetree.org/schemas/sound/nvidia,tegra210-mvc.yaml#
$schema: http://devicetree.org/meta-schemas/core.yaml#

title: Tegra210 MVC Device Tree Bindings

description: |
  The Master Volume Control (MVC) provides gain or attenuation to a digital
  signal path. It can be used in input or output signal path for per-stream
  volume control or it can be used as master volume control. The MVC block
  has one input and one output. The input digital stream can be mono or
  multi-channel (up to 7.1 channels) stream. An independent mute control is
  also included in the MVC block.

maintainers:
  - Jon Hunter <jonathanh@nvidia.com>
  - Mohan Kumar <mkumard@nvidia.com>
  - Sameer Pujar <spujar@nvidia.com>

properties:
  $nodename:
    pattern: "^mvc@[0-9a-f]*$"

  compatible:
    oneOf:
      - const: nvidia,tegra210-mvc
      - items:
          - enum:
              - nvidia,tegra194-mvc
              - nvidia,tegra186-mvc
          - const: nvidia,tegra210-mvc

  reg:
    maxItems: 1

  sound-name-prefix:
    pattern: "^MVC[1-9]$"
    $ref: /schemas/types.yaml#/definitions/string
    description:
      used as prefix for sink/source names of the component. Must be a
      unique string among multiple instances of the same component.
      The name can be "MVC1" or "MVC2" ... "MVCx", where x depends on
      the maximum available instances on a Tegra SoC.

  ports:
    $ref: /schemas/graph.yaml#/properties/ports
    properties:
      port@0:
        $ref: audio-graph-port.yaml#
        unevaluatedProperties: false
        description: |
          ACIF (Audio Client Interface) acting as MVC input (RX) port.
          This is connected to corresponding ACIF port on AHUB.

      port@1:
        $ref: audio-graph-port.yaml#
        unevaluatedProperties: false
        description: |
          ACIF (Audio Client Interface) acting as MVC output (TX) port.
          This is connected to corresponding ACIF port on AHUB.

required:
  - compatible
  - reg

additionalProperties: false

examples:
  - |

    mvc@702da000 {
        compatible = "nvidia,tegra210-mvc";
        reg = <0x702da000 0x200>;
        sound-name-prefix = "MVC1";
    };

...
```

## Documentation/devicetree/bindings/sound/nvidia,tegra210-sfc.yaml
```yaml
# SPDX-License-Identifier: (GPL-2.0-only OR BSD-2-Clause)
%YAML 1.2
---
$id: http://devicetree.org/schemas/sound/nvidia,tegra210-sfc.yaml#
$schema: http://devicetree.org/meta-schemas/core.yaml#

title: Tegra210 SFC Device Tree Bindings

description: |
  The Sampling Frequency Converter (SFC) converts the sampling frequency
  of the input signal from one frequency to another. It supports sampling
  frequency conversions of streams of up to two channels (stereo).

maintainers:
  - Jon Hunter <jonathanh@nvidia.com>
  - Mohan Kumar <mkumard@nvidia.com>
  - Sameer Pujar <spujar@nvidia.com>

properties:
  $nodename:
    pattern: "^sfc@[0-9a-f]*$"

  compatible:
    oneOf:
      - const: nvidia,tegra210-sfc
      - items:
          - enum:
              - nvidia,tegra194-sfc
              - nvidia,tegra186-sfc
          - const: nvidia,tegra210-sfc

  reg:
    maxItems: 1

  sound-name-prefix:
    pattern: "^SFC[1-9]$"
    $ref: /schemas/types.yaml#/definitions/string
    description:
      used as prefix for sink/source names of the component. Must be a
      unique string among multiple instances of the same component.
      The name can be "SFC1" or "SFC2" ... "SFCx", where x depends on
      the maximum available instances on a Tegra SoC.

  ports:
    $ref: /schemas/graph.yaml#/properties/ports
    properties:
      port@0:
        $ref: audio-graph-port.yaml#
        unevaluatedProperties: false
        description: |
          ACIF (Audio Client Interface) acting as SFC input (RX) port.
          This is connected to corresponding ACIF port on AHUB.

      port@1:
        $ref: audio-graph-port.yaml#
        unevaluatedProperties: false
        description: |
          ACIF (Audio Client Interface) acting as SFC output (TX) port.
          This is connected to corresponding ACIF port on AHUB.

required:
  - compatible
  - reg

additionalProperties: false

examples:
  - |

    sfc@702d2000 {
        compatible = "nvidia,tegra210-sfc";
        reg = <0x702d2000 0x200>;
        sound-name-prefix = "SFC1";
    };

...
```

## Documentation/devicetree/bindings/sound/qcom,q6apm.yaml
```yaml
# SPDX-License-Identifier: (GPL-2.0 OR BSD-2-Clause)
%YAML 1.2
---
$id: "http://devicetree.org/schemas/sound/qcom,q6apm.yaml#"
$schema: "http://devicetree.org/meta-schemas/core.yaml#"

title: Qualcomm Audio Process Manager binding

maintainers:
  - Srinivas Kandagatla <srinivas.kandagatla@linaro.org>

description: |
  This binding describes the Qualcomm Audio Process Manager service in DSP

properties:
  compatible:
    const: qcom,q6apm

  reg:
    maxItems: 1

  '#address-cells':
    const: 1

  '#size-cells':
    const: 0

#APM Services
patternProperties:
  'apm@[0-9]+$':
    type: object
    description:
      APM devices use subnodes for services.

    properties:
      compatible:
        enum:
          - qcom,q6apm-dais
          - qcom,q6apm-bedais

      iommus:
        maxItems: 1

      "#sound-dai-cells":
        const: 1

      reg:
        maxItems: 1

    required:
      - compatible
      - reg
      - '#sound-dai-cells'

    additionalProperties: false

required:
  - compatible
  - reg

additionalProperties: false

examples:
  - |
    gpr {
        #address-cells = <1>;
        #size-cells = <0>;
        gprservice@1 {
          compatible = "qcom,q6apm";
          reg = <1>;

          #address-cells = <1>;
          #size-cells = <0>;

          apm@1 {
            compatible = "qcom,q6apm-dais";
            #sound-dai-cells = <1>;
            reg = <1>;
          };

          apm@2 {
            compatible = "qcom,q6apm-bedais";
            #sound-dai-cells = <1>;
            reg = <2>;
          };
        };
    };
```

## Documentation/devicetree/bindings/sound/qcom,q6dsp-audio-clocks.yaml
```yaml
# SPDX-License-Identifier: (GPL-2.0 OR BSD-2-Clause)
%YAML 1.2
---
$id: "http://devicetree.org/schemas/sound/qcom,q6dsp-audio-clocks.yaml#"
$schema: "http://devicetree.org/meta-schemas/core.yaml#"

title: Qualcomm DSP Clock Controller binding

maintainers:
  - Srinivas Kandagatla <srinivas.kandagatla@linaro.org>

description: |
  This binding describes the Qualcomm DSP Clock Controller

properties:
  compatible:
    enum:
      - qcom,q6afe-clocks
      - qcom,q6prm-clocks

  reg:
    maxItems: 1

  '#clock-cells':
    const: 2
    description:
      Clock Id is followed by clock coupling attributes.
        1 = for no coupled clock
        2 = for dividend of the coupled clock
        3 = for divisor of the coupled clock
        4 = for inverted and no couple clock

required:
  - compatible
  - reg
  - "#clock-cells"

additionalProperties: false

examples:
  - |
    #include <dt-bindings/soc/qcom,apr.h>
    #include <dt-bindings/sound/qcom,q6afe.h>
    apr {
        #address-cells = <1>;
        #size-cells = <0>;
        apr-service@4 {
            reg = <APR_SVC_AFE>;
            #address-cells = <1>;
            #size-cells = <0>;
            q6afecc@2 {
              compatible = "qcom,q6afe-clocks";
              reg = <2>;
              #clock-cells = <2>;
            };
        };
      };

  - |
    #include <dt-bindings/soc/qcom,gpr.h>
    gpr {
        #address-cells = <1>;
        #size-cells = <0>;
        gpr-service@2 {
            reg = <GPR_PRM_MODULE_IID>;
            #address-cells = <1>;
            #size-cells = <0>;
            q6prmcc@2 {
              compatible = "qcom,q6prm-clocks";
              reg = <2>;
              #clock-cells = <2>;
            };
        };
      };
```

## Documentation/devicetree/bindings/sound/qcom,q6dsp-audio-stream.yaml
```yaml
# SPDX-License-Identifier: (GPL-2.0 OR BSD-2-Clause)
%YAML 1.2
---
$id: "http://devicetree.org/schemas/sound/qcom,q6dsp-audio-stream.yaml#"
$schema: "http://devicetree.org/meta-schemas/core.yaml#"

title: Qualcomm DSP Audio Stream binding

maintainers:
  - Srinivas Kandagatla <srinivas.kandagatla@linaro.org>

description: |
  This binding describes the Qualcomm DSP Audio stream

properties:
  compatible:
    enum:
      - qcom,q6asm-dais
      - qcom,q6apm-dais

  reg:
    maxItems: 1

  '#sound-dai-cells':
    const: 1

  '#address-cells':
    const: 1

  '#size-cells':
    const: 0

#Digital Audio Interfaces
patternProperties:
  '^dai@[0-9]+$':
    type: object
    description:
      Q6DSP Audio Stream Digital Audio Interfaces.

    properties:
      reg:
        description:
          Digital Audio Interface ID

      direction:
        $ref: /schemas/types.yaml#/definitions/uint32
        enum: [0, 1, 2]
        description:
          Compress DAI direction
            0 = bi-directional
            1 = tx only
            2 = rx only

      is-compress-dai:
        type: boolean
        description:
          Indicate if DAI is for compress offload

    required:
      - reg

    additionalProperties: false

required:
  - compatible
  - reg
  - "#sound-dai-cells"
  - "#address-cells"
  - "#size-cells"

additionalProperties: false

examples:
  - |
    #include <dt-bindings/soc/qcom,apr.h>
    apr {
        #address-cells = <1>;
        #size-cells = <0>;
        apr-service@7 {
            reg = <APR_SVC_ASM>;
            #address-cells = <1>;
            #size-cells = <0>;
            q6asmdai@1 {
              compatible = "qcom,q6asm-dais";
              reg = <1>;
              #address-cells = <1>;
              #size-cells = <0>;
              #sound-dai-cells = <1>;

              dai@1 {
                reg = <1>;
                is-compress-dai;
              };
            };
        };
      };
  - |
    #include <dt-bindings/soc/qcom,gpr.h>
    gpr {
        #address-cells = <1>;
        #size-cells = <0>;
        gpr-service@1 {
            reg = <GPR_APM_MODULE_IID>;
            #address-cells = <1>;
            #size-cells = <0>;
            q6apmdai@1 {
              compatible = "qcom,q6apm-dais";
              reg = <1>;
              #address-cells = <1>;
              #size-cells = <0>;
              #sound-dai-cells = <1>;

              dai@1 {
                reg = <1>;
              };
            };
        };
      };
```

## Documentation/devicetree/bindings/sound/qcom,q6prm.yaml
```yaml
# SPDX-License-Identifier: (GPL-2.0-only OR BSD-2-Clause)
%YAML 1.2
---
$id: http://devicetree.org/schemas/sound/qcom,q6prm.yaml#
$schema: http://devicetree.org/meta-schemas/core.yaml#

title: Q6 Proxy Resource Manager

maintainers:
  - Srinivas Kandagatla <srinivas.kandagatla@linaro.org>

description: |
  Proxy Resource Manager module is core module used to manage
  core dsp resources like clocks

properties:
  compatible:
    const: qcom,q6prm

  reg:
    maxItems: 1

  '#clock-cells':
    const: 2

required:
  - compatible
  - reg
  - '#clock-cells'

additionalProperties: false

examples:
  - |
    gpr {
        #address-cells = <1>;
        #size-cells = <0>;
        gprservice@2 {
          compatible = "qcom,q6prm";
          reg = <2>;
          #clock-cells = <2>;
       };
    };
```

## Documentation/devicetree/bindings/sound/qcom,wcd938x-sdw.yaml
```yaml
# SPDX-License-Identifier: (GPL-2.0-only OR BSD-2-Clause)
%YAML 1.2
---
$id: http://devicetree.org/schemas/sound/qcom,wcd938x-sdw.yaml#
$schema: http://devicetree.org/meta-schemas/core.yaml#

title: Bindings for Qualcomm SoundWire Slave devices on WCD9380/WCD9385

maintainers:
  - Srinivas Kandagatla <srinivas.kandagatla@linaro.org>

description: |
  Qualcomm WCD9380/WCD9385 Codec is a standalone Hi-Fi audio codec IC.
  It has RX and TX Soundwire slave devices. This bindings is for the
  slave devices.

properties:
  compatible:
    const: sdw20217010d00

  reg:
    maxItems: 1

  qcom,direction:
    description: direction of the SoundWire device instance
    enum:
      - rx
      - tx

  qcom,port-mapping:
    description: |
      Specifies static port mapping between slave and master ports.
      In the order of slave port index.
    $ref: /schemas/types.yaml#/definitions/uint32-array
    minItems: 4
    maxItems: 5

required:
  - compatible
  - reg
  - qcom,direction
  - qcom,port-mapping

additionalProperties: false

examples:
  - |
    soundwire@3230000 {
        #address-cells = <2>;
        #size-cells = <0>;
        reg = <0x03230000 0x2000>;

        codec@0,3 {
            compatible = "sdw20217010d00";
            reg  = <0 3>;
            qcom,direction = "tx";
            qcom,port-mapping = <2 3 4 5>;
        };
    };

...
```
