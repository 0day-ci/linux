## Documentation/devicetree/bindings/sound/qcom,wcd938x.yaml
```yaml
# SPDX-License-Identifier: (GPL-2.0-only OR BSD-2-Clause)
%YAML 1.2
---
$id: http://devicetree.org/schemas/sound/qcom,wcd938x.yaml#
$schema: http://devicetree.org/meta-schemas/core.yaml#

title: Bindings for Qualcomm WCD9380/WCD9385 Audio Codec

maintainers:
  - Srinivas Kandagatla <srinivas.kandagatla@linaro.org>

description: |
  Qualcomm WCD9380/WCD9385 Codec is a standalone Hi-Fi audio codec IC.
  It has RX and TX Soundwire slave devices.

properties:
  compatible:
    enum:
      - qcom,wcd9380-codec
      - qcom,wcd9385-codec

  reset-gpios:
    description: GPIO spec for reset line to use
    maxItems: 1

  vdd-buck-supply:
    description: A reference to the 1.8V buck supply

  vdd-rxtx-supply:
    description: A reference to the 1.8V rx supply

  vdd-io-supply:
    description: A reference to the 1.8V I/O supply

  qcom,tx-device:
    $ref: /schemas/types.yaml#/definitions/phandle-array
    maxItems: 1
    description: A reference to Soundwire tx device phandle

  qcom,rx-device:
    $ref: /schemas/types.yaml#/definitions/phandle-array
    maxItems: 1
    description: A reference to Soundwire rx device phandle

  qcom,micbias1-microvolt:
    description: micbias1 voltage
    minimum: 1800000
    maximum: 2850000

  qcom,micbias2-microvolt:
    description: micbias2 voltage
    minimum: 1800000
    maximum: 2850000

  qcom,micbias3-microvolt:
    description: micbias3 voltage
    minimum: 1800000
    maximum: 2850000

  qcom,micbias4-microvolt:
    description: micbias4 voltage
    minimum: 1800000
    maximum: 2850000

  qcom,mbhc-hphl-switch:
    description: Indicates that HPHL switch type is normally closed
    type: boolean

  qcom,mbhc-ground-switch:
    description: Indicates that Headset Ground switch type is normally closed
    type: boolean

  qcom,mbhc-button0-vthreshold-microvolt:
    description: Voltage threshold value headset button0
    minimum: 0
    maximum: 500000

  qcom,mbhc-button1-vthreshold-microvolt:
    description: Voltage threshold value headset button1
    minimum: 0
    maximum: 500000

  qcom,mbhc-button2-vthreshold-microvolt:
    description: Voltage threshold value headset button2
    minimum: 0
    maximum: 500000

  qcom,mbhc-button3-vthreshold-microvolt:
    description: Voltage threshold value headset button3
    minimum: 0
    maximum: 500000

  qcom,mbhc-button4-vthreshold-microvolt:
    description: Voltage threshold value headset button4
    minimum: 0
    maximum: 500000

  qcom,mbhc-button5-vthreshold-microvolt:
    description: Voltage threshold value headset button5
    minimum: 0
    maximum: 500000

  qcom,mbhc-button6-vthreshold-microvolt:
    description: Voltage threshold value headset button6
    minimum: 0
    maximum: 500000

  qcom,mbhc-button7-vthreshold-microvolt:
    description: Voltage threshold value headset button7
    minimum: 0
    maximum: 500000

  '#sound-dai-cells':
    const: 1

required:
  - compatible
  - reset-gpios
  - qcom,tx-device
  - qcom,rx-device
  - qcom,micbias1-microvolt
  - qcom,micbias2-microvolt
  - qcom,micbias3-microvolt
  - qcom,micbias4-microvolt
  - qcom,mbhc-hphl-switch
  - qcom,mbhc-ground-switch
  - "#sound-dai-cells"

additionalProperties: false

examples:
  - |
    codec {
        compatible = "qcom,wcd9380-codec";
        reset-gpios = <&tlmm 32 0>;
        #sound-dai-cells = <1>;
        qcom,tx-device = <&wcd938x_tx>;
        qcom,rx-device = <&wcd938x_rx>;
        qcom,micbias1-microvolt = <1800000>;
        qcom,micbias2-microvolt = <1800000>;
        qcom,micbias3-microvolt = <1800000>;
        qcom,micbias4-microvolt = <1800000>;
        qcom,mbhc-hphl-switch;
        qcom,mbhc-ground-switch;
        qcom,mbhc-button0-vthreshold-microvolt = <75000>;
        qcom,mbhc-button1-vthreshold-microvolt = <150000>;
        qcom,mbhc-button2-vthreshold-microvolt = <237000>;
        qcom,mbhc-button3-vthreshold-microvolt = <500000>;
        qcom,mbhc-button5-vthreshold-microvolt = <500000>;
        qcom,mbhc-button6-vthreshold-microvolt = <500000>;
        qcom,mbhc-button7-vthreshold-microvolt = <500000>;
    };

    /* ... */

    soundwire@3230000 {
        #address-cells = <2>;
        #size-cells = <0>;
        reg = <0x03230000 0x2000>;
        wcd938x_tx: codec@0,3 {
            compatible = "sdw20217010d00";
            reg  = <0 3>;
            qcom,direction = "tx";
            qcom,port-mapping = <2 3 4 5>;
        };

        wcd938x_rx: codec@0,4 {
            compatible = "sdw20217010d00";
            reg  = <0 4>;
            qcom,direction = "rx";
            qcom,port-mapping = <1 2 3 4 5>;
        };

    };

...
```

## Documentation/devicetree/bindings/sound/richtek,rt9120.yaml
```yaml
# SPDX-License-Identifier: GPL-2.0
%YAML 1.2
---
$id: http://devicetree.org/schemas/sound/richtek,rt9120.yaml#
$schema: http://devicetree.org/meta-schemas/core.yaml#

title: Richtek RT9120 Class-D audio amplifier

maintainers:
  - ChiYuan Huang <cy_huang@richtek.com>

description: |
  The RT9120 is a high efficiency, I2S-input, stereo audio power amplifier
  delivering 2*20W into 8 Ohm BTL speaker loads. It supports the wide input
  voltage  range from 4.5V to 26.4V to meet the need on most common
  applications like as TV, monitors. home entertainment, electronic music
  equipment.

properties:
  compatible:
    enum:
      - richtek,rt9120

  reg:
    description: I2C device address
    maxItems: 1

  pwdnn-gpios:
    description: GPIO used for power down, low active
    maxItems: 1

  richtek,use-dvdd-1p8v:
    description: Indicate DVDD 1P8V is used, default for 3P3V or 5V design
    type: boolean

  '#sound-dai-cells':
    const: 0

required:
  - compatible
  - reg
  - '#sound-dai-cells'

additionalProperties: false

examples:
  - |
    i2c {
      #address-cells = <1>;
      #size-cells = <0>;
      rt9120@1a {
        compatible = "richtek,rt9120";
        reg = <0x1a>;
        #sound-dai-cells = <0>;
        pwdnn-gpios = <&gpio26 2 0>;
        richtek,use-dvdd-1p8v;
      };
    };
```

## Documentation/devicetree/bindings/sound/rockchip,i2s-tdm.yaml
```yaml
# SPDX-License-Identifier: (GPL-2.0-only OR BSD-2-Clause)
%YAML 1.2
---
$id: http://devicetree.org/schemas/sound/rockchip,i2s-tdm.yaml#
$schema: http://devicetree.org/meta-schemas/core.yaml#

title: Rockchip I2S/TDM Controller

description:
  The Rockchip I2S/TDM Controller is a Time Division Multiplexed
  audio interface found in various Rockchip SoCs, allowing up
  to 8 channels of audio over a serial interface.

maintainers:
  - Nicolas Frattaroli <frattaroli.nicolas@gmail.com>

properties:
  compatible:
    enum:
      - rockchip,px30-i2s-tdm
      - rockchip,rk1808-i2s-tdm
      - rockchip,rk3308-i2s-tdm
      - rockchip,rk3568-i2s-tdm
      - rockchip,rv1126-i2s-tdm

  reg:
    maxItems: 1

  interrupts:
    maxItems: 1

  dmas:
    minItems: 1
    maxItems: 2

  dma-names:
    oneOf:
      - const: rx
      - items:
          - const: tx
          - const: rx

  clocks:
    items:
      - description: clock for TX
      - description: clock for RX
      - description: clock for I2S bus

  clock-names:
    items:
      - const: mclk_tx
      - const: mclk_rx
      - const: hclk

  rockchip,frame-width:
    $ref: /schemas/types.yaml#/definitions/uint32
    default: 64
    minimum: 32
    maximum: 512
    description:
      Width of a frame, usually slot width multiplied by number of slots.
      Must be even.

  resets:
    items:
      - description: reset for TX
      - description: reset for RX

  reset-names:
    items:
      - const: tx-m
      - const: rx-m

  rockchip,cru:
    $ref: /schemas/types.yaml#/definitions/phandle
    description:
      The phandle of the cru.
      Required if both playback and capture are used, i.e. if rockchip,clk-trcm
      is 0.

  rockchip,grf:
    $ref: /schemas/types.yaml#/definitions/phandle
    description:
      The phandle of the syscon node for the GRF register.

  rockchip,mclk-calibrate:
    description:
      Enable mclk source calibration.
    type: boolean

  rockchip,trcm-sync:
    $ref: /schemas/types.yaml#/definitions/uint32
    description:
      Which lrck/bclk clocks each direction will sync to. You should use the
      constants in <dt-bindings/sound/rockchip,i2s-tdm.h>
    oneOf:
      - const: 0
        description:
          RK_TRCM_TXRX. Use both the TX and the RX clock for TX and RX.
      - const: 1
        description:
          RK_TRCM_TX. Use only the TX clock for TX and RX.
      - const: 2
        description:
          RK_TRCM_RX. Use only the RX clock for TX and RX.

  "#sound-dai-cells":
    const: 0

  rockchip,no-dmaengine:
    description:
      If present, driver will not register a pcm dmaengine, only the dai.
      If the dai is part of multi-dais, the property should be present.
    type: boolean

  rockchip,playback-only:
    description: Specify that the controller only has playback capability.
    type: boolean

  rockchip,capture-only:
    description: Specify that the controller only has capture capability.
    type: boolean

  rockchip,i2s-rx-route:
    $ref: /schemas/types.yaml#/definitions/uint32
    description:
      Defines the mapping of I2S RX sdis to I2S data bus lines.
      By default, they are mapped one-to-one.
    items:
      - description: which sdi to connect to data line 0
      - description: which sdi to connect to data line 1
      - description: which sdi to connect to data line 2
      - description: which sdi to connect to data line 3

  rockchip,i2s-tx-route:
    $ref: /schemas/types.yaml#/definitions/uint32
    description:
      Defines the mapping of I2S TX sdos to I2S data bus lines.
      By default, they are mapped one-to-one.
    items:
      - description: which sdo to connect to data line 0
      - description: which sdo to connect to data line 1
      - description: which sdo to connect to data line 2
      - description: which sdo to connect to data line 3

  rockchip,tdm-fsync-half-frame:
    description: Whether to use half frame fsync.
    type: boolean


required:
  - compatible
  - reg
  - interrupts
  - dmas
  - dma-names
  - clocks
  - clock-names
  - resets
  - reset-names
  - rockchip,grf
  - "#sound-dai-cells"
  - rockchip,trcm-sync

allOf:
  - if:
      properties:
        rockchip,clk-trcm:
          contains:
            enum: [0]
    then:
      required:
        - rockchip,cru


additionalProperties: false

examples:
  - |
    #include <dt-bindings/clock/rk3568-cru.h>
    #include <dt-bindings/interrupt-controller/arm-gic.h>
    #include <dt-bindings/interrupt-controller/irq.h>
    #include <dt-bindings/pinctrl/rockchip.h>
    #include <dt-bindings/sound/rockchip,i2s-tdm.h>


    foo {
        #address-cells = <2>;
        #size-cells = <2>;
        i2s@fe410000 {
            compatible = "rockchip,rk3568-i2s-tdm";
            reg = <0x0 0xfe410000 0x0 0x1000>;
            interrupts = <GIC_SPI 53 IRQ_TYPE_LEVEL_HIGH>;
            clocks = <&cru MCLK_I2S1_8CH_TX>, <&cru MCLK_I2S1_8CH_RX>,
                     <&cru HCLK_I2S1_8CH>;
            clock-names = "mclk_tx", "mclk_rx", "hclk";
            dmas = <&dmac1 2>, <&dmac1 3>;
            dma-names = "tx", "rx";
            resets = <&cru SRST_M_I2S1_8CH_TX>, <&cru SRST_M_I2S1_8CH_RX>;
            reset-names = "tx-m", "rx-m";
            rockchip,trcm-sync = <RK_TRCM_TX>;
            rockchip,cru = <&cru>;
            rockchip,grf = <&grf>;
            #sound-dai-cells = <0>;
            pinctrl-names = "default";
            pinctrl-0 =
                <&i2s1m0_sclktx
                &i2s1m0_sclkrx
                &i2s1m0_lrcktx
                &i2s1m0_lrckrx
                &i2s1m0_sdi0
                &i2s1m0_sdi1
                &i2s1m0_sdi2
                &i2s1m0_sdi3
                &i2s1m0_sdo0
                &i2s1m0_sdo1
                &i2s1m0_sdo2
                &i2s1m0_sdo3>;
            status = "disabled";
        };
    };
```

## Documentation/devicetree/bindings/sound/rockchip,rk817-codec.yaml
```yaml
# SPDX-License-Identifier: (GPL-2.0 OR BSD-2-Clause)
%YAML 1.2
---
$id: http://devicetree.org/schemas/sound/rockchip-rk817.yaml#
$schema: http://devicetree.org/meta-schemas/core.yaml#

title: Rockchip rk817 audio codec

description:
  The rk817 codec is an I2C codec integrated with every Rockchip
  rk817 PMIC MFD.

properties:
  compatible:
    enum:
      - rockchip,rk817-codec

  clocks:
    maxItems: 1

  clock-names:
    const: "mclk"

  mic-in-differential:
    description: the microphone is in differential mode.
    $ref: /schemas/types.yaml#/definitions/flag

required:
  - compatible
  - clocks
  - clock-names

additionalProperties: false

examples:
  - |
rk817: pmic@20 {
	compatible = "rockchip,rk817";
	reg = <0x20>;
	interrupt-parent = <&gpio0>;
	interrupts = <7 IRQ_TYPE_LEVEL_LOW>;
	pinctrl-names = "default";
	pinctrl-0 = <&pmic_int>;

	........

	rk817_codec: codec {
			#sound-dai-cells = <0>;
			compatible = "rockchip,rk817-codec";
			clocks = <&cru SCLK_I2S_8CH_OUT>;
			clock-names = "mclk";
			pinctrl-names = "default";
			pinctrl-0 = <&i2s_8ch_mclk>;
			mic-in-differential;
			status = "okay";
	};

	........

};
```

## Documentation/devicetree/bindings/sound/snd-soc-dummy.txt
```
* snd-soc-dummy

This node models the snd-soc-dummy.
This is useful to create dummy codec devices where we need to have
some DAI links without a real Codec.

Required properties:
- compatible   : "asoc,snd-soc-dummy"


Example:

dummy_codec {
	compatible = "asoc,snd-soc-dummy";
	#sound-dai-cells = <0>;
};
```
