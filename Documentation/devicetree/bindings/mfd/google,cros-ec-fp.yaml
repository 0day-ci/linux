## Documentation/devicetree/bindings/mfd/rockchip,rk809.yaml
```yaml
# SPDX-License-Identifier: GPL-2.0-only OR BSD-2-Clause
%YAML 1.2
---
$id: http://devicetree.org/schemas/mfd/rockchip,rk809.yaml#
$schema: http://devicetree.org/meta-schemas/core.yaml#

title: RK817 Power Management Integrated Circuit

maintainers:
  - Chris Zhong <zyw@rock-chips.com>
  - Zhang Qing <zhangqing@rock-chips.com>

description: |
  Rockchip RK809 series PMIC. This device consists of an i2c controlled MFD
  that includes regulators, an RTC, and power button.

properties:
  compatible:
    enum:
      - rockchip,rk809

  reg:
    maxItems: 1

  interrupts:
    maxItems: 1

  '#clock-cells':
    description: |
      See <dt-bindings/clock/rockchip,rk808.h> for clock IDs.
    const: 1

  clock-output-names:
    description:
      From common clock binding to override the default output clock name.
    maxItems: 2

  rockchip,system-power-controller:
    type: boolean
    description:
      Telling whether or not this PMIC is controlling the system power.

  wakeup-source:
    type: boolean
    description:
      Device can be used as a wakeup source.

  vcc1-supply:
    description:
      The input supply for DCDC_REG1.

  vcc2-supply:
    description:
      The input supply for DCDC_REG2.

  vcc3-supply:
    description:
      The input supply for DCDC_REG3.

  vcc4-supply:
    description:
      The input supply for DCDC_REG4.

  vcc5-supply:
    description:
      The input supply for LDO_REG1, LDO_REG2, and LDO_REG3.

  vcc6-supply:
    description:
      The input supply for LDO_REG4, LDO_REG5, and LDO_REG6.

  vcc7-supply:
    description:
      The input supply for LDO_REG7, LDO_REG8, and LDO_REG9.

  vcc8-supply:
    description:
      The input supply for SWITCH_REG1.

  vcc9-supply:
    description:
      The input supply for DCDC_REG5 and SWITCH_REG2.

  regulators:
    type: object
    patternProperties:
      "^(LDO_REG[1-9]|DCDC_REG[1-5]|SWITCH_REG[1-2])$":
        type: object
        $ref: ../regulator/regulator.yaml#
    unevaluatedProperties: false

required:
  - compatible
  - reg
  - interrupts
  - "#clock-cells"

additionalProperties: false
```

## Documentation/devicetree/bindings/mfd/rockchip,rk818.yaml
```yaml
# SPDX-License-Identifier: GPL-2.0-only OR BSD-2-Clause
%YAML 1.2
---
$id: http://devicetree.org/schemas/mfd/rockchip,rk818.yaml#
$schema: http://devicetree.org/meta-schemas/core.yaml#

title: RK818 Power Management Integrated Circuit

maintainers:
  - Chris Zhong <zyw@rock-chips.com>
  - Zhang Qing <zhangqing@rock-chips.com>

description: |
  Rockchip RK818 series PMIC. This device consists of an i2c controlled MFD
  that includes regulators, an RTC, and a power button.

properties:
  compatible:
    enum:
      - rockchip,rk818

  reg:
    maxItems: 1

  interrupts:
    maxItems: 1

  '#clock-cells':
    description: |
      See <dt-bindings/clock/rockchip,rk808.h> for clock IDs.
    const: 1

  clock-output-names:
    description:
      From common clock binding to override the default output clock name.
    maxItems: 2

  rockchip,system-power-controller:
    type: boolean
    description:
      Telling whether or not this PMIC is controlling the system power.

  wakeup-source:
    type: boolean
    description:
      Device can be used as a wakeup source.

  vcc1-supply:
    description:
      The input supply for DCDC_REG1.

  vcc2-supply:
    description:
      The input supply for DCDC_REG2.

  vcc3-supply:
    description:
      The input supply for DCDC_REG3.

  vcc4-supply:
    description:
      The input supply for DCDC_REG4.

  boost-supply:
    description:
      The input supply for DCDC_BOOST

  vcc6-supply:
    description:
      The input supply for LDO_REG1 and LDO_REG2.

  vcc7-supply:
    description:
      The input supply for LDO_REG3, LDO_REG5, and LDO_REG7.

  vcc8-supply:
    description:
      The input supply for LDO_REG4, LDO_REG6, and LDO_REG8.

  vcc9-supply:
    description:
      The input supply for LDO_REG9 and SWITCH_REG.

  h_5v-supply:
    description:
      The input supply for HDMI_SWITCH.

  usb-supply:
    description:
      The input supply for OTG_SWITCH.

  regulators:
    type: object
    patternProperties:
      "^(DCDC_REG[1-4]|LDO_REG[1-9]|SWITCH_REG|HDMI_SWITCH|OTG_SWITCH)$":
        type: object
        $ref: ../regulator/regulator.yaml#
    unevaluatedProperties: false

required:
  - compatible
  - reg
  - interrupts
  - "#clock-cells"

additionalProperties: false
```

## Documentation/devicetree/bindings/mfd/ti,am3359-tscadc.yaml
```yaml
# SPDX-License-Identifier: (GPL-2.0-only OR BSD-2-Clause)
%YAML 1.2
---
$id: http://devicetree.org/schemas/mfd/ti,am3359-tscadc.yaml#
$schema: http://devicetree.org/meta-schemas/core.yaml#

title: Bindings for Touchscreen + ADC MFD IPs on TI SoCs

maintainers:
  - Vignesh Raghavendra <vigneshr@ti.com>

properties:
  compatible:
    oneOf:
      - items:
          - enum:
              - ti,am654-tscadc
          - const: ti,am3359-tscadc
      - const: ti,am3359-tscadc

  reg:
    maxItems: 1

  interrupts:
    maxItems: 1

  clocks:
    maxItems: 1

  clock-names:
    const: "adc_tsc_fck"

  dmas:
    maxItems: 2

  dma-names:
    items:
      - const: fifo0
      - const: fifo1

  power-domains: true

  tsc:
    $ref: ../input/touchscreen/ti,am3359-tsc.yaml
    description:
      Bindings for Touchscreen part of the MFD

  adc:
    $ref: ../iio/adc/ti,am3359-adc.yaml
    description:
      Bindings for ADC part of the MFD

required:
  - compatible
  - reg
  - interrupts

additionalProperties: false

if:
  properties:
    compatible:
      contains:
        const: ti,am654-tscadc
then:
  properties:
    tsc: false

examples:
  - |
    tscadc@44e0d000 {
      compatible = "ti,am3359-tscadc";
      reg = <0x44e0d000 0x1000>;
      interrupts = <16>;
        tsc {
          compatible = "ti,am3359-tsc";
          ti,wires = <4>;
          ti,x-plate-resistance = <200>;
          ti,coordinate-readouts = <5>;
          ti,wire-config = <0x00 0x11 0x22 0x33>;
          ti,charge-delay = <0x400>;
        };

      adc {
        compatible = "ti,am3359-adc";
        ti,adc-channels = <4 5 6 7>;
        ti,chan-step-opendelay = <0x098 0x3ffff 0x098 0x0>;
        ti,chan-step-sampledelay = <0xff 0x0 0xf 0x0>;
        ti,chan-step-avg = <16 2 4 8>;
        #io-channel-cells = <1>;
      };
    };
```

## Documentation/devicetree/bindings/mfd/ti,palmas.yaml
```yaml
# SPDX-License-Identifier: GPL-2.0-only
%YAML 1.2
---
$id: http://devicetree.org/schemas/mfd/ti,palmas.yaml#
$schema: http://devicetree.org/meta-schemas/core.yaml#

title: Texas Instruments Palmas family of Power-Management ICs

maintainers:
  - Lee Jones <lee.jones@linaro.org>

properties:
  compatible:
    items:
      - enum:
          - ti,twl6035
          - ti,twl6036
          - ti,twl6037
          - ti,tps65913
          - ti,tps65914
          - ti,tps80036
          - ti,tps659038
          - ti,tps65917
      - const: ti,palmas

  reg:
    maxItems: 1

  interrupts:
    maxItems: 1

  interrupt-controller:
    description: The Palmas chip has its own internal IRQs.

  "#interrupt-cells":
    description: The first cell is the IRQ number and the second cell is the flags, encoded as the
      trigger mask from ../interrupt-controller/interrupts.txt.
    const: 2

  ti,mux-pad1:
    $ref: /schemas/types.yaml#/definitions/uint32
    description: Set the pad register 1 to the correct muxing for the hardware. Otherwise the
     muxing will be obtained from OTP.

  ti,mux-pad2:
    $ref: /schemas/types.yaml#/definitions/uint32
    description: Set the pad register 2 to the correct muxing for the hardware. Otherwise the
     muxing will be obtained from OTP.

  ti,power-ctrl:
    $ref: /schemas/types.yaml#/definitions/flag
    description: Specifies the value to program into the POWER_CTRL register.

  ti,system-power-controller:
    $ref: /schemas/types.yaml#/definitions/flag
    description: Specifies whether or not this PMIC is controlling the system power.

  pinctrl:
    $ref: ../pinctrl/ti,palmas-pinctrl.yaml

  pwrbutton:
    $ref: ../input/ti,palmas-pwrbutton.yaml

  rtc:
    $ref: ../rtc/ti,palmas-rtc.yaml

patternProperties:
  "^(palmas_)?adc$":
    $ref: ../iio/adc/ti,palmas-gpadc.yaml

  "^(palmas_)?(clk32k|clk32kg|clk32kgaudio)$":
    $ref: ../clock/ti,palmas-clk32k.yaml

  "^(palmas_)?gpio$":
    $ref: ../gpio/ti,palmas-gpio.yaml

  "^(palmas_)?pinmux$":
    $ref: ../pinctrl/ti,palmas-pinctrl.yaml

  "^(palmas_)?pmic$":
    $ref: ../regulator/ti,palmas-pmic.yaml

  "^(palmas_)?usb$":
    $ref: ../extcon/ti,palmas-usb-vid.yaml

additionalProperties: false

required:
  - compatible
  - reg
  - interrupt-controller
  - "#interrupt-cells"

examples:
  - |
    #include <dt-bindings/interrupt-controller/irq.h>

    i2c {
      #address-cells = <1>;
      #size-cells = <0>;

      pmic@48 {
        compatible = "ti,twl6035", "ti,palmas";
        reg = <0x48>;
        interrupts = <16 IRQ_TYPE_LEVEL_LOW>;
        interrupt-parent = <&intc>;
        interrupt-controller;
        #interrupt-cells = <2>;

        ti,mux-pad1 = <0>;
        ti,mux-pad2 = <0>;

        pmic {
          compatible = "ti,twl6035-pmic", "ti,palmas-pmic";
        };
      };
    };
```

## Documentation/devicetree/bindings/misc/hisilicon,hikey-usb.yaml
```yaml
# SPDX-License-Identifier: (GPL-2.0 OR BSD-2-Clause)
# Copyright 2019 Linaro Ltd.
%YAML 1.2
---
$id: http://devicetree.org/schemas/misc/hisilicon,hikey-usb.yaml#
$schema: http://devicetree.org/meta-schemas/core.yaml#

title: HiKey960/970 onboard USB GPIO Hub

maintainers:
  - John Stultz <john.stultz@linaro.org>

description: |
  Supports the onboard USB GPIO hubs found on HiKey960/970.
  Such hubs require a power supply for the USB I/O. Depending on the
  exact hub model, after USB I/O is powered up, a reset should be needed.

  It also acts as a role-switch intermediary to detect the state of
  the USB-C port, to switch the hub into dual-role USB-C or host mode,
  which enables and powers up the onboard USB-A host ports.

  Schematics about such hubs can be found here:
    https://github.com/96boards/documentation/raw/master/consumer/hikey/hikey960/hardware-docs/HiKey960_Schematics.pdf
    https://www.96boards.org/documentation/consumer/hikey/hikey970/hardware-docs/files/hikey970-schematics.pdf

properties:
  compatible:
    enum:
      - hisilicon,usbhub

  typec-vbus-gpios:
    $ref: /schemas/types.yaml#/definitions/phandle-array
    description: phandle to the typec-vbus gpio

  otg-switch-gpios:
    $ref: /schemas/types.yaml#/definitions/phandle-array
    description: phandle to the otg-switch gpio

  hub-reset-en-gpios:
    $ref: /schemas/types.yaml#/definitions/phandle-array
    description: phandle to the hub reset gpio

  usb-role-switch:
    $ref: /schemas/types.yaml#/definitions/flag
    description: Support role switch.

  hub-vdd-supply:
    description: regulator for hub power

  port:
    description: |
      describe hadware connections between USB endpoints.
      Two ports are supported: the first being the endpoint that will
      be notified by this driver, and the second being the endpoint
      that notifies this driver of a role switch.

required:
  - compatible
  - hub-vdd-supply
  - port

additionalProperties: false

examples:
  - |
    #include <dt-bindings/gpio/gpio.h>

    usb-hub {
        compatible = "hisilicon,usbhub";
        typec-vbus-gpios = <&gpio25 2 GPIO_ACTIVE_HIGH>;
        otg-switch-gpios = <&gpio25 6 GPIO_ACTIVE_HIGH>;
        hub-reset-en-gpios = <&gpio0 3 GPIO_ACTIVE_HIGH>;
        hub-vdd-supply = <&usb_hub_vdd>;
        usb-role-switch;
        port {
            #address-cells = <1>;
            #size-cells = <0>;
            usb_ep0: endpoint@0 {
                reg = <0>;
                remote-endpoint = <&dwc3_role_switch>;
            };
            usb_ep1: endpoint@1 {
                reg = <1>;
                remote-endpoint = <&rt1711h_ep>;
            };
        };
    };
```

## Documentation/devicetree/bindings/misc/power-efuse.yaml
```yaml
# SPDX-License-Identifier: (GPL-2.0 OR BSD-2-Clause)
%YAML 1.2
---
$id: http://devicetree.org/schemas/misc/power-efuse.yaml#
$schema: http://devicetree.org/meta-schemas/core.yaml#

title: Generic power efuse device

maintainers:
 - Zev Weiss <zev@bewilderbeest.net>

properties:
  compatible:
    const: power-efuse

  vout-supply:
    description:
      phandle to the regulator providing power for the efuse

  error-flags-cache-ttl-ms:
    description:
      The number of milliseconds the vout-supply regulator's error
      flags should be cached before re-fetching them.

required:
  - compatible
  - vout-supply

additionalProperties: false

examples:
  - |
    efuse {
        compatible = "power-efuse";
        vout-supply = <&efuse_reg>;
        error-flags-cache-ttl-ms = <500>;
    };
```

## Documentation/devicetree/bindings/misc/qcom,fastrpc.yaml
```yaml
# SPDX-License-Identifier: (GPL-2.0-only OR BSD-2-Clause)
%YAML 1.2
---
$id: "http://devicetree.org/schemas/misc/qcom,fastrpc.yaml#"
$schema: "http://devicetree.org/meta-schemas/core.yaml#"

title: Qualcomm FastRPC Driver

maintainers:
  - Srinivas Kandagatla <srinivas.kandagatla@linaro.org>

description: |
  The FastRPC implements an IPC (Inter-Processor Communication)
  mechanism that allows for clients to transparently make remote method
  invocations across DSP and APPS boundaries. This enables developers
  to offload tasks to the DSP and free up the application processor for
  other tasks.

properties:
  compatible:
    items:
      - const: qcom,fastrpc

  label:
    items:
      enum:
        - adsp
        - mdsp
        - sdsp
        - cdsp

  '#address-cells':
    const: 1

  '#size-cells':
    const: 0

patternProperties:
  "(compute-)?cb@[0-9]$":
    type: object

    description: >
      Each subnode of the Fastrpc represents compute context banks available on the dsp.

    properties:
      compatible:
        items:
          - const: qcom,fastrpc-compute-cb

      reg:
        maxItems: 1

      qcom,nsession:
        $ref: /schemas/types.yaml#/definitions/uint32
        default: 1
        description: >
          A value indicating how many sessions can share this context bank.

    required:
      - compatible
      - reg

    additionalProperties: true

required:
  - compatible
  - label
  - '#address-cells'
  - '#size-cells'

additionalProperties: true

examples:
  - |
    smd-edge {
        label = "lpass";
        fastrpc {
            compatible = "qcom,fastrpc";
            label = "adsp";
            qcom,smd-channels = "fastrpcsmd-apps-dsp";
            #address-cells = <1>;
            #size-cells = <0>;

            compute-cb@1 {
                compatible = "qcom,fastrpc-compute-cb";
                reg = <1>;
            };

            compute-cb@2 {
                compatible = "qcom,fastrpc-compute-cb";
                reg = <2>;
            };
        };
    };
```
