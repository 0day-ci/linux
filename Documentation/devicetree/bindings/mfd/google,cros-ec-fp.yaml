## Documentation/devicetree/bindings/misc/sunplus-iop.yaml
```yaml
# SPDX-License-Identifier: (GPL-2.0-only OR BSD-2-Clause)
# Copyright (C) Sunplus Ltd. Co. 2021
%YAML 1.2
---
$id: http://devicetree.org/schemas/misc/sunplus-iop.yaml#
$schema: http://devicetree.org/meta-schemas/core.yaml#

title: Sunplus IOP(8051) controller

maintainers:
  - Tony Huang <tonyhuang.sunplus@gmail.com>

description: |
  Processor for I/O control, RTC wake-up procedure management,
  and cooperation with CPU&PMC in power management.

properties:
  compatible:
    enum:
      - sunplus,sp7021-iop

  reg:
    items:
      - description: IOP registers regions
      - description: PMC registers regions
      - description: MOON0 registers regions

  reg-names:
    items:
      - const: iop
      - const: iop_pmc
      - const: moon0

  interrupts:
    items:
      - description: IOP_INT0. IOP to system Interrupt 0.
                     Sent by IOP to system RISC.
      - description: IOP_INT1. IOP to System Interrupt 1.
                     Sent by IOP to system RISC.

  memory-region:
    maxItems: 1

  wakeup-gpios:
    description: When the linux kernel system is powered off.
      8051 is always powered. 8051 cand receive external signals
      according to this gpio pin. 8051 receives external signal
      through gpio pin. 8051 can power on linux kernel system.

required:
  - compatible
  - reg
  - reg-names
  - interrupts
  - memory-region
  - wakeup-gpios

additionalProperties: false

examples:
  - |
    #include <dt-bindings/interrupt-controller/irq.h>
    #include <dt-bindings/interrupt-controller/arm-gic.h>
    #include <dt-bindings/gpio/gpio.h>
    iop: iop@9c000400 {
        compatible = "sunplus,sp7021-iop";
        reg = <0x9c000400 0x80>, <0x9c003100 0x80>, <0x9c000000 0x80>;
        reg-names = "iop", "iop_pmc", "moon0";
        interrupt-parent = <&intc>;
        interrupts = <41 IRQ_TYPE_LEVEL_HIGH>, <42 IRQ_TYPE_LEVEL_HIGH>;
        memory-region = <&iop_reserve>;
        pinctrl-names = "default";
        pinctrl-0 = <&iop_pins>;
        wakeup-gpios = <&pctl 1 GPIO_ACTIVE_HIGH>;
    };
...
```

## Documentation/devicetree/bindings/misc/xlnx,zynq-afi-fpga.yaml
```yaml
# SPDX-License-Identifier: (GPL-2.0-only OR BSD-2-Clause)
%YAML 1.2
---
$id: http://devicetree.org/schemas/misc/xlnx,zynq-afi-fpga.yaml#
$schema: http://devicetree.org/meta-schemas/core.yaml#

title: Xilinx Zynq AFI interface Manager.

maintainers:
  - Nava kishore Manne <nava.manne@xilinx.com>

description: |
  The Zynq Processing System core provides access from PL masters to PS
  internal peripherals, and memory through AXI FIFO interface(AFI)
  interfaces.

properties:
  compatible:
    items:
      - enum:
          - xlnx,zynq-afi-fpga
  reg:
    maxItems: 1

  xlnx,afi-buswidth:
    $ref: /schemas/types.yaml#/definitions/uint32
    description: |
            Size of the afi bus width.
            0 - 64-bit AXI data width.
            1 - 32-bit AXI data width.
    maxItems: 1

required:
  - compatible
  - reg
  - xlnx,afi-buswidth

additionalProperties: false

examples:
  - |
    afi0: afi@f8008000 {
        compatible = "xlnx,zynq-afi-fpga";
        reg = <0xf8008000 0x1000>;
        xlnx,afi-buswidth = <1>;
    };
...
```

## Documentation/devicetree/bindings/misc/xlnx,zynqmp-afi-fpga.yaml
```yaml
# SPDX-License-Identifier: (GPL-2.0-only OR BSD-2-Clause)
%YAML 1.2
---
$id: http://devicetree.org/schemas/misc/xlnx,zynqmp-afi-fpga.yaml#
$schema: http://devicetree.org/meta-schemas/core.yaml#

title: Xilinx ZynqMP AFI interface Manager.

maintainers:
  - Nava kishore Manne <nava.manne@xilinx.com>

description: |
  The Zynq UltraScale+ MPSoC Processing System core provides access from PL
  masters to PS internal peripherals, and memory through AXI FIFO interface(AFI)
  interfaces.

properties:
  compatible:
    items:
      - enum:
          - xlnx,zynqmp-afi-fpga

  config-afi:
    $ref: /schemas/types.yaml#/definitions/uint32-array
    description: |
      Pairs of  <regid value >
      The possible values of regid and values are
      regid - Regids of the register to be written possible values
        0- AFIFM0_RDCTRL
        1- AFIFM0_WRCTRL
        2- AFIFM1_RDCTRL
        3- AFIFM1_WRCTRL
        4- AFIFM2_RDCTRL
        5- AFIFM2_WRCTRL
        6- AFIFM3_RDCTRL
        7- AFIFM3_WRCTRL
        8- AFIFM4_RDCTRL
        9- AFIFM4_WRCTRL
        10- AFIFM5_RDCTRL
        11- AFIFM5_WRCTRL
        12- AFIFM6_RDCTRL
        13- AFIFM6_WRCTRL
        14- AFIFS
        15- AFIFS_SS2
      value - Array of values to be written.
        for FM0_RDCTRL(0) the valid values-fabric width
          2 - 32-bit
          1 - 64-bit
          0 - 128-bit
        for FM0_WRCTRL(1) the valid values-fabric width
          2 - 32-bit
          1 - 64-bit
          0 - 128-bit
        for FM1_RDCTRL(2) the valid values-fabric width
          2 - 32-bit
          1 - 64-bit
          0 - 128-bit
        for FM1_WRCTRL(3) the valid values-fabric width
          2 - 32-bit
          1 - 64-bit
          0 - 128-bit
        for FM2_RDCTRL(4) the valid values-fabric width
          2 - 32-bit
          1 - 64-bit
          0 - 128-bit
        for FM2_WRCTRL(5) the valid values-fabric width
          2 - 32-bit
          1 - 64-bit
          0 - 128-bit
        for FM3_RDCTRL(6) the valid values-fabric width
          2 - 32-bit
          1 - 64-bit
          0 - 128-bit
        for FM3_WRCTRL(7) the valid values-fabric width
          2 - 32-bit
          1 - 64-bit
          0 - 128-bit
        for FM4_RDCTRL(8) the valid values-fabric width
          2 - 32-bit
          1 - 64-bit
          0 - 128-bit
        for FM4_WRCTRL(9) the valid values-fabric width
          2 - 32-bit
          1 - 64-bit
          0 - 128-bit
        for FM5_RDCTRL(10) the valid values-fabric width
          2 - 32-bit
          1 - 64-bit
          0 - 128-bit
        for FM5_WRCTRL(11) the valid values-fabric width
          2 - 32-bit
          1 - 64-bit
          0 - 128-bit
        for FM6_RDCTRL(12) the valid values-fabric width
          2 - 32-bit
          1 - 64-bit
          0 - 128-bit
        for FM6_WRCTRL(13) the valid values-fabric width
          2 - 32-bit
          1 - 64-bit
          0 - 128-bit
        for AFI_FA(14)
          dw_ss1_sel      bits (11:10)
          dw_ss0_sel      bits (9:8)
            0x0 - 32-bit AXI data width
            0x1 - 64-bit AXI data width
            0x2 - 128-bit AXI data width
            All other bits are 0 write ignored.

        for AFI_FA(15)  selects for ss2AXI data width valid values
          0x000 - 32-bit AXI data width
          0x100 - 64-bit AXI data width
          0x200 - 128-bit AXI data width
    minItems: 1
    maxItems: 15

required:
  - compatible
  - config-afi

additionalProperties: false

examples:
  - |
    firmware {
      zynqmp_firmware: zynqmp-firmware {
        compatible = "xlnx,zynqmp-firmware";
        method = "smc";
        afi0: afi {
          compatible = "xlnx,afi-fpga";
          config-afi = <0 2>, <1 1>, <2 1>;
        };
      };
    };

...
```

## Documentation/devicetree/bindings/mmc/aspeed,sdhci.yaml
```yaml
# SPDX-License-Identifier: GPL-2.0-or-later
# Copyright 2019 IBM Corp.
%YAML 1.2
---
$id: http://devicetree.org/schemas/mmc/aspeed,sdhci.yaml#
$schema: http://devicetree.org/meta-schemas/core.yaml#

title: ASPEED SD/SDIO/MMC Controller

maintainers:
  - Andrew Jeffery <andrew@aj.id.au>
  - Ryan Chen <ryanchen.aspeed@gmail.com>

description: |+
  The ASPEED SD/SDIO/eMMC controller exposes two slots implementing the SDIO
  Host Specification v2.00, with 1 or 4 bit data buses, or an 8 bit data bus if
  only a single slot is enabled.

  The two slots are supported by a common configuration area. As the SDHCIs for
  the slots are dependent on the common configuration area, they are described
  as child nodes.

  The signal voltage of SDHCIs on AST2600-A2 EVB is able to be toggled by GPIO
  pins. In the reference design, GPIOV0 of AST2600-A2 EVB is connected to the
  power load switch that providing 3.3v to SD1 bus vdd, GPIOV1 is connected to
  a 1.8v and a 3.3v power load switch that providing signal voltage to
  SD1 bus.
  If GPIOV0 is active high, SD1 bus is enabled. Otherwise, SD1 bus is
  disabled. If GPIOV1 is active high, 3.3v power load switch is enabled, SD1
  signal voltage is 3.3v. Otherwise, 1.8v power load switch will be enabled, SD1
  signal voltage becomes 1.8v.
  AST2600-A2 EVB also support toggling signal voltage for SD2 bus.
  The design is the same as SD1 bus. It uses GPIOV2 as power-gpio and GPIOV3
  as power-switch-gpio.

properties:
  compatible:
    enum:
      - aspeed,ast2400-sd-controller
      - aspeed,ast2500-sd-controller
      - aspeed,ast2600-sd-controller
  reg:
    maxItems: 1
    description: Common configuration registers
  "#address-cells":
    const: 1
  "#size-cells":
    const: 1
  ranges: true
  clocks:
    maxItems: 1
    description: The SD/SDIO controller clock gate

patternProperties:
  "^sdhci@[0-9a-f]+$":
    type: object
    $ref: mmc-controller.yaml

    properties:
      compatible:
        enum:
          - aspeed,ast2400-sdhci
          - aspeed,ast2500-sdhci
          - aspeed,ast2600-sdhci
      reg:
        maxItems: 1
        description: The SDHCI registers
      clocks:
        maxItems: 1
        description: The SD bus clock
      interrupts:
        maxItems: 1
        description: The SD interrupt shared between both slots
      sdhci,auto-cmd12:
        type: boolean
        description: Specifies that controller should use auto CMD12
    required:
      - compatible
      - reg
      - clocks
      - interrupts

additionalProperties: false

required:
  - compatible
  - reg
  - "#address-cells"
  - "#size-cells"
  - ranges
  - clocks

examples:
  //Example 1
  - |
    #include <dt-bindings/clock/aspeed-clock.h>
    sdc@1e740000 {
            compatible = "aspeed,ast2500-sd-controller";
            reg = <0x1e740000 0x100>;
            #address-cells = <1>;
            #size-cells = <1>;
            ranges = <0 0x1e740000 0x20000>;
            clocks = <&syscon ASPEED_CLK_GATE_SDCLK>;

            sdhci0: sdhci@100 {
                    compatible = "aspeed,ast2500-sdhci";
                    reg = <0x100 0x100>;
                    interrupts = <26>;
                    sdhci,auto-cmd12;
                    clocks = <&syscon ASPEED_CLK_SDIO>;
            };

            sdhci1: sdhci@200 {
                    compatible = "aspeed,ast2500-sdhci";
                    reg = <0x200 0x100>;
                    interrupts = <26>;
                    sdhci,auto-cmd12;
                    clocks = <&syscon ASPEED_CLK_SDIO>;
            };
    };

  //Example 2 (AST2600EVB with GPIO regulator)
  - |
    #include <dt-bindings/clock/aspeed-clock.h>
    #include <dt-bindings/gpio/aspeed-gpio.h>
    vcc_sdhci0: regulator-vcc-sdhci0 {
            compatible = "regulator-fixed";

            regulator-name = "SDHCI0 Vcc";
            regulator-min-microvolt = <3300000>;
            regulator-max-microvolt = <3300000>;
            gpios = <&gpio0 ASPEED_GPIO(V, 0)
                            GPIO_ACTIVE_HIGH>;
            enable-active-high;
    };

    vccq_sdhci0: regulator-vccq-sdhci0 {
            compatible = "regulator-gpio";

            regulator-name = "SDHCI0 VccQ";
            regulator-min-microvolt = <1800000>;
            regulator-max-microvolt = <3300000>;
            gpios = <&gpio0 ASPEED_GPIO(V, 1)
                            GPIO_ACTIVE_HIGH>;
            gpios-states = <1>;
            states = <3300000 1
                      1800000 0>;
    };

    vcc_sdhci1: regulator-vcc-sdhci1 {
            compatible = "regulator-fixed";

            regulator-name = "SDHCI1 Vcc";
            regulator-min-microvolt = <3300000>;
            regulator-max-microvolt = <3300000>;
            gpios = <&gpio0 ASPEED_GPIO(V, 2)
                            GPIO_ACTIVE_HIGH>;
            enable-active-high;
    };

    vccq_sdhci1: regulator-vccq-sdhci1 {
            compatible = "regulator-gpio";

            regulator-name = "SDHCI1 VccQ";
            regulator-min-microvolt = <1800000>;
            regulator-max-microvolt = <3300000>;
            gpios = <&gpio0 ASPEED_GPIO(V, 3)
                            GPIO_ACTIVE_HIGH>;
            gpios-states = <1>;
            states = <3300000 1
                      1800000 0>;
    };

    sdc@1e740000 {
            compatible = "aspeed,ast2600-sd-controller";
            reg = <0x1e740000 0x100>;
            #address-cells = <1>;
            #size-cells = <1>;
            ranges = <0 0x1e740000 0x20000>;
            clocks = <&syscon ASPEED_CLK_GATE_SDCLK>;

            sdhci0: sdhci@100 {
                    compatible = "aspeed,ast2600-sdhci", "sdhci";
                    reg = <0x100 0x100>;
                    interrupts = <GIC_SPI 43 IRQ_TYPE_LEVEL_HIGH>;
                    sdhci,auto-cmd12;
                    clocks = <&syscon ASPEED_CLK_SDIO>;
                    vmmc-supply = <&vcc_sdhci0>;
                    vqmmc-supply = <&vccq_sdhci0>;
                    sd-uhs-sdr104;
                    clk-phase-uhs-sdr104 = <180>, <180>;
            };

            sdhci1: sdhci@200 {
                    compatible = "aspeed,ast2600-sdhci", "sdhci";
                    reg = <0x200 0x100>;
                    interrupts = <GIC_SPI 43 IRQ_TYPE_LEVEL_HIGH>;
                    sdhci,auto-cmd12;
                    clocks = <&syscon ASPEED_CLK_SDIO>;
                    vmmc-supply = <&vcc_sdhci1>;
                    vqmmc-supply = <&vccq_sdhci1>;
                    sd-uhs-sdr104;
                    clk-phase-uhs-sdr104 = <0>, <0>;
            };
    };
```

## Documentation/devicetree/bindings/mmc/sunplus-mmc.yaml
```yaml
# SPDX-License-Identifier: (GPL-2.0-only OR BSD-2-Clause)
# Copyright (C) Sunplus Ltd. Co. 2021
%YAML 1.2
---
$id: http://devicetree.org/schemas/mmc/sunplus-mmc.yaml#
$schema: http://devicetree.org/meta-schemas/core.yaml#

title: sunplus MMC controller

allOf:
  - $ref: "mmc-controller.yaml"

maintainers:
  - Tony Huang <tonyhuang.sunplus@gmail.com>

properties:
  compatible:
    const: sunplus,sp7021-emmc

  reg:
    maxItems: 1

  interrupts:
    maxItems: 1

  clocks:
    minItems: 1

  resets:
    maxItems: 1

required:
  - compatible
  - reg
  - interrupts
  - clocks
  - resets

unevaluatedProperties: false

examples:
  - |
    #include <dt-bindings/interrupt-controller/irq.h>
    #include <dt-bindings/interrupt-controller/arm-gic.h>
    mmc0: mmc@9c003b00 {
        compatible = "sunplus,sp7021-emmc";
        reg = <0x9c003b00 0x180>;
        interrupts = <20 IRQ_TYPE_LEVEL_HIGH>;
        clocks = <&clkc 0x4e>;
        resets = <&rstc 0x3e>;
        bus-width = <8>;
        max-frequency = <52000000>;
        non-removable;
        disable-wp;
        cap-mmc-highspeed;
        mmc-ddr-3_3v;
        no-sdio;
        no-sd;
    };
...
```
