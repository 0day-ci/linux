## Documentation/devicetree/bindings/mfd/google,cros-ec-fp.yaml
```yaml
# SPDX-License-Identifier: (GPL-2.0-only OR BSD-2-Clause)
%YAML 1.2
---
$id: http://devicetree.org/schemas/mfd/google,cros-ec-fp.yaml#
$schema: http://devicetree.org/meta-schemas/core.yaml#

title: ChromeOS Embedded Fingerprint Controller

description:
  Google's ChromeOS embedded fingerprint controller is a device which
  implements fingerprint functionality such as unlocking a Chromebook
  without typing a password.

maintainers:
  - Tom Hughes <tomhughes@chromium.org>

properties:
  compatible:
    const: google,cros-ec-fp

  reg:
    maxItems: 1

  spi-max-frequency:
    maximum: 3000000

  interrupts:
    maxItems: 1

  reset-gpios:
    maxItems: 1
    description: reset signal (active low).

  boot0-gpios:
    maxItems: 1
    description: boot signal (low for normal boot; high for bootloader).

  vdd-supply:
    description: Power supply for the fingerprint controller.

  google,cros-ec-spi-pre-delay:
    description:
      This property specifies the delay in usecs between the
      assertion of the CS and the first clock pulse.
    allOf:
      - $ref: /schemas/types.yaml#/definitions/uint32
      - default: 0
      - minimum: 0

  google,cros-ec-spi-msg-delay:
    description:
      This property specifies the delay in usecs between messages.
    allOf:
      - $ref: /schemas/types.yaml#/definitions/uint32
      - default: 0
      - minimum: 0

required:
  - compatible
  - reg
  - interrupts
  - reset-gpios
  - boot0-gpios
  - vdd-supply
  - spi-max-frequency

additionalProperties: false

examples:
  - |
    #include <dt-bindings/interrupt-controller/irq.h>
    #include <dt-bindings/gpio/gpio.h>
    spi {
      #address-cells = <0x1>;
      #size-cells = <0x0>;
      ec@0 {
        compatible = "google,cros-ec-fp";
        reg = <0>;
        interrupt-parent = <&gpio_controller>;
        interrupts = <4 IRQ_TYPE_LEVEL_LOW>;
        spi-max-frequency = <3000000>;
        google,cros-ec-spi-msg-delay = <37>;
        google,cros-ec-spi-pre-delay = <5>;
        reset-gpios = <&gpio_controller 5 GPIO_ACTIVE_LOW>;
        boot0-gpios = <&gpio_controller 10 GPIO_ACTIVE_LOW>;
        vdd-supply = <&pp3300_fp_mcu>;
      };
    };
...
```

## Documentation/devicetree/bindings/mfd/qcom,pm8008.yaml
```yaml
# SPDX-License-Identifier: GPL-2.0-only OR BSD-2-Clause
%YAML 1.2
---
$id: http://devicetree.org/schemas/mfd/qcom,pm8008.yaml#
$schema: http://devicetree.org/meta-schemas/core.yaml#

title: Qualcomm Technologies, Inc. PM8008 PMIC bindings

maintainers:
  - Guru Das Srinagesh <gurus@codeaurora.org>

description: |
  Qualcomm Technologies, Inc. PM8008 is a dedicated camera PMIC that integrates
  all the necessary power management, housekeeping, and interface support
  functions into a single IC.

properties:
  compatible:
    enum:
      - qcom,pm8008
      - qcom,pm8008-regulators

  reg:
    description:
      I2C slave address.

    maxItems: 1

  interrupts:
    maxItems: 1

    description: Parent interrupt.

  "#interrupt-cells":
    const: 2

    description: |
      The first cell is the IRQ number, the second cell is the IRQ trigger
      flag. All interrupts are listed in include/dt-bindings/mfd/qcom-pm8008.h.

  interrupt-controller: true

  "#address-cells":
    const: 1

  "#size-cells":
    const: 0

  vdd_l1_l2-supply:
    description: Input supply phandle of ldo1 and ldo2 regulators.

  vdd_l3_l4-supply:
    description: Input supply phandle of ldo3 and ldo4 regulators.

  vdd_l5-supply:
    description: Input supply phandle of ldo5 regulator.

  vdd_l6-supply:
    description: Input supply phandle of ldo6 regulator.

  vdd_l7-supply:
    description: Input supply phandle of ldo7 regulator.

  regulators:
    type: object
    $ref: "../regulator/qcom,pm8008-regulator.yaml#"

patternProperties:
  "^gpio@[0-9a-f]+$":
    type: object

    description: |
      The GPIO peripheral. This node may be specified twice, one for each GPIO.

    properties:
      compatible:
        items:
          - const: qcom,pm8008-gpio
          - const: qcom,spmi-gpio

      reg:
        description: Peripheral address of one of the two GPIO peripherals.
        maxItems: 1

      gpio-controller: true

      gpio-ranges:
        maxItems: 1

      interrupt-controller: true

      "#interrupt-cells":
        const: 2

      "#gpio-cells":
        const: 2

    required:
      - compatible
      - reg
      - gpio-controller
      - interrupt-controller
      - "#gpio-cells"
      - gpio-ranges
      - "#interrupt-cells"

    additionalProperties: false

required:
  - compatible
  - reg
  - "#address-cells"
  - "#size-cells"

additionalProperties: false

examples:
  - |
    #include <dt-bindings/mfd/qcom-pm8008.h>
    #include <dt-bindings/interrupt-controller/irq.h>
    qupv3_se13_i2c {
      #address-cells = <1>;
      #size-cells = <0>;
      pm8008_infra: pm8008@8 {
        compatible = "qcom,pm8008";
        reg = <0x8>;
        #address-cells = <1>;
        #size-cells = <0>;
        interrupt-controller;
        #interrupt-cells = <2>;

        interrupt-parent = <&tlmm>;
        interrupts = <32 IRQ_TYPE_EDGE_RISING>;

        pm8008_gpios: gpio@c000 {
          compatible = "qcom,pm8008-gpio", "qcom,spmi-gpio";
          reg = <0xc000>;
          gpio-controller;
          gpio-ranges = <&pm8008_gpios 0 0 2>;
          #gpio-cells = <2>;
          interrupt-controller;
          #interrupt-cells = <2>;
        };
      };

      pm8008_regulators: pm8008@9 {
        compatible = "qcom,pm8008";
        reg = <0x9>;
        #address-cells = <1>;
        #size-cells = <0>;

        vdd_l1_l2-supply = <&vreg_s8b_1p2>;
        vdd_l3_l4-supply = <&vreg_s1b_1p8>;
        vdd_l5-supply = <&vreg_bob>;
        vdd_l6-supply = <&vreg_bob>;
        vdd_l7-supply = <&vreg_bob>;

        regulators {
          pm8008_l1: LDO1 {
            regulator-name = "pm8008_l1";
            regulator-min-microvolt = <950000>;
            regulator-max-microvolt = <1300000>;
          };
        };
      };
    };
...
```

## Documentation/devicetree/bindings/mfd/raspberrypi,sensehat.yaml
```yaml
# SPDX-License-Identifier: (GPL-2.0-only OR BSD-2-Clause)
$id: http://devicetree.org/schemas/mfd/raspberrypi,sensehat.yaml#
$schema: http://devicetree.org/meta-schemas/core.yaml#

title: Raspberry Pi Sensehat

maintainers:
  - Charles Mirabile <cmirabil@redhat.com>
  - Mwesigwa Guma <mguma@redhat.com>
  - Joel Savitz <jsavitz@redhat.com>

description: |
  The Raspberry Pi Sensehat is an addon board originally developed
  for the Raspberry Pi that has a joystick and an 8x8 RGB LED display
  as well as several environmental sensors. It connects via i2c and
  a gpio for irq.

properties:
  compatible:
    oneOf:
      - enum:
        - raspberrypi,sensehat
        - rpi,rpisense

  reg:
    items:
      - description: i2c bus address

  keys-int-gpios:
    items:
      - description: gpio pin for joystick interrupt

required:
  - compatible
  - reg
  - keys-int-gpios

additionalProperties: false

examples:
  - |
    #include <dt-bindings/gpio/gpio.h>
    i2c {
      #address-cells = <1>;
      #size-cells = <0>;
      sensehat@46 {
        compatible = "raspberrypi,sensehat";
        reg = <0x46>;
        keys-int-gpios = <&gpio 23 GPIO_ACTIVE_HIGH>;
      };
    };
```

## Documentation/devicetree/bindings/mfd/realtek,rtl8231.yaml
```yaml
# SPDX-License-Identifier: GPL-2.0-only OR BSD-2-Clause
%YAML 1.2
---
$id: http://devicetree.org/schemas/mfd/realtek,rtl8231.yaml#
$schema: http://devicetree.org/meta-schemas/core.yaml#

title: Realtek RTL8231 GPIO and LED expander.

maintainers:
  - Sander Vanheule <sander@svanheule.net>

description: |
  The RTL8231 is a GPIO and LED expander chip, providing up to 37 GPIOs, up to
  88 LEDs, and up to one PWM output. This device is frequently used alongside
  Realtek switch SoCs, to provide additional I/O capabilities.

  To manage the RTL8231's features, its strapping pins can be used to configure
  it in one of three modes: shift register, MDIO device, or SMI device. The
  shift register mode does not need special support. In MDIO or SMI mode, most
  pins can be configured as a GPIO output, LED matrix scan line/column, or as a
  PWM output.

  The GPIO and pin control are part of the main node. PWM and LED support are
  configured as sub-nodes.

properties:
  compatible:
    const: realtek,rtl8231

  reg:
    description: MDIO or SMI device address.
    maxItems: 1

  # GPIO support
  gpio-controller: true

  "#gpio-cells":
    const: 2
    description: |
      The first cell is the pin number and the second cell is used to specify
      the gpio active state.

  gpio-ranges:
    description: |
      Must reference itself, and provide a zero-based mapping for 37 pins.
    maxItems: 1

  # Pin muxing and configuration
  realtek,drive-strength:
    $ref: /schemas/types.yaml#/definitions/uint32
    description: |
      Common drive strength used for all GPIO output pins, must be 4mA or 8mA.
      On reset, this value will default to 8mA.
    enum: [4, 8]

  # LED scanning matrix
  leds:
    $ref: ../leds/realtek,rtl8231-leds.yaml#

  # PWM output
  pwm:
    type: object
    description: |
      Subnode describing the PWM peripheral. To use the PWM output, gpio35 must
      be muxed to its 'pwm' function. Valid frequency values for consumers are
      1200, 1600, 2000, 2400, 2800, 3200, 4000, and 4800.

    properties:
      "#pwm-cells":
        description: |
          Twos cells with PWM index (must be 0) and PWM frequency in Hz.
        const: 2

    required:
      - "#pwm-cells"

patternProperties:
  "-pins$":
    type: object
    $ref: ../pinctrl/pinmux-node.yaml#

    properties:
      pins:
        items:
          oneOf:
            - enum: ["gpio0", "gpio1", "gpio2", "gpio3", "gpio4", "gpio5", "gpio6",
                     "gpio7", "gpio8", "gpio9", "gpio10", "gpio11", "gpio12", "gpio13",
                     "gpio14", "gpio15", "gpio16", "gpio17", "gpio18", "gpio19", "gpio20",
                     "gpio21", "gpio22", "gpio23", "gpio24", "gpio25", "gpio26", "gpio27",
                     "gpio28", "gpio29", "gpio30", "gpio31", "gpio32", "gpio33", "gpio34",
                     "gpio35", "gpio36"]
        minItems: 1
        maxItems: 37
      function:
        description: |
          Select which function to use. "gpio" is supported for all pins, "led" is supported
          for pins 0-34, "pwm" is supported for for pin 35.
        enum: ["gpio", "led", "pwm"]

    required:
      - pins
      - function

required:
  - compatible
  - reg
  - gpio-controller
  - "#gpio-cells"
  - gpio-ranges

additionalProperties: false

examples:
  - |
    // Minimal example
    mdio {
        #address-cells = <1>;
        #size-cells = <0>;

        expander0: expander@0 {
            compatible = "realtek,rtl8231";
            reg = <0>;

            gpio-controller;
            #gpio-cells = <2>;
            gpio-ranges = <&expander0 0 0 37>;
        };
    };
  - |
    // All bells and whistles included
    #include <dt-bindings/leds/common.h>
    mdio {
        #address-cells = <1>;
        #size-cells = <0>;

        expander1: expander@1 {
            compatible = "realtek,rtl8231";
            reg = <1>;

            gpio-controller;
            #gpio-cells = <2>;
            gpio-ranges = <&expander1 0 0 37>;

            realtek,drive-strength = <4>;

            button-pins {
                pins = "gpio36";
                function = "gpio";
                input-debounce = "100000";
            };

            pwm-pins {
                pins = "gpio35";
                function = "pwm";
            };

            led-pins {
                pins = "gpio0", "gpio1", "gpio3", "gpio4";
                function = "led";
            };

            pwm {
                #pwm-cells = <2>;
            };

            leds {
                compatible = "realtek,rtl8231-leds";
                #address-cells = <2>;
                #size-cells = <0>;

                realtek,led-scan-mode = "single-color";

                led@0,0 {
                    reg = <0 0>;
                    color = <LED_COLOR_ID_GREEN>;
                    function = LED_FUNCTION_LAN;
                    function-enumerator = <0>;
                };

                led@0,1 {
                    reg = <0 1>;
                    color = <LED_COLOR_ID_AMBER>;
                    function = LED_FUNCTION_LAN;
                    function-enumerator = <0>;
                };

                led@1,0 {
                    reg = <1 0>;
                    color = <LED_COLOR_ID_GREEN>;
                    function = LED_FUNCTION_LAN;
                    function-enumerator = <1>;
                };

                led@1,1 {
                    reg = <1 1>;
                    color = <LED_COLOR_ID_AMBER>;
                    function = LED_FUNCTION_LAN;
                    function-enumerator = <1>;
                };
            };
        };
    };
```

## Documentation/devicetree/bindings/mfd/rockchip,rk805.yaml
```yaml
# SPDX-License-Identifier: GPL-2.0-only OR BSD-2-Clause
%YAML 1.2
---
$id: http://devicetree.org/schemas/mfd/rockchip,rk805.yaml#
$schema: http://devicetree.org/meta-schemas/core.yaml#

title: RK808 Power Management Integrated Circuit

maintainers:
  - Chris Zhong <zyw@rock-chips.com>
  - Zhang Qing <zhangqing@rock-chips.com>

description: |
  Rockchip RK805 series PMIC. This device consists of an i2c controlled MFD
  that includes multiple switchable regulators.

properties:
  compatible:
    enum:
      - rockchip,rk805

  reg:
    maxItems: 1

  interrupts:
    maxItems: 1

  '#clock-cells':
    const: 1

  clock-output-names:
    maxItems: 2
    description:
      From common clock binding to override the default output clock name.

  rockchip,system-power-controller:
    type: boolean
    description:
      Telling whether or not this PMIC is controlling the system power.

  wakeup-source:
    type: boolean
    description:
      Device can be used as a wakeup source.

  vcc1-supply:
    description:
      The input supply for DCDC_REG1.

  vcc2-supply:
    description:
      The input supply for DCDC_REG2.

  vcc3-supply:
    description:
      The input supply for DCDC_REG3.

  vcc4-supply:
    description:
      The input supply for DCDC_REG4.

  vcc5-supply:
    description:
      The input supply for LDO_REG1 and LDO_REG2.

  vcc6-supply:
    description:
      The input supply for LDO_REG3.

  regulators:
    type: object
    patternProperties:
      "^(DCDC_REG[1-4]|LDO_REG[1-3])$":
        type: object
        $ref: ../regulator/regulator.yaml#
    unevaluatedProperties: false

required:
  - compatible
  - reg
  - interrupts
  - "#clock-cells"

additionalProperties: false
```
