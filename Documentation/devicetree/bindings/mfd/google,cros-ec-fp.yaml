## Documentation/devicetree/bindings/mmc/sunplus-sd2.yaml
```yaml
# SPDX-License-Identifier: (GPL-2.0 OR BSD-2-Clause)
# Copyright (C) Sunplus Co., Ltd.
%YAML 1.2
---
$id: http://devicetree.org/schemas/mmc/sunplus-sd2.yaml#
$schema: http://devicetree.org/meta-schemas/core.yaml#

title: Sunplus SD/SDIO controller

maintainers:
  - Li-hao Kuo <lhjeff911@gmail.com>

properties:
  compatible:
    enum:
      - sunplus,sp7021-card
      - sunplus,sp7021-sdio

  reg:
    items:
      - description: Base address and length of the SD/SDIO registers

  interrupts:
    maxItems: 1

  clocks:
    maxItems: 1

  resets:
    maxItems: 1

  max-frequency: true

allOf:
  - $ref: "mmc-controller.yaml"

required:
  - compatible
  - reg
  - interrupts
  - clocks
  - resets
  - pinctrl-names
  - pinctrl-0

additionalProperties: false

examples:
  - |
    #include <dt-bindings/clock/sp-sp7021.h>
    #include <dt-bindings/reset/sp-sp7021.h>
    #include <dt-bindings/interrupt-controller/irq.h>
    sdcard: sdcard@9c003e80 {
       compatible = "sunplus,sp7021-card";
       reg = <0x9c003e80 0x280>;
       interrupts = <21 IRQ_TYPE_LEVEL_HIGH>;
       clocks = <&clkc CARD_CTL1>;
       resets = <&rstc RST_CARD_CTL1>;
       pinctrl-names = "default";
       pinctrl-0 = <&mmc1_mux &mmc1_mux_cd>;
       max-frequency = <52000000>;
    };
    sdio: mmc@9c008400 {
       compatible = "sunplus,sp7021-sdio";
       reg = <0x9c008400 0x280>;
       interrupts = <21 IRQ_TYPE_LEVEL_HIGH>;
       clocks = <&clkc CARD_CTL1>;
       resets = <&rstc RST_CARD_CTL1>;
       pinctrl-names = "default";
       pinctrl-0 = <&pins_sdio>;
       max-frequency = <52000000>;
    };
...
```

## Documentation/devicetree/bindings/mtd/amlogic,meson-nand.yaml
```yaml
# SPDX-License-Identifier: (GPL-2.0-only OR BSD-2-Clause)
%YAML 1.2
---
$id: http://devicetree.org/schemas/clock/amlogic,mmc-clkc.yaml#
$schema: http://devicetree.org/meta-schemas/core.yaml#

title: Amlogic NAND Flash Controller (NFC) for GXBB/GXL/AXG family SoCs

maintainers:
  - liang.yang@amlogic.com

properties:
  compatible:
    enum:
      - "amlogic,meson-gxl-nfc"
      - "amlogic,meson-axg-nfc"

  reg:
    maxItems: 2

  interrupts:
    maxItems: 1

  clocks:
    maxItems: 2

  clock-names:
    items:
      - const: "core", "device"

  "#clock-cells":
    const: 1

required:
  - compatible
  - reg
  - interrupts
  - clocks
  - clock-names
  - "#clock-cells"

additionalProperties: false

examples:
  - |
    nand-controller@7800 {
	compatible = "amlogic,meson-axg-nfc";
	reg = <0x0 0x7800 0x0 0x100>,
	      <0x0 0x7000 0x0 0x1>;
	#address-cells = <1>;
	#size-cells = <0>;
	interrupts = <GIC_SPI 34 IRQ_TYPE_EDGE_RISING>;

	clocks = <&clkc CLKID_SD_EMMC_C>,
		<&clkc CLKID_FCLK_DIV2>;
	clock-names = "core", "device";

	pinctrl-names = "default";
	pinctrl-0 = <&nand_pins>;

	nand@0 {
		reg = <0>;
		#address-cells = <1>;
		#size-cells = <1>;

		nand-on-flash-bbt;
	};
     };

...
```

## Documentation/devicetree/bindings/mtd/cypress,hyperflash.yaml
```yaml
# SPDX-License-Identifier: (GPL-2.0-only OR BSD-2-Clause)
%YAML 1.2
---
$id: http://devicetree.org/schemas/mtd/cypress,hyperflash.yaml#
$schema: http://devicetree.org/meta-schemas/core.yaml#

title: HyperFlash serial NOR flash chips

maintainers:
  - Vignesh Raghavendra <vigneshr@ti.com>

allOf:
  - $ref: "mtd.yaml#"

properties:
  compatible:
    items:
      - const: cypress,hyperflash
      - const: cfi-flash
    description:
      HyperFlash serial NOR flash chips compliant with Cypress HyperBus
      specification and supports Cypress CFI specification 1.5 command set.

  reg:
    maxItems: 1

  partitions:
    type: object

  '#address-cells': true
  '#size-cells': true

required:
  - compatible
  - reg

additionalProperties: false

examples:
  - |
    memory-controller {
        #address-cells = <1>;
        #size-cells = <1>;

        flash@0 {
            #address-cells = <1>;
            #size-cells = <1>;
            compatible = "cypress,hyperflash", "cfi-flash";
            reg = <0x0 0x4000000>;
        };
    };
```

## Documentation/devicetree/bindings/mtd/hpe,gxp.txt
```
* HPE GXP BMC

HPE GXP SoC definition

Required properties:
  - compatible : Must contain: "HPE,GXP"

Example:
/ {
	model = "Hewlett Packard Enterprise GXP BMC";
	compatible = "HPE,GXP";
	#address-cells = <1>;
	#size-cells = <1>;

}
```

## Documentation/devicetree/bindings/mtd/nand-chip.yaml
```yaml
# SPDX-License-Identifier: (GPL-2.0-only OR BSD-2-Clause)
%YAML 1.2
---
$id: http://devicetree.org/schemas/mtd/nand-chip.yaml#
$schema: http://devicetree.org/meta-schemas/core.yaml#

title: NAND Chip and NAND Controller Generic Binding

maintainers:
  - Miquel Raynal <miquel.raynal@bootlin.com>

description: |
  This file covers the generic description of a NAND chip. It implies that the
  bus interface should not be taken into account: both raw NAND devices and
  SPI-NAND devices are concerned by this description.

properties:
  reg:
    description:
      Contains the chip-select IDs.

  nand-ecc-engine:
    allOf:
      - $ref: /schemas/types.yaml#/definitions/phandle
    description: |
      A phandle on the hardware ECC engine if any. There are
      basically three possibilities:
      1/ The ECC engine is part of the NAND controller, in this
      case the phandle should reference the parent node.
      2/ The ECC engine is part of the NAND part (on-die), in this
      case the phandle should reference the node itself.
      3/ The ECC engine is external, in this case the phandle should
      reference the specific ECC engine node.

  nand-use-soft-ecc-engine:
    type: boolean
    description: Use a software ECC engine.

  nand-no-ecc-engine:
    type: boolean
    description: Do not use any ECC correction.

  nand-ecc-algo:
    description:
      Desired ECC algorithm.
    $ref: /schemas/types.yaml#/definitions/string
    enum: [hamming, bch, rs]

  nand-ecc-strength:
    description:
      Maximum number of bits that can be corrected per ECC step.
    $ref: /schemas/types.yaml#/definitions/uint32
    minimum: 1

  nand-ecc-step-size:
    description:
      Number of data bytes covered by a single ECC step.
    $ref: /schemas/types.yaml#/definitions/uint32
    minimum: 1

  secure-regions:
    $ref: /schemas/types.yaml#/definitions/uint64-matrix
    description:
      Regions in the NAND chip which are protected using a secure element
      like Trustzone. This property contains the start address and size of
      the secure regions present.

required:
  - reg

additionalProperties: false
```

## Documentation/devicetree/bindings/mtd/partitions/dynamic-partitions.yaml
```yaml
# SPDX-License-Identifier: GPL-2.0-only OR BSD-2-Clause
%YAML 1.2
---
$id: http://devicetree.org/schemas/mtd/partitions/dynamic-partitions.yaml#
$schema: http://devicetree.org/meta-schemas/core.yaml#

title: Dynamic partitions

description: |
  This binding can be used on platforms which have partitions registered at
  runtime by parsers or partition table present on the flash. Example are
  partitions declared from smem parser or cmdlinepart. This will create an
  of node for these dynamic partition where systems like Nvmem can get a
  reference to register nvmem-cells.

  The partition table should be a node named "dynamic-partitions".
  Partitions are then defined as subnodes. Only the label is required
  as any other data will be taken from the parser.

maintainers:
  - Ansuel Smith <ansuelsmth@gmail.com>

properties:
  compatible:
    const: dynamic-partitions

patternProperties:
  "@[0-9a-f]+$":
    $ref: "partition.yaml#"

additionalProperties: true

examples:
  - |
    partitions {
        compatible = "qcom,smem";
        #address-cells = <1>;
        #size-cells = <1>;
    };

    dynamic-partitions {
      compatible = "dynamic-partitions";

      art: art {
        label = "0:art";
        read-only;
        compatible = "nvmem-cells";
        #address-cells = <1>;
        #size-cells = <1>;

        macaddr_art_0: macaddr@0 {
          reg = <0x0 0x6>;
        };

        macaddr_art_6: macaddr@6 {
          reg = <0x6 0x6>;
        };
      };
    };
```

## Documentation/devicetree/bindings/mtd/partitions/partition-dynamic.yaml
```yaml
# SPDX-License-Identifier: GPL-2.0-only OR BSD-2-Clause
%YAML 1.2
---
$id: http://devicetree.org/schemas/mtd/partitions/partition-dynamic.yaml#
$schema: http://devicetree.org/meta-schemas/core.yaml#

title: Dynamic Partition

description: |
  This binding describes a single flash partition that is dynamically allocated
  by a dedicated parser that is not a fixed-partition parser. To declare a
  partition the label is required. This can be used to give a dynamic partition
  an OF node so that subsystems like NVMEM can work and provide NVMEM Cells to
  the system. An example is declaring the partition label and all the NVMEM
  cells in it. The parser will detect the correct reg and offset and the NVMEM
  will register the cells in it based on the data extracted by the parser.

maintainers:
  - Ansuel Smith <ansuelsmth@gmail.com>

properties:
  label:
    description: The label / name for the partition assigned by the parser at
      runtime. This is needed for sybsystem like NVMEM to define cells and
      register with this OF node.

required:
  - label

additionalProperties: true

examples:
  - |
    partitions {
      compatible = "qcom,smem-part";
      #address-cells = <1>;
      #size-cells = <1>;

      art {
        compatible = "nvmem-cells";
        #address-cells = <1>;
        #size-cells = <1>;

        label = "0:art";

        macaddr_art_0: macaddr@0 {
          reg = <0x0 0x6>;
        };

        macaddr_art_6: macaddr@6 {
          reg = <0x6 0x6>;
        };
      };
    };
```

## Documentation/devicetree/bindings/mtd/partitions/ubi.yaml
```yaml
# SPDX-License-Identifier: GPL-2.0-only OR BSD-2-Clause
%YAML 1.2
---
$id: http://devicetree.org/schemas/mtd/partitions/ubi.yaml#
$schema: http://devicetree.org/meta-schemas/core.yaml#

title: UBI (Unsorted Block Images) device

description: |
  UBI is a layer providing logical volumes (consisting of logical blocks) on top
  of raw flash devices. It deals with low-level flash issues (bit-flips, bad
  physical eraseblocks, wearing) providing a reliable data storage.

  UBI device is built and stored in a single flash partition.

  Some (usually embedded) devices use UBI volumes of specific names or indexes
  to store setup / configuration data. This binding allows describing such
  volumes so they can be identified and referenced by consumers.

maintainers:
  - Rafał Miłecki <rafal@milecki.pl>

allOf:
  - $ref: partition.yaml#

properties:
  compatible:
    const: ubi

patternProperties:
  "^volume-[0-9a-f]+$":
    type: object
    description: UBI volume
    properties:
      volume-name:
        $ref: /schemas/types.yaml#/definitions/string
      volume-id:
        $ref: /schemas/types.yaml#/definitions/uint32
    anyOf:
      - required:
          - volume-name
      - required:
          - volume-id

unevaluatedProperties: false

examples:
  - |
    partitions {
        compatible = "fixed-partitions";
        #address-cells = <1>;
        #size-cells = <1>;

        partition@0 {
            compatible = "ubi";
            reg = <0x0000000 0x1000000>;
            label = "filesystem";

            env: volume-0 {
                volume-name = "u-boot-env";
            };

            calibration: volume-1 {
                volume-id = <99>;
            };
        };
    };
```
