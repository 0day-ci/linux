## Documentation/devicetree/bindings/nvmem/denx,u-boot-env.yaml
```yaml
# SPDX-License-Identifier: GPL-2.0-only OR BSD-2-Clause
%YAML 1.2
---
$id: http://devicetree.org/schemas/nvmem/denx,u-boot-env.yaml#
$schema: http://devicetree.org/meta-schemas/core.yaml#

title: U-Boot environment NVMEM Device Tree Bindings

maintainers:
  - Marek Behún <kabel@kernel.org>

description:
  This binding represents U-Boot's environment NVMEM settings which can be
  stored on a specific offset of an EEPROM, MMC, NAND or SATA device, or
  an UBI volume, or in a file on a filesystem.

properties:
  compatible:
    const: denx,u-boot-env

  path:
    description:
      The path to the file containing the environment if on a filesystem.
    $ref: /schemas/types.yaml#/definitions/string

patternProperties:
  "^[^=]+$":
    type: object

    description:
      This node represents one U-Boot environment variable, which is also one
      NVMEM data cell.

    properties:
      name:
        description:
          If the variable name contains characters not allowed in device tree node
          name, use this property to specify the name, otherwise the variable name
          is equal to node name.
        $ref: /schemas/types.yaml#/definitions/string

      type:
        description:
          Type of the variable. Since variables, even integers and MAC addresses,
          are stored as strings in U-Boot environment, for proper conversion the
          type needs to be specified. Use one of the U_BOOT_ENV_TYPE_* prefixed
          definitions from include/dt-bindings/nvmem/u-boot-env.h.
        $ref: /schemas/types.yaml#/definitions/uint32
        minimum: 0
        maximum: 5

    required:
      - type

required:
  - compatible

additionalProperties: true

examples:
  - |

    #include <dt-bindings/nvmem/u-boot-env.h>

    spi-flash {
        partitions {
            compatible = "fixed-partitions";
            #address-cells = <1>;
            #size-cells = <1>;

            partition@180000 {
                compatible = "denx,u-boot-env";
                label = "u-boot-env";
                reg = <0x180000 0x10000>;

                eth0_addr: ethaddr {
                    type = <U_BOOT_ENV_TYPE_MAC_ADDRESS>;
                };
            };
        };
    };

    ethernet-controller {
        nvmem-cells = <&eth0_addr>;
        nvmem-cell-names = "mac-address";
    };

...
```

## Documentation/devicetree/bindings/nvmem/mediatek,efuse.yaml
```yaml
# SPDX-License-Identifier: (GPL-2.0-only OR BSD-2-Clause)
%YAML 1.2
---
$id: http://devicetree.org/schemas/nvmem/mediatek,efuse.yaml#
$schema: http://devicetree.org/meta-schemas/core.yaml#

title: MediaTek efuse device tree bindings

description: |
  MediaTek's efuse is used for storing calibration data, it can be accessed
  on ARM devices usiong I/O mapped memory.

maintainers:
  - Andrew-CT Chen <andrew-ct.chen@mediatek.com>

allOf:
  - $ref: "nvmem.yaml#"

properties:
  $nodename:
    pattern: "^efuse@[0-9a-f]+$"

  compatible:
    oneOf:
      - items:
          - enum:
              - mediatek,mt7622-efuse
              - mediatek,mt7623-efuse
              - mediatek,mt8173-efuse
              - mediatek,mt8192-efuse
              - mediatek,mt8195-efuse
              - mediatek,mt8516-efuse
          - const: mediatek,efuse
      - const: mediatek,mt8173-efuse
        deprecated: true

  reg:
    maxItems: 1

  "#address-cells":
    const: 1

  "#size-cells":
    const: 1

patternProperties:
  "^.*@[0-9a-f]+$":
    type: object

    properties:
      reg:
        maxItems: 1

      bits:
        maxItems: 1

    required:
      - reg

    additionalProperties: false

required:
  - compatible
  - reg

unevaluatedProperties: false

examples:
  - |
    efuse@10206000 {
        compatible = "mediatek,mt8173-efuse";
        reg = <0x10206000 0x1000>;
        #address-cells = <1>;
        #size-cells = <1>;

        u2_intr_p0: usb2-intr-p0@188 {
            reg = <0x188 0x1>;
            bits = <0 5>;
        };

        u2_intr_p1: usb2-intr-p1@188 {
            reg = <0x188 0x2>;
            bits = <5 5>;
        };

        thermal_calibration: calib@528 {
            reg = <0x528 0xc>;
        };
    };
```

## Documentation/devicetree/bindings/nvmem/nvmem-transformations.yaml
```yaml
# SPDX-License-Identifier: (GPL-2.0 OR BSD-2-Clause)
%YAML 1.2
---
$id: http://devicetree.org/schemas/nvmem/nvmem-transformations.yaml#
$schema: http://devicetree.org/meta-schemas/core.yaml#

title: NVMEM transformations Device Tree Bindings

maintainers:
  - Srinivas Kandagatla <srinivas.kandagatla@linaro.org>

description: |
  This is a list NVMEM devices which need transformations.

properties:
  compatible:
    oneOf:
      - items:
        - enum:
          - kontron,sl28-vpd
        - const: user-otp
      - const: user-otp

required:
  - compatible

additionalProperties: true

examples:
  - |
    otp-1 {
            compatible = "kontron,sl28-vpd", "user-otp";
            #address-cells = <1>;
            #size-cells = <1>;

            serial@2 {
                    reg = <2 15>;
            };

            base_mac_address: base-mac-address@17 {
                    #nvmem-cell-cells = <1>;
                    reg = <17 6>;
            };
    };

...
```

## Documentation/devicetree/bindings/nvmem/nvmem.yaml
```yaml
# SPDX-License-Identifier: (GPL-2.0 OR BSD-2-Clause)
%YAML 1.2
---
$id: http://devicetree.org/schemas/nvmem/nvmem.yaml#
$schema: http://devicetree.org/meta-schemas/core.yaml#

title: NVMEM (Non Volatile Memory) Device Tree Bindings

maintainers:
  - Srinivas Kandagatla <srinivas.kandagatla@linaro.org>

description: |
  This binding is intended to represent the location of hardware
  configuration data stored in NVMEMs like eeprom, efuses and so on.

  On a significant proportion of boards, the manufacturer has stored
  some data on NVMEM, for the OS to be able to retrieve these
  information and act upon it. Obviously, the OS has to know about
  where to retrieve these data from, and where they are stored on the
  storage device.

properties:
  "#address-cells":
    const: 1

  "#size-cells":
    const: 1

  '#nvmem-cell-cells':
    enum: [0, 1]
    description:
      Must be 1 if the transformations has multiple output values.
      The argument is then the index into the list of output values.
      For example, if the nvmem cell only specify a base ethernet
      address the transformation can then create different individual
      ethernet addresses.

  read-only:
    $ref: /schemas/types.yaml#/definitions/flag
    description:
      Mark the provider as read only.

  transformation:
    description:
      Transform the content of a NVMEM cell. Sometimes it is necessary
      to preprocess the content of a cell so it is usable by the NVMEM
      consumer. There are also cases where one NVMEM cell value can
      generate a list of values.

      Use one of the NVMEM_T_* prefixed definitions from the header
      include/dt-bindings/nvmem/nvmem.h.

      Some transformations might have additional arguments.
    $ref: /schemas/types.yaml#/definitions/uint32


  wp-gpios:
    description:
      GPIO to which the write-protect pin of the chip is connected.
      The write-protect GPIO is asserted, when it's driven high
      (logical '1') to block the write operation. It's deasserted,
      when it's driven low (logical '0') to allow writing.
    maxItems: 1

patternProperties:
  "@[0-9a-f]+(,[0-7])?$":
    type: object

    properties:
      reg:
        maxItems: 1
        description:
          Offset and size in bytes within the storage device.

      bits:
        maxItems: 1
        items:
          items:
            - minimum: 0
              maximum: 7
              description:
                Offset in bit within the address range specified by reg.
            - minimum: 1
              description:
                Size in bit within the address range specified by reg.

    required:
      - reg

additionalProperties: true

examples:
  - |
      #include <dt-bindings/gpio/gpio.h>

      qfprom: eeprom@700000 {
          #address-cells = <1>;
          #size-cells = <1>;
          reg = <0x00700000 0x100000>;

          wp-gpios = <&gpio1 3 GPIO_ACTIVE_HIGH>;

          /* ... */

          /* Data cells */
          tsens_calibration: calib@404 {
              reg = <0x404 0x10>;
          };

          tsens_calibration_bckp: calib_bckp@504 {
              reg = <0x504 0x11>;
              bits = <6 128>;
          };

          pvs_version: pvs-version@6 {
              reg = <0x6 0x2>;
              bits = <7 2>;
          };

          speed_bin: speed-bin@c{
              reg = <0xc 0x1>;
              bits = <2 3>;
          };

          ethernet_base_mac: base-mac-address@100 {
              #nvmem-cell-cells = <1>;
              reg = <0x100 0x6>;
              transformation = <NVMEM_T_ETH_OFFSET 0 1 2 7>;
          };
      };

...
```

## Documentation/devicetree/bindings/nvmem/sunplus,sp7021-ocotp.yaml
```yaml
# SPDX-License-Identifier: (GPL-2.0-only OR BSD-2-Clause)
# Copyright (C) Sunplus Co., Ltd. 2021
%YAML 1.2
---
$id: http://devicetree.org/schemas/nvmem/sunplus,sp7021-ocotp.yaml#
$schema: http://devicetree.org/meta-schemas/core.yaml#

title: On-Chip OTP Memory for Sunplus sp7021

maintainers:
  - Vincent Shih <vincent.shih@sunplus.com>

allOf:
  - $ref: "nvmem.yaml#"

properties:
  compatible:
    const: sunplus,sp7021-ocotp

  reg:
    maxItems: 2

  reg-names:
    items:
      - const: hb_gpio
      - const: otprx

  clocks:
    maxItems: 1

  resets:
    maxItems: 1

  "#address-cells":
    const: 1

  "#size-cells":
    const: 1

  therm_calib:
    type: object
    description: thermal calibration values
    properties:
      reg:
        maxItems: 1

    required:
      - reg

  mac_addr0:
    type: object
    description: MAC address of ethernet port 0
    properties:
      reg:
        maxItems: 1

    required:
      - reg

  mac_addr1:
    type: object
    description: MAC address of ethernet port 1
    properties:
      reg:
        maxItems: 1

    required:
      - reg

  disc_vol:
    type: object
    description: disconnect voltages of usb2 port 0 and port 1
    properties:
      reg:
        maxItems: 1

    required:
      - reg

required:
  - compatible
  - reg
  - reg-names
  - clocks
  - resets

unevaluatedProperties: false

examples:
  - |
    #include <dt-bindings/clock/sp-sp7021.h>
    #include <dt-bindings/reset/sp-sp7021.h>

    otp: otp@9C00AF00 {
        compatible = "sunplus,sp7021-ocotp";
        reg = <0x9C00AF00 0x34>, <0x9C00AF80 0x58>;
        reg-names = "hb_gpio", "otprx";
        clocks = <&clks OTPRX>;
        resets = <&rstc RST_OTPRX>;

        #address-cells = <1>;
        #size-cells = <1>;
        therm_calib: therm_calib@14 {
          reg = <0x14 0x3>;
        };
        mac_addr0: mac_addr0@34 {
          reg = <0x34 0x6>;
        };
        mac_addr1: mac_addr1@3A {
          reg = <0x3A 0x6>;
        };
        disc_vol: disc_vol@18 {
          reg = <0x18 0x2>;
        };
    };
...
```

## Documentation/devicetree/bindings/nvmem/u-boot,env.yaml
```yaml
# SPDX-License-Identifier: GPL-2.0-only OR BSD-2-Clause
%YAML 1.2
---
$id: http://devicetree.org/schemas/nvmem/u-boot,env.yaml#
$schema: http://devicetree.org/meta-schemas/core.yaml#

title: U-Boot environment variables

description: |
  U-Boot uses environment variables to store device parameters and
  configuration. They may be used for booting process, setup or keeping end user
  info.

  Data is stored on flash in a U-Boot specific format (header and NUL separated
  key-value pairs).

  This binding allows specifying data location and used format.

maintainers:
  - Rafał Miłecki <rafal@milecki.pl>

allOf:
  - $ref: nvmem.yaml#

properties:
  compatible:
    oneOf:
      - description: A standalone env data block
        const: u-boot,env
      - description: Two redundant blocks with active one flagged
        const: u-boot,env-redundant-bool
      - description: Two redundant blocks with active having higher counter
        const: u-boot,env-redundant-count

  reg:
    maxItems: 1

unevaluatedProperties: false

examples:
  - |
    partitions {
        compatible = "fixed-partitions";
        #address-cells = <1>;
        #size-cells = <1>;

        partition@0 {
            label = "u-boot";
            reg = <0x0 0x40000>;
            read-only;
        };

        partition@40000 {
            compatible = "u-boot,env";
            label = "u-boot-env";
            reg = <0x40000 0x10000>;
        };
    };
```

## Documentation/devicetree/bindings/opp/apple,mcc-operating-points.yaml
```yaml
# SPDX-License-Identifier: (GPL-2.0-only OR BSD-2-Clause)
%YAML 1.2
---
$id: http://devicetree.org/schemas/opp/apple,mcc-operating-points.yaml#
$schema: http://devicetree.org/meta-schemas/core.yaml#

title: Apple SoC memory controller OPP bindings

maintainers:
  - Hector Martin <marcan@marcan.st>

description: |
  Apple SoCs can have their memory controller performance adjusted depending on
  system requirements. These performance states are represented by specific
  memory controller register values. The apple-mcc driver uses these values
  to change the MCC performance.

allOf:
  - $ref: opp-v2-base.yaml#

properties:
  compatible:
    const: apple,mcc-operating-points

required:
  - compatible

patternProperties:
  "opp[0-9]+":
    type: object

    properties:
      opp-level: true
      apple,memory-perf-config:
        $ref: /schemas/types.yaml#/definitions/uint32-array
        description: |
          A pair of register values used to configure this performance state.
        minItems: 2
        maxItems: 2

    required:
      - opp-level
      - apple,memory-perf-config

    unevaluatedProperties: false

additionalProperties: false

examples:
  - |
    mcc_opp: opp-table-2 {
        compatible = "operating-points-v2";

        mcc_lowperf: opp0 {
            opp-level = <0>;
            apple,memory-perf-config = <0x813057f 0x1800180>;
        };
        mcc_highperf: opp1 {
            opp-level = <1>;
            apple,memory-perf-config = <0x133 0x55555340>;
        };
    };
```
