## Documentation/devicetree/bindings/pci/st,st-pcie.yaml
```yaml
# SPDX-License-Identifier: (GPL-2.0 OR BSD-2-Clause)
%YAML 1.2
---
$id: http://devicetree.org/schemas/pci/st,st-pcie.yaml#
$schema: http://devicetree.org/meta-schemas/core.yaml#

title: PCIe RC controller on ST STi platform

maintainers:
  - Alain Volmat <avolmat@me.com>

allOf:
  - $ref: /schemas/pci/snps,dw-pcie.yaml#

properties:
  compatible:
    const: st,stih407-pcie

  reg:
    items:
      - description: Controller control and status registers.
      - description: PCIe configuration registers.
      - description: Memory made available to the controller

  reg-names:
    items:
      - const: dbi
      - const: config
      - const: mem-window

  interrupts:
    maxItems: 1

  resets:
    items:
    - description: Controller reset
    - description: Powerdown reset (optional)
    minItems: 1

  reset-names:
    items:
      - const: softreset
      - const: powerdown
    minItems: 1

  phys:
    maxItems: 1

  phy-names:
    const: pcie

  reset-gpios: true

  st,syscfg:
    $ref: "/schemas/types.yaml#/definitions/phandle-array"
    description: syscfg node phandle and offsets of the 2 registers
                 controlling root complex and ltssm.

required:
  - interrupts
  - '#interrupt-cells'
  - interrupt-map
  - interrupt-map-mask
  - resets
  - reset-names
  - phys
  - phy-names

unevaluatedProperties: false

examples:
  - |
    #include <dt-bindings/gpio/gpio.h>
    #include <dt-bindings/interrupt-controller/irq.h>
    #include <dt-bindings/interrupt-controller/arm-gic.h>
    #include <dt-bindings/phy/phy.h>
    #include <dt-bindings/reset/stih407-resets.h>
    pcie1: pcie@9b10000 {
      compatible = "st,stih407-pcie";
      device_type = "pci";
      #address-cells = <3>;
      #size-cells = <2>;
      reg = <0x09b10000 0x1000>,
            <0x3fff0000 0x10000>,
            <0x40000000 0xc0000000>;
      reg-names = "dbi", "config", "mem-window";

      #interrupt-cells = <1>;
      interrupts = <GIC_SPI 175 IRQ_TYPE_LEVEL_HIGH>;
      interrupt-names = "msi";
      interrupt-map-mask = <0 0 0 7>;
      interrupt-map = <0 0 0 1 &intc GIC_SPI 171 IRQ_TYPE_LEVEL_HIGH>,
                      <0 0 0 2 &intc GIC_SPI 172 IRQ_TYPE_LEVEL_HIGH>,
                      <0 0 0 3 &intc GIC_SPI 173 IRQ_TYPE_LEVEL_HIGH>,
                      <0 0 0 4 &intc GIC_SPI 174 IRQ_TYPE_LEVEL_HIGH>;

      st,syscfg = <&syscfg_core 0xdc 0xe4>;

      ranges = <0x82000000 0 0x30000000 0x30000000 0 0x05550000>, /* non-prefetchable memory */
               <0xc2000000 0 0x35550000 0x35550000 0 0x0AAA0000>; /* prefetchable memory */
      bus-range = <0x00 0xff>;

      resets = <&softreset STIH407_PCIE1_SOFTRESET>,
               <&powerdown STIH407_PCIE1_POWERDOWN>;

      reset-names = "softreset", "powerdown";

      phys = <&phy_port1 PHY_TYPE_PCIE>;
      phy-names = "pcie";

      reset-gpios = <&pio34 5 GPIO_ACTIVE_LOW>;
    };
```

## Documentation/devicetree/bindings/pci/xilinx-versal-cpm.yaml
```yaml
# SPDX-License-Identifier: (GPL-2.0-only OR BSD-2-Clause)
%YAML 1.2
---
$id: http://devicetree.org/schemas/pci/xilinx-versal-cpm.yaml#
$schema: http://devicetree.org/meta-schemas/core.yaml#

title: CPM Host Controller device tree for Xilinx Versal SoCs

maintainers:
  - Bharat Kumar Gogada <bharat.kumar.gogada@xilinx.com>

allOf:
  - $ref: /schemas/pci/pci-bus.yaml#

properties:
  compatible:
    contains:
      enum:
        - xlnx,versal-cpm-host-1.00
        - xlnx,versal-cpm5-host-1.00

  reg:
    description: |
      Should contain cpm_slcr, cfg registers location and length.
      For xlnx,versal-cpm5-host-1.00, it should also contain cpm_csr.
    minItems: 2
    maxItems: 3

  reg-names:
    minItems: 2
    maxItems: 3

  interrupts:
    maxItems: 1

  msi-map:
    description:
      Maps a Requester ID to an MSI controller and associated MSI sideband data.

  ranges:
    maxItems: 2

  "#interrupt-cells":
    const: 1

  interrupt-controller:
    description: Interrupt controller node for handling legacy PCI interrupts.
    type: object
    properties:
      "#address-cells":
        const: 0
      "#interrupt-cells":
        const: 1
      "interrupt-controller": true
    additionalProperties: false

required:
  - reg
  - reg-names
  - "#interrupt-cells"
  - interrupts
  - interrupt-map
  - interrupt-map-mask
  - bus-range
  - msi-map
  - interrupt-controller

unevaluatedProperties: false

examples:
  - |

    versal {
               #address-cells = <2>;
               #size-cells = <2>;
               cpm_pcie: pcie@fca10000 {
                       compatible = "xlnx,versal-cpm-host-1.00";
                       device_type = "pci";
                       #address-cells = <3>;
                       #interrupt-cells = <1>;
                       #size-cells = <2>;
                       interrupts = <0 72 4>;
                       interrupt-parent = <&gic>;
                       interrupt-map-mask = <0 0 0 7>;
                       interrupt-map = <0 0 0 1 &pcie_intc_0 0>,
                                       <0 0 0 2 &pcie_intc_0 1>,
                                       <0 0 0 3 &pcie_intc_0 2>,
                                       <0 0 0 4 &pcie_intc_0 3>;
                       bus-range = <0x00 0xff>;
                       ranges = <0x02000000 0x0 0xe0000000 0x0 0xe0000000 0x0 0x10000000>,
                                <0x43000000 0x80 0x00000000 0x80 0x00000000 0x0 0x80000000>;
                       msi-map = <0x0 &its_gic 0x0 0x10000>;
                       reg = <0x6 0x00000000 0x0 0x10000000>,
                             <0x0 0xfca10000 0x0 0x1000>;
                       reg-names = "cfg", "cpm_slcr";
                       pcie_intc_0: interrupt-controller {
                               #address-cells = <0>;
                               #interrupt-cells = <1>;
                               interrupt-controller;
                       };
               };

              cpm5_pcie: pcie@fcdd0000 {
                       compatible = "xlnx,versal-cpm5-host-1.00";
                       device_type = "pci";
                       #address-cells = <3>;
                       #interrupt-cells = <1>;
                       #size-cells = <2>;
                       interrupts = <0 72 4>;
                       interrupt-parent = <&gic>;
                       interrupt-map-mask = <0 0 0 7>;
                       interrupt-map = <0 0 0 1 &pcie_intc_1 0>,
                                       <0 0 0 2 &pcie_intc_1 1>,
                                       <0 0 0 3 &pcie_intc_1 2>,
                                       <0 0 0 4 &pcie_intc_1 3>;
                       bus-range = <0x00 0xff>;
                       ranges = <0x02000000 0x0 0xe0000000 0x0 0xe0000000 0x0 0x10000000>,
                                <0x43000000 0x80 0x00000000 0x80 0x00000000 0x0 0x80000000>;
                       msi-map = <0x0 &its_gic 0x0 0x10000>;
                       reg = <0x00 0xfcdd0000 0x00 0x1000>,
                             <0x06 0x00000000 0x00 0x1000000>,
                             <0x00 0xfce20000 0x00 0x1000000>;
                       reg-names = "cpm_slcr", "cfg", "cpm_csr";

                       pcie_intc_1: interrupt-controller {
                               #address-cells = <0>;
                               #interrupt-cells = <1>;
                               interrupt-controller;
                       };
               };
    };
```

## Documentation/devicetree/bindings/peci/peci-aspeed.yaml
```yaml
# SPDX-License-Identifier: (GPL-2.0-only OR BSD-2-Clause)
%YAML 1.2
---
$id: http://devicetree.org/schemas/peci/peci-aspeed.yaml#
$schema: http://devicetree.org/meta-schemas/core.yaml#

title: Aspeed PECI Bus Device Tree Bindings

maintainers:
  - Iwona Winiarska <iwona.winiarska@intel.com>
  - Jae Hyun Yoo <jae.hyun.yoo@linux.intel.com>

allOf:
  - $ref: peci-controller.yaml#

properties:
  compatible:
    enum:
      - aspeed,ast2400-peci
      - aspeed,ast2500-peci
      - aspeed,ast2600-peci

  reg:
    maxItems: 1

  interrupts:
    maxItems: 1

  clocks:
    description:
      Clock source for PECI controller. Should reference the external
      oscillator clock.
    maxItems: 1

  resets:
    maxItems: 1

  cmd-timeout-ms:
    minimum: 1
    maximum: 1000
    default: 1000

  aspeed,clock-divider:
    description:
      This value determines PECI controller internal clock dividing
      rate. The divider will be calculated as 2 raised to the power of
      the given value.
    $ref: /schemas/types.yaml#/definitions/uint32
    minimum: 0
    maximum: 7
    default: 0

  aspeed,msg-timing:
    description:
      Message timing negotiation period. This value will determine the period
      of message timing negotiation to be issued by PECI controller. The unit
      of the programmed value is four times of PECI clock period.
    $ref: /schemas/types.yaml#/definitions/uint32
    minimum: 0
    maximum: 255
    default: 1

  aspeed,addr-timing:
    description:
      Address timing negotiation period. This value will determine the period
      of address timing negotiation to be issued by PECI controller. The unit
      of the programmed value is four times of PECI clock period.
    $ref: /schemas/types.yaml#/definitions/uint32
    minimum: 0
    maximum: 255
    default: 1

  aspeed,rd-sampling-point:
    description:
      Read sampling point selection. The whole period of a bit time will be
      divided into 16 time frames. This value will determine the time frame
      in which the controller will sample PECI signal for data read back.
      Usually in the middle of a bit time is the best.
    $ref: /schemas/types.yaml#/definitions/uint32
    minimum: 0
    maximum: 15
    default: 8

required:
  - compatible
  - reg
  - interrupts
  - clocks
  - resets

additionalProperties: false

examples:
  - |
    #include <dt-bindings/interrupt-controller/arm-gic.h>
    #include <dt-bindings/clock/ast2600-clock.h>
    peci-controller@1e78b000 {
      compatible = "aspeed,ast2600-peci";
      reg = <0x1e78b000 0x100>;
      interrupts = <GIC_SPI 38 IRQ_TYPE_LEVEL_HIGH>;
      clocks = <&syscon ASPEED_CLK_GATE_REF0CLK>;
      resets = <&syscon ASPEED_RESET_PECI>;
      cmd-timeout-ms = <1000>;
      aspeed,clock-divider = <0>;
      aspeed,msg-timing = <1>;
      aspeed,addr-timing = <1>;
      aspeed,rd-sampling-point = <8>;
    };
...
```

## Documentation/devicetree/bindings/perf/marvell-cn10k-tad.yaml
```yaml
# SPDX-License-Identifier: (GPL-2.0-only OR BSD-2-Clause)
%YAML 1.2
---
$id: http://devicetree.org/schemas/perf/marvell-cn10k-tad.yaml#
$schema: http://devicetree.org/meta-schemas/core.yaml#

title: Marvell CN10K LLC-TAD performance monitor

maintainers:
  - Bhaskara Budiredla <bbudiredla@marvell.com>

description: |
  The Tag-and-Data units (TADs) maintain coherence and contain CN10K
  shared on-chip last level cache (LLC). The tad pmu measures the
  performance of last-level cache. Each tad pmu supports up to eight
  counters.

  The DT setup comprises of number of tad blocks, the sizes of pmu
  regions, tad blocks and overall base address of the HW.

properties:
  compatible:
    const: marvell,cn10k-tad-pmu

  reg:
    maxItems: 1

required:
  - compatible
  - tad-cnt
  - tad-page-size
  - tad-pmu-page-size
  - reg

additionalProperties: false

examples:
  - |
    tad_pmu@0x87e280000000 {
        compatible = "marvell,cn10k-tad-pmu";
        tad-cnt = <1>;
        tad-page-size = <0x1000>;
        tad-pmu-page-size = <0x1000>;
        reg = <0x87e2 0x80000000 0x0 0x1000>;
    };
```

## Documentation/devicetree/bindings/perf/riscv,pmu.yaml
```yaml
# SPDX-License-Identifier: (GPL-2.0-only OR BSD-2-Clause)
%YAML 1.2
---
$id: http://devicetree.org/schemas/pmu/riscv,pmu.yaml#
$schema: http://devicetree.org/meta-schemas/core.yaml#

title: RISC-V PMU

maintainers:
  - Atish Patra <atish.patra@wdc.com>

description:
  The "Sscofpmf" extension allows the RISC-V PMU counters to overflow and
  generate a local interrupt so that event sampling can be done from user-space.
  The above said ISA extension is an optional extension to maintain backward
  compatibility and will be included in privilege specification v1.12 . That's
  why the interrupt property is marked as optional. The platforms with sscofpmf
  extension should add this property to enable event sampling.
  The device tree node with the compatible string is mandatory for any platform
  that wants to use pmu counter start/stop methods using SBI PMU extension.

properties:
  compatible:
    enum:
      - riscv,pmu

    description:
      Should be "riscv,pmu".

  interrupts-extended:
    minItems: 1
    maxItems: 4095

additionalProperties: false

required:
  - None
optional:
  - compatible
  - interrupts-extended

examples:
  - |
    pmu {
      compatible = "riscv,pmu";
      interrupts-extended = <&cpu0intc 13>,
                            <&cpu1intc 13>,
                            <&cpu2intc 13>,
                            <&cpu3intc 13>;
    };
...
```
