## Documentation/devicetree/bindings/pci/apple,pcie.yaml
```yaml
# SPDX-License-Identifier: (GPL-2.0-only OR BSD-2-Clause)
%YAML 1.2
---
$id: http://devicetree.org/schemas/pci/apple,pcie.yaml#
$schema: http://devicetree.org/meta-schemas/core.yaml#

title: Apple SoC PCIe Controller Device Tree Bindings

maintainers:
  - Alyssa Rosenzweig <alyssa@rosenzweig.io>

description: |+
  Apple SoC PCIe host controller.

allOf:
 - $ref: /schemas/pci/pci-bus.yaml#

properties:
  compatible:
    const: apple,pcie

  reg:
    items:
      - description: PCIe configuration region.
      - description: Core registers.
      - description: AXI bridge registers.
      - description: Port 0 (radio) registers.
      - description: Port 1 (USB) registers.
      - description: Port 2 (Ethernet) registers.

  reg-names:
    items:
      - const: config
      - const: rc
      - const: phy
      - const: port0
      - const: port1
      - const: port2

  interrupts:
    maxItems: 35

  msi-controller:
    description: Identifies the node as an MSI controller.

  msi-parent:
    description: MSI controller the device is capable of using.

  reset-gpios:
    description: Reset lines for each of the ports of the controller.

  pinctrl-0:
    description: Pin controller for the reset lines.

  pinctrl-names:
    description: Names for the pin controller.

required:
  - reg
  - reg-names
  - interrupt-parent
  - interrupts
  - msi-controller
  - msi-parent
  - msi-interrupts
  - iommu-map
  - iommu-map-mask
  - pinctrl-0
  - pinctrl-names
  - reset-gpios
  - bus-range
  - "#address-cells"
  - "#size-cells"
  - ranges
  - device_type

unevaluatedProperties: false

examples:
  - |
    #include <dt-bindings/interrupt-controller/apple-aic.h>
    #include <dt-bindings/interrupt-controller/irq.h>

    soc {
        #address-cells = <2>;
        #size-cells = <2>;
        pcie0: pcie@690000000 {
       	    compatible = "apple,pcie";
       	    reg = <0x6 0x90000000 0x0 0x1000000>,
       	          <0x6 0x80000000 0x0 0x100000>,
       	          <0x6 0x8c000000 0x0 0x100000>,
       	          <0x6 0x81000000 0x0 0x4000>,
       	          <0x6 0x82000000 0x0 0x4000>,
       	          <0x6 0x83000000 0x0 0x4000>;
       	    reg-names = "config", "rc", "phy", "port0",
       	    	    "port1", "port2";
       	    interrupt-parent = <&aic>;
       	    interrupts = <AIC_IRQ 695 IRQ_TYPE_LEVEL_HIGH>,
       	    	     <AIC_IRQ 698 IRQ_TYPE_LEVEL_HIGH>,
       	    	     <AIC_IRQ 701 IRQ_TYPE_LEVEL_HIGH>,
       	    	     <AIC_IRQ 704 IRQ_TYPE_LEVEL_HIGH>,
       	    	     <AIC_IRQ 705 IRQ_TYPE_LEVEL_HIGH>,
       	    	     <AIC_IRQ 706 IRQ_TYPE_LEVEL_HIGH>,
       	    	     <AIC_IRQ 707 IRQ_TYPE_LEVEL_HIGH>,
       	    	     <AIC_IRQ 708 IRQ_TYPE_LEVEL_HIGH>,
       	    	     <AIC_IRQ 709 IRQ_TYPE_LEVEL_HIGH>,
       	    	     <AIC_IRQ 710 IRQ_TYPE_LEVEL_HIGH>,
       	    	     <AIC_IRQ 711 IRQ_TYPE_LEVEL_HIGH>,
       	    	     <AIC_IRQ 712 IRQ_TYPE_LEVEL_HIGH>,
       	    	     <AIC_IRQ 713 IRQ_TYPE_LEVEL_HIGH>,
       	    	     <AIC_IRQ 714 IRQ_TYPE_LEVEL_HIGH>,
       	    	     <AIC_IRQ 715 IRQ_TYPE_LEVEL_HIGH>,
       	    	     <AIC_IRQ 716 IRQ_TYPE_LEVEL_HIGH>,
       	    	     <AIC_IRQ 717 IRQ_TYPE_LEVEL_HIGH>,
       	    	     <AIC_IRQ 718 IRQ_TYPE_LEVEL_HIGH>,
       	    	     <AIC_IRQ 719 IRQ_TYPE_LEVEL_HIGH>,
       	    	     <AIC_IRQ 720 IRQ_TYPE_LEVEL_HIGH>,
       	    	     <AIC_IRQ 721 IRQ_TYPE_LEVEL_HIGH>,
       	    	     <AIC_IRQ 722 IRQ_TYPE_LEVEL_HIGH>,
       	    	     <AIC_IRQ 723 IRQ_TYPE_LEVEL_HIGH>,
       	    	     <AIC_IRQ 724 IRQ_TYPE_LEVEL_HIGH>,
       	    	     <AIC_IRQ 725 IRQ_TYPE_LEVEL_HIGH>,
       	    	     <AIC_IRQ 726 IRQ_TYPE_LEVEL_HIGH>,
       	    	     <AIC_IRQ 727 IRQ_TYPE_LEVEL_HIGH>,
       	    	     <AIC_IRQ 728 IRQ_TYPE_LEVEL_HIGH>,
       	    	     <AIC_IRQ 729 IRQ_TYPE_LEVEL_HIGH>,
       	    	     <AIC_IRQ 730 IRQ_TYPE_LEVEL_HIGH>,
       	    	     <AIC_IRQ 731 IRQ_TYPE_LEVEL_HIGH>,
       	    	     <AIC_IRQ 732 IRQ_TYPE_LEVEL_HIGH>,
       	    	     <AIC_IRQ 733 IRQ_TYPE_LEVEL_HIGH>,
       	    	     <AIC_IRQ 734 IRQ_TYPE_LEVEL_HIGH>,
       	    	     <AIC_IRQ 735 IRQ_TYPE_LEVEL_HIGH>;
       	    msi-controller;
       	    msi-parent = <&pcie0>;
       	    msi-interrupts = <704 32>;
       	    iommu-map = <0x100 &pcie0_dart_0 0 1>,
       	    	    <0x200 &pcie0_dart_1 0 1>,
       	    	    <0x300 &pcie0_dart_2 0 1>;
       	    iommu-map-mask = <0xff00>;
       	    pinctrl-0 = <&pcie_pins>;
       	    pinctrl-names = "default";
       	    reset-gpios = <&gpio 152 0   &gpio 153 0   &gpio 33 0>;
       	    bus-range = <0 15>;
       	    #address-cells = <3>;
       	    #size-cells = <2>;
       	    ranges = <0x43000000 0x6 0xa0000000 0x6 0xa0000000
       	    	  0x0 0x20000000>,
       	    	 <0x02000000 0x0 0xc0000000 0x6 0xc0000000
       	    	  0x0 0x40000000>;
       	    device_type = "pci";
        };
    };
...
```

## Documentation/devicetree/bindings/pci/kirin-pcie.txt
```
HiSilicon Kirin SoCs PCIe host DT description

Kirin PCIe host controller is based on the Synopsys DesignWare PCI core.
It shares common functions with the PCIe DesignWare core driver and
inherits common properties defined in
Documentation/devicetree/bindings/pci/designware-pcie.txt.

Additional properties are described here:

Required properties
- compatible:
	"hisilicon,kirin960-pcie"
- reg: Should contain rc_dbi, apb, config registers location and length.
- reg-names: Must include the following entries:
  "dbi": controller configuration registers;
  "apb": apb Ctrl register defined by Kirin;
  "config": PCIe configuration space registers.

Optional properties:

Example based on kirin960:

	pcie@f4000000 {
		compatible = "hisilicon,kirin960-pcie";
		reg = <0x0 0xf4000000 0x0 0x1000>, <0x0 0xff3fe000 0x0 0x1000>,
		      <0x0 0xF4000000 0 0x2000>;
		reg-names = "dbi","apb", "config";
		bus-range = <0x0  0x1>;
		#address-cells = <3>;
		#size-cells = <2>;
		device_type = "pci";
		ranges = <0x02000000 0x0 0x00000000 0x0 0xf5000000 0x0 0x2000000>;
		num-lanes = <1>;
		#interrupt-cells = <1>;
		interrupt-map-mask = <0xf800 0 0 7>;
		interrupt-map = <0x0 0 0 1 &gic 0 0 0  282 4>,
				<0x0 0 0 2 &gic 0 0 0  283 4>,
				<0x0 0 0 3 &gic 0 0 0  284 4>,
				<0x0 0 0 4 &gic 0 0 0  285 4>;
	};
```

## Documentation/devicetree/bindings/pci/mediatek,mt7621-pci.yaml
```yaml
# SPDX-License-Identifier: (GPL-2.0-only OR BSD-2-Clause)
%YAML 1.2
---
$id: http://devicetree.org/schemas/pci/mediatek,mt7621-pci.yaml#
$schema: http://devicetree.org/meta-schemas/core.yaml#

title: MediaTek MT7621 PCIe controller

maintainers:
  - Sergio Paracuellos <sergio.paracuellos@gmail.com>

description: |+
  MediaTek MT7621 PCIe subsys supports single Root complex (RC)
  with 3 Root Ports. Each Root Ports supports a Gen1 1-lane Link

allOf:
  - $ref: /schemas/pci/pci-bus.yaml#

properties:
  compatible:
    const: mediatek,mt7621-pci

  reg:
    items:
      - description: host-pci bridge registers
      - description: pcie port 0 RC control registers
      - description: pcie port 1 RC control registers
      - description: pcie port 2 RC control registers

  ranges:
    maxItems: 2

  interrupts:
    maxItems: 3

  resets:
    items:
      - description: pcie port 0 reset.
      - description: pcie port 1 reset.
      - description: pcie port 2 reset.

  reset-names:
    items:
      - const: pcie0
      - const: pcie1
      - const: pcie2

  clocks:
    items:
      - description: pcie port 0 clock.
      - description: pcie port 1 clock.
      - description: pcie port 2 clock.

  clock-names:
    items:
      - const: pcie0
      - const: pcie1
      - const: pcie2

  phys:
    items:
      - description: Dual-ported phy for pcie port 0 and 1.
      - description: Phy for pcie port 2.

  phy-names:
    items:
      - const: pcie-phy0
      - const: pcie-phy2

required:
  - compatible
  - reg
  - ranges
  - interrupts
  - resets
  - reset-names
  - clocks
  - clock-names
  - phys
  - phy-names
  - reset-gpios

unevaluatedProperties: false

examples:
  - |
    #include <dt-bindings/gpio/gpio.h>
    #include <dt-bindings/interrupt-controller/mips-gic.h>

    pcie: pcie@1e140000 {
        compatible = "mediatek,mt7621-pci";
        reg = <0x1e140000 0x100>,
              <0x1e142000 0x100>,
              <0x1e143000 0x100>,
              <0x1e144000 0x100>;

        #address-cells = <3>;
        #size-cells = <2>;
        pinctrl-names = "default";
        pinctrl-0 = <&pcie_pins>;
        device_type = "pci";
        bus-range = <0 255>;
        ranges = <0x02000000 0 0x00000000 0x60000000 0 0x10000000>,  /* pci memory */
                 <0x01000000 0 0x00000000 0x1e160000 0 0x00010000>;  /* io space */
        interrupt-parent = <&gic>;
        interrupts = <GIC_SHARED 4 IRQ_TYPE_LEVEL_HIGH>,
                     <GIC_SHARED 24 IRQ_TYPE_LEVEL_HIGH>,
                     <GIC_SHARED 25 IRQ_TYPE_LEVEL_HIGH>;
        resets = <&rstctrl 24>, <&rstctrl 25>, <&rstctrl 26>;
        reset-names = "pcie0", "pcie1", "pcie2";
        clocks = <&clkctrl 24>, <&clkctrl 25>, <&clkctrl 26>;
        clock-names = "pcie0", "pcie1", "pcie2";
        phys = <&pcie0_phy 1>, <&pcie2_phy 0>;
        phy-names = "pcie-phy0", "pcie-phy2";
        reset-gpios = <&gpio 19 GPIO_ACTIVE_LOW>;

        pcie@0,0 {
            reg = <0x0000 0 0 0 0>;
            #address-cells = <3>;
            #size-cells = <2>;
            device_type = "pci";
            ranges;
            bus-range = <0x00 0xff>;
        };

        pcie@1,0 {
            reg = <0x0800 0 0 0 0>;
            #address-cells = <3>;
            #size-cells = <2>;
            device_type = "pci";
            ranges;
            bus-range = <0x00 0xff>;
        };

        pcie@2,0 {
            reg = <0x1000 0 0 0 0>;
            #address-cells = <3>;
            #size-cells = <2>;
            device_type = "pci";
            ranges;
            bus-range = <0x00 0xff>;
        };
    };
...
```

## Documentation/devicetree/bindings/pci/qcom,pcie-ep.yaml
```yaml
# SPDX-License-Identifier: (GPL-2.0-only OR BSD-2-Clause)
%YAML 1.2
---
$id: http://devicetree.org/schemas/pci/qcom,pcie-ep.yaml#
$schema: http://devicetree.org/meta-schemas/core.yaml#

title: Qualcomm PCIe Endpoint Controller binding

maintainers:
  - Manivannan Sadhasivam <manivannan.sadhasivam@linaro.org>

allOf:
  - $ref: "pci-ep.yaml#"

properties:
  compatible:
    const: qcom,pcie-ep

  reg:
    items:
      - description: Designware PCIe registers
      - description: External local bus interface registers
      - description: Address Translation Unit (ATU) registers
      - description: Memory region used to map remote RC address space
      - description: Qualcomm specific PARF configuration registers
      - description: Qualcomm specific TCSR registers

  reg-names:
    items:
      - const: dbi
      - const: elbi
      - const: atu
      - const: addr_space
      - const: parf
      - const: tcsr

  clocks:
    items:
      - description: PCIe CFG AHB clock
      - description: PCIe Auxiliary clock
      - description: PCIe Master AXI clock
      - description: PCIe Slave AXI clock
      - description: PCIe Reference clock
      - description: PCIe Sleep clock
      - description: PCIe Slave Q2A AXI clock

  clock-names:
    items:
      - const: cfg
      - const: aux
      - const: bus_master
      - const: bus_slave
      - const: ref
      - const: sleep
      - const: slave_q2a

  interrupts:
    maxItems: 1
    description: PCIe Global interrupt

  interrupt-names:
    const: int_global

  perst-gpios:
    description: PCIe endpoint reset GPIO
    maxItems: 1

  wake-gpios:
    description: PCIe endpoint wake GPIO
    maxItems: 1

  resets:
    maxItems: 1

  reset-names:
    const: core_reset

  power-domains:
    maxItems: 1

  phys:
    maxItems: 1

  phy-names:
    const: pciephy

required:
  - compatible
  - reg
  - reg-names
  - clocks
  - clock-names
  - interrupts
  - interrupt-names
  - perst-gpios
  - resets
  - reset-names
  - power-domains

unevaluatedProperties: false

examples:
  - |
    #include <dt-bindings/clock/qcom,gcc-sdx55.h>
    #include <dt-bindings/gpio/gpio.h>
    #include <dt-bindings/interrupt-controller/arm-gic.h>
    pcie_ep: pcie-ep@40000000 {
        compatible = "qcom,pcie-ep";

        reg = <0x40000000 0xf1d>,
              <0x40000f20 0xc8>,
              <0x40001000 0x1000>,
              <0x42000000 0x1000>,
              <0x01c00000 0x3000>,
              <0x01fcb000 0x1000>;
        reg-names = "dbi", "elbi", "atu", "addr_space", "parf", "tcsr";

        clocks = <&gcc GCC_PCIE_CFG_AHB_CLK>,
             <&gcc GCC_PCIE_AUX_CLK>,
             <&gcc GCC_PCIE_MSTR_AXI_CLK>,
             <&gcc GCC_PCIE_SLV_AXI_CLK>,
             <&gcc GCC_PCIE_0_CLKREF_CLK>,
             <&gcc GCC_PCIE_SLEEP_CLK>,
             <&gcc GCC_PCIE_SLV_Q2A_AXI_CLK>;
        clock-names = "cfg", "aux", "bus_master", "bus_slave",
                      "ref", "sleep", "slave_q2a";

        interrupts = <GIC_SPI 140 IRQ_TYPE_LEVEL_HIGH>;
        interrupt-names = "int_global";
        perst-gpios = <&tlmm 57 GPIO_ACTIVE_HIGH>;
        wake-gpios = <&tlmm 53 GPIO_ACTIVE_LOW>;
        resets = <&gcc GCC_PCIE_BCR>;
        reset-names = "core_reset";
        power-domains = <&gcc PCIE_GDSC>;
        phys = <&pcie0_lane>;
        phy-names = "pciephy";
        max-link-speed = <3>;
        num-lanes = <2>;
    };
```
