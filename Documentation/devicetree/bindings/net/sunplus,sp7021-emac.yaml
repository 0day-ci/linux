## Documentation/devicetree/bindings/net/sunplus,sp7021-emac.yaml
```yaml
# SPDX-License-Identifier: (GPL-2.0-only OR BSD-2-Clause)
# Copyright (C) Sunplus Co., Ltd. 2021
%YAML 1.2
---
$id: http://devicetree.org/schemas/net/sunplus,sp7021-emac.yaml#
$schema: http://devicetree.org/meta-schemas/core.yaml#

title: Sunplus SP7021 Dual Ethernet MAC Device Tree Bindings

maintainers:
  - Wells Lu <wells.lu@sunplus.com>

description: |
  Sunplus SP7021 dual 10M/100M Ethernet MAC controller.
  Device node of the controller has following properties.

properties:
  compatible:
    const: sunplus,sp7021-emac

  reg:
    items:
      - description: Base address and length of the EMAC registers.
      - description: Base address and length of the MOON5 registers.

  reg-names:
    items:
      - const: emac
      - const: moon5

  interrupts:
    description: |
      Contains number and type of interrupt. Number should be 66.
      Type should be high-level trigger
    maxItems: 1

  clocks:
    description: |
      Clock controller selector for Ethernet MAC controller.
    maxItems: 1

  resets:
    description: |
      Reset controller selector for Ethernet MAC controller.
    maxItems: 1

  phy-handle1:
    description: A handle to node of phy 1 in mdio node
    maxItems: 1

  phy-handle2:
    description: A handle to node of phy 2 in mdio node
    maxItems: 1

  pinctrl-names:
    description: |
      Names corresponding to the numbered pinctrl states.
      A pinctrl state named "default" must be defined.
    const: default

  pinctrl-0:
    description: A handle to the 'default' state of pin configuration

  nvmem-cells:
    items:
      - description: nvmem cell address of MAC address of MAC 1
      - description: nvmem cell address of MAC address of MAC 2

  nvmem-cell-names:
    description: names corresponding to the nvmem cells of MAC address
    items:
      - const: mac_addr0
      - const: mac_addr1

  mdio:
    type: object
    description: Internal MDIO Bus

    properties:
      "#address-cells":
        const: 1

      "#size-cells":
        const: 0

    patternProperties:
      "^ethernet-phy@[0-9]$":
        type: object

        description:
          Integrated PHY node

        properties:
           reg:
             maxItems: 1

           phy-mode:
             maxItems: 1

        required:
          - reg
          - phy-mode

additionalProperties: false

required:
  - compatible
  - reg
  - reg-names
  - interrupts
  - clocks
  - resets
  - phy-handle1
  - phy-handle2
  - pinctrl-0
  - pinctrl-names
  - nvmem-cells
  - nvmem-cell-names
  - mdio

examples:
  - |
    #include <dt-bindings/interrupt-controller/irq.h>
    emac: emac@9c108000 {
        compatible = "sunplus,sp7021-emac";
        reg = <0x9c108000 0x400>, <0x9c000280 0x80>;
        reg-names = "emac", "moon5";
        interrupt-parent = <&intc>;
        interrupts = <66 IRQ_TYPE_LEVEL_HIGH>;
        clocks = <&clkc 0xa7>;
        resets = <&rstc 0x97>;
        phy-handle1 = <&eth_phy0>;
        phy-handle2 = <&eth_phy1>;
        pinctrl-0 = <&emac_demo_board_v3_pins>;
        pinctrl-names = "default";
        nvmem-cells = <&mac_addr0>, <&mac_addr1>;
        nvmem-cell-names = "mac_addr0", "mac_addr1";

        mdio {
            #address-cells = <1>;
            #size-cells = <0>;
            eth_phy0: ethernet-phy@0 {
                reg = <0>;
                phy-mode = "rmii";
            };
            eth_phy1: ethernet-phy@1 {
                reg = <1>;
                phy-mode = "rmii";
            };
        };
    };
...
```

## Documentation/devicetree/bindings/net/usbnet.yaml
```yaml
# SPDX-License-Identifier: (GPL-2.0-only OR BSD-2-Clause)
%YAML 1.2
---
$id: http://devicetree.org/schemas/net/usbnet.yaml#
$schema: http://devicetree.org/meta-schemas/core.yaml#

title: The device tree bindings for the USB Ethernet controllers

maintainers:
  - Oleksij Rempel <o.rempel@pengutronix.de>

description: |
  Device tree properties for hard wired USB Ethernet devices.

allOf:
  - $ref: ethernet-controller.yaml#

properties:
  compatible: true

  reg:
    description: Port number

  label:
    description:
      Describes the label associated with this port, which will become
      the netdev name
    $ref: /schemas/types.yaml#/definitions/string

required:
  - compatible
  - reg

additionalProperties: true

...
```

## Documentation/devicetree/bindings/net/wireless/brcm,bcm43xx-fmac.txt
```
Broadcom BCM43xx Fullmac wireless SDIO devices

This node provides properties for controlling the Broadcom wireless device. The
node is expected to be specified as a child node to the SDIO controller that
connects the device to the system.

Required properties:

 - compatible : Should be "brcm,bcm4329-fmac".

Optional properties:
 - brcm,drive-strength : drive strength used for SDIO pins on device in mA
	(default = 6).
 - interrupts : specifies attributes for the out-of-band interrupt (host-wake).
	When not specified the device will use in-band SDIO interrupts.
 - interrupt-names : name of the out-of-band interrupt, which must be set
	to "host-wake".
 - brcm,ccode-map : multiple strings for translating ISO3166 country code to
	brcmfmac firmware country code and revision.  Each string must be in
	format "AA-BB-num" where:
	  AA is the ISO3166 country code which must be 2 characters.
	  BB is the firmware country code which must be 2 characters.
	  num is the revision number which must fit into signed integer.

Example:

mmc3: mmc@1c12000 {
	#address-cells = <1>;
	#size-cells = <0>;

	pinctrl-names = "default";
	pinctrl-0 = <&mmc3_pins_a>;
	vmmc-supply = <&reg_vmmc3>;
	bus-width = <4>;
	non-removable;

	brcmf: wifi@1 {
		reg = <1>;
		compatible = "brcm,bcm4329-fmac";
		interrupt-parent = <&pio>;
		interrupts = <10 8>; /* PH10 / EINT10 */
		interrupt-names = "host-wake";
		brcm,ccode-map = "JP-JP-78", "US-Q2-86";
	};
};
```

## Documentation/devicetree/bindings/net/wireless/qca,ath9k.yaml
```yaml
# SPDX-License-Identifier: (GPL-2.0-only OR BSD-2-Clause)
%YAML 1.2
---
$id: http://devicetree.org/schemas/net/wireless/qca,ath9k.yaml#
$schema: http://devicetree.org/meta-schemas/core.yaml#

title: Qualcomm Atheros ath9k wireless devices Generic Binding

maintainers:
  - Kalle Valo <kvalo@codeaurora.org>

description: |
  This node provides properties for configuring the ath9k wireless device.
  The node is expected to be specified as a child node of the PCI controller
  to which the wireless chip is connected.

allOf:
  - $ref: ieee80211.yaml#

properties:
  compatible:
    enum:
      - pci168c,0023
      - pci168c,0024
      - pci168c,0027
      - pci168c,0029
      - pci168c,002a
      - pci168c,002b
      - pci168c,002c
      - pci168c,002d
      - pci168c,002e
      - pci168c,0030
      - pci168c,0032
      - pci168c,0033
      - pci168c,0034
      - pci168c,0036
      - pci168c,0037

  reg:
    maxItems: 1

  interrupts:
    maxItems: 1

  ieee80211-freq-limit: true

  qca,no-eeprom:
    $ref: /schemas/types.yaml#/definitions/flag
    description:
      Indicates that there is no physical EEPROM connected

  nvmem-cells:
    items:
      - description: Reference to an nvmem node for the MAC address
      - description: Reference to an nvmem node for calibration data

  nvmem-cell-names:
    items:
      - const: mac-address
      - const: calibration

required:
  - compatible
  - reg

additionalProperties: false

examples:
  - |
    pcie0 {
      #address-cells = <3>;
      #size-cells = <2>;
      wifi@0,0 {
        compatible = "pci168c,002d";
        reg = <0 0 0 0 0>;
        interrupts = <3>;
        qca,no-eeprom;

        nvmem-cells = <&macaddr_art_c>, <&cal_art_1000>;
        nvmem-cell-names = "mac-address", "calibration";
      };
    };
```

## Documentation/devicetree/bindings/net/xilinx,pcs.yaml
```yaml
# SPDX-License-Identifier: (GPL-2.0 OR BSD-2-Clause)
%YAML 1.2
---
$id: http://devicetree.org/schemas/net/xilinx,pcs.yaml#
$schema: http://devicetree.org/meta-schemas/core.yaml#

title: Xilinx 1G/2.5G Ethernet PCS/PMA or SGMII LogiCORE IP

maintainers:
  - Sean Anderson <sean.anderson@seco.com>

description:
  This is a soft device which converts between GMII and SGMII, 2.5G SGMII,
  1000BASE-X, or 2500BASE-X. It may have an attached SERDES, or may talk
  directly to LVDS.

allOf:
  - $ref: "ethernet-controller.yaml#"

properties:
  compatible:
    contains:
      const:
        - xilinx,pcs-16.2

  reg:
    maxItems: 1

  clocks:
    maxItems: 1
    items:
      - description: The reference clock for the PMD, which is typically a
                     SERDES but may be a direct interface to LVDS I/Os.
                     Depending on your setup, this may be the gtrefclk, refclk,
                     or clk125m signal.

  clock-names:
    const: refclk

  resets:
    maxItems: 1

  reset-names:
    const: pcs

  standard:
    description:
      The interface standard that the PCS supports. The sgmii/1000base-x
      setting indicates that the PCS supports dynamically switching between
      SGMII and 1000BASE-X.
    enum:
      - sgmii
      - 1000base-x
      - sgmii/1000base-x
      - 2500base-x

required:
  - compatible
  - reg
  - clocks
  - clock-names
  - resets
  - reset-names
  - standard

additionalProperties: false

examples:
  - |
    mdio {
        #address-cells = <1>;
        #size-cells = <0>;

        pcs0: ethernet-pcs@0 {
            compatible = "xlnx,pcs-16.2";
            reg = <0>;
            clocks = <&si570>;
            clock-names = "refclk";
            resets = <&pcs_reset 1>;
            reset-names = "pcs";
            standard = "sgmii/1000base-x";
        };
    };
```

## Documentation/devicetree/bindings/nvmem/bootcount-nvmem.yaml
```yaml
# SPDX-License-Identifier: GPL-2.0-only OR BSD-2-Clause
# Copyright (c) Vaisala Oyj. All rights reserved.
%YAML 1.2
---
$id: http://devicetree.org/schemas/nvmem/bootcount-nvmem.yaml#
$schema: http://devicetree.org/meta-schemas/core.yaml#

title: Bootcount NVMEM bindings

maintainers:
  - Nandor Han <nandor.han@vaisala.com>

description: |
  This binding is intendent to describe the hardware location for
  storing the bootcount value and magic combo.

  The NVMEM cell size should be 2 or 4 bytes.

properties:
  compatible:
    enum:
      - linux,bootcount-nvmem

  nvmem-cells:
    description: Phandle to reboot mode nvmem data cell.
    $ref: /schemas/types.yaml#/definitions/phandle

  nvmem-cell-names:
    description: Name of the NVMEM cell.
    $ref: /schemas/types.yaml#/definitions/string
    enum:
      - bootcount-regs

  linux,bootcount-magic:
    description: Override default mask value.
    $ref: /schemas/types.yaml#/definitions/uint32

required:
  - compatible
  - nvmem-cells
  - nvmem-cell-names

additionalProperties: false

examples:
  # example with 16 bit nvram cell:
  - |
    bootcount {
      compatible = "linux,bootcount-nvmem";
      nvmem-cells = <&bootcount_regs>;
      nvmem-cell-names = "bootcount-regs";
    };

    rtc@68 {
      bootcount_regs: bootcount_nvmem_regs@e {
      reg = <0x0e 0x2>;
    };

  # example with 32 bit nvram cell:
  - |
    bootcount {
      compatible = "linux,bootcount-nvmem";
      nvmem-cells = <&bootcount_regs>;
      nvmem-cell-names = "bootcount-regs";
    };

    rtc@68 {
      bootcount_regs: bootcount_nvmem_regs@e {
      reg = <0x0e 0x4>;
    };

...
```

## Documentation/devicetree/bindings/nvmem/brcm,nvram.yaml
```yaml
# SPDX-License-Identifier: (GPL-2.0-only OR BSD-2-Clause)
%YAML 1.2
---
$id: http://devicetree.org/schemas/nvmem/brcm,nvram.yaml#
$schema: http://devicetree.org/meta-schemas/core.yaml#

title: Broadcom's NVRAM

description: |
  Broadcom's NVRAM is a structure containing device specific environment
  variables. It is used for storing device configuration, booting parameters
  and calibration data.

  NVRAM can be accessed on Broadcom BCM47xx MIPS and Northstar ARM Cortex-A9
  devices usiong I/O mapped memory.

maintainers:
  - Rafał Miłecki <rafal@milecki.pl>

allOf:
  - $ref: "nvmem.yaml#"

properties:
  compatible:
    const: brcm,nvram

  reg:
    maxItems: 1

patternProperties:
  ".*":
    description: |
      Each child node represents one NVRAM entry (variable). Node name has to
      match variable name as internally defined in the NVRAM.

      Some of common NVRAM variables are: "board_id", "boardflags", "boot_wait",
      "clkfreq", "et0macaddr", "sdram_config", "wait_time".

unevaluatedProperties: false

examples:
  - |
    nvram@1eff0000 {
        compatible = "brcm,nvram";
        reg = <0x1eff0000 0x10000>;

        mac: et0macaddr {
        };
    };
```

## Documentation/devicetree/bindings/nvmem/cells/cell.yaml
```yaml
# SPDX-License-Identifier: GPL-2.0-only OR BSD-2-Clause
%YAML 1.2
---
$id: http://devicetree.org/schemas/nvmem/cells/cell.yaml#
$schema: http://devicetree.org/meta-schemas/core.yaml#

title: NVMEM cell

maintainers:
  - Srinivas Kandagatla <srinivas.kandagatla@linaro.org>

description: NVMEM cell is a data entry of NVMEM device.

properties:
  reg:
    maxItems: 1
    description:
      Offset and size in bytes within the storage device.

  bits:
    maxItems: 1
    items:
      items:
        - minimum: 0
          maximum: 7
          description:
            Offset in bit within the address range specified by reg.
        - minimum: 1
          description:
            Size in bit within the address range specified by reg.

required:
  - reg

additionalProperties: true
```

## Documentation/devicetree/bindings/nvmem/cells/mac-address.yaml
```yaml
# SPDX-License-Identifier: GPL-2.0-only OR BSD-2-Clause
%YAML 1.2
---
$id: http://devicetree.org/schemas/nvmem/cells/mac-address.yaml#
$schema: http://devicetree.org/meta-schemas/core.yaml#

title: NVMEM cell containing a MAC address

maintainers:
  - Rafał Miłecki <rafal@milecki.pl>

properties:
  compatible:
    const: mac-address

  format:
    description: |
      Some NVMEM cells contain MAC in a non-binary format.

      ASCII should be specified if MAC is string formatted like:
      - "01:23:45:67:89:AB" (30 31 3a 32 33 3a 34 35 3a 36 37 3a 38 39 3a 41 42)
      - "01-23-45-67-89-AB"
      - "0123456789AB"
    enum:
      - ascii

  reversed-bytes:
    type: boolean
    description: |
      MAC is stored in reversed bytes order. Example:
      Stored value: AB 89 67 45 23 01
      Actual MAC: 01 23 45 67 89 AB

  base-address:
    type: boolean
    description: |
      Marks NVMEM cell as provider of multiple addresses that are relative to
      the one actually stored physically. Respective addresses can be requested
      by specifying cell index of NVMEM cell.

allOf:
  - $ref: cell.yaml#
  - if:
      required:
        - base-address
    then:
      properties:
        "#nvmem-cell-cells":
          const: 1
      required:
        - "#nvmem-cell-cells"

unevaluatedProperties: false

examples:
  - |
    partitions {
        compatible = "fixed-partitions";
        #address-cells = <1>;
        #size-cells = <1>;

        partition@f00000 {
            compatible = "nvmem-cells";
            label = "calibration";
            reg = <0xf00000 0x100000>;
            ranges = <0 0xf00000 0x100000>;
            #address-cells = <1>;
            #size-cells = <1>;

            mac@100 {
                compatible = "mac-address";
                reg = <0x100 0x6>;
            };

            mac@200 {
                compatible = "mac-address";
                reg = <0x200 0x6>;
                reversed-bytes;
            };

            mac@300 {
                compatible = "mac-address";
                reg = <0x300 0x11>;
                format = "ascii";
            };

            mac@400 {
                compatible = "mac-address";
                reg = <0x400 0x6>;
                base-address;
                #nvmem-cell-cells = <1>;
            };
        };
    };
```
