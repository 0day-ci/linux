## Documentation/devicetree/bindings/firmware/arm,scmi.yaml
```yaml
# SPDX-License-Identifier: (GPL-2.0 OR BSD-2-Clause)
# Copyright 2021 ARM Ltd.
%YAML 1.2
---
$id: http://devicetree.org/schemas/firmware/arm,scmi.yaml#
$schema: http://devicetree.org/meta-schemas/core.yaml#

title: System Control and Management Interface (SCMI) Message Protocol bindings

maintainers:
  - Sudeep Holla <sudeep.holla@arm.com>

description: |
  The SCMI is intended to allow agents such as OSPM to manage various functions
  that are provided by the hardware platform it is running on, including power
  and performance functions.

  This binding is intended to define the interface the firmware implementing
  the SCMI as described in ARM document number ARM DEN 0056A ("ARM System Control
  and Management Interface Platform Design Document")[0] provide for OSPM in
  the device tree.

  [0] http://infocenter.arm.com/help/topic/com.arm.doc.den0056a/index.html

properties:
  $nodename:
    const: scmi

  compatible:
    oneOf:
      - description: SCMI compliant firmware with mailbox transport
        items:
          - const: arm,scmi
      - description: SCMI compliant firmware with ARM SMC/HVC transport
        items:
          - const: arm,scmi-smc

  mbox-names:
    description: |
      Specifies the mailboxes used to communicate with SCMI compliant
      firmware.
    items:
      - const: tx
      - const: rx

  mboxes:
    description: |
      List of phandle and mailbox channel specifiers. It should contain
      exactly one or two mailboxes, one for transmitting messages("tx")
      and another optional for receiving the notifications("rx") if supported.
    minItems: 1
    maxItems: 2

  shmem:
    description: |
      List of phandle pointing to the shared memory(SHM) area, for each
      transport channel specified.
    minItems: 1
    maxItems: 2

  '#address-cells':
    description: |
      The address cells maps to protocol identifier for a given sub-node.
    const: 1

  '#size-cells':
    description: |
      The size cells are not present as 'reg' property doesn't have any
      size associated with it.
    const: 0

  arm,smc-id:
    $ref: /schemas/types.yaml#/definitions/uint32
    description: |
      SMC id required when using smc or hvc transports

additionalProperties:
  type: object

patternProperties:
  '^protocol@[0-9a-f]+$':
    type: object
    description: |
      Each sub-node represents a protocol supported. If the platform
      supports dedicated communication channel for a particular protocol,
      then corresponding transport properties must be present.

    properties:
      reg:
        maxItems: 1

      '#clock-cells':
        const: 1

      '#reset-cells':
        const: 1

      '#power-domain-cells':
        const: 1

      '#thermal-sensor-cells':
        const: 1

required:
  - compatible
  - shmem

allOf:
  - if:
      properties:
        compatible:
          contains:
            const: arm,scmi
    then:
      required:
        - mboxes
  - if:
      properties:
        compatible:
          contains:
            const: arm,scmi-smc
    then:
      properties:
        interrupts:
          description: |
            The interrupt that indicates message completion by the platform
            rather than by the return of the smc call. This should not be used
            except when the platform requires such behavior.

        interrupt-names:
          const: a2p

      required:
        - arm,smc-id

examples:
  - |
    firmware {
      scmi {
        compatible = "arm,scmi";
        mboxes = <&mhuB 0 0>,
                 <&mhuB 0 1>;
        mbox-names = "tx", "rx";
        shmem = <&cpu_scp_lpri &cpu_scp_hpri>;

        #address-cells = <1>;
        #size-cells = <0>;

        scmi_devpd: protocol@11 {
          reg = <0x11>;
          #power-domain-cells = <1>;
        };

        scmi_dvfs: protocol@13 {
          reg = <0x13>;
          #clock-cells = <1>;
        };

        scmi_clk: protocol@14 {
          reg = <0x14>;
          #clock-cells = <1>;
        };

        scmi_sensors: protocol@15 {
          reg = <0x15>;
          #thermal-sensor-cells = <1>;
        };

        scmi_reset: protocol@16 {
          reg = <0x16>;
          #reset-cells = <1>;
        };

        scmi_voltage: protocol@17 {
          reg = <0x17>;
        };
      };
    };

    soc {
      #address-cells = <2>;
      #size-cells = <2>;

      sram@50000000 {
        compatible = "mmio-sram";
        reg = <0x0 0x50000000 0x0 0x10000>;

        #address-cells = <1>;
        #size-cells = <1>;
        ranges = <0 0x0 0x50000000 0x10000>;

        cpu_scp_lpri: scp-sram-section@0 {
          compatible = "arm,scmi-shmem";
          reg = <0x0 0x200>;
        };

        cpu_scp_hpri: scp-sram-section@200 {
          compatible = "arm,scmi-shmem";
          reg = <0x200 0x200>;
        };
      };

      mhuB: mailbox@2b2f0000 {
        #mbox-cells = <2>;
        compatible = "arm,mhu-doorbell", "arm,primecell";
        reg = <0 0x2b2f0000 0 0x1000>;
        interrupts = <0 36 4>, /* LP-NonSecure */
                     <0 35 4>, /* HP-NonSecure */
                     <0 37 4>; /* Secure */
        clocks = <&clock 0 2 1>;
        clock-names = "apb_pclk";
      };

      gpu@ffe40000 {
        compatible = "amlogic,meson-g12a-mali", "arm,mali-bifrost";
        reg = <0x0 0xffe40000 0x0 0x10000>;
        interrupts = <0 160 4>, <0 161 4>, <0 162 4>;
        interrupt-names = "job", "mmu", "gpu";
        clocks = <&scmi_clk 1>;
        power-domains = <&scmi_devpd 8>;
        resets = <&scmi_reset 0>, <&scmi_reset 1>;
      };

      display@20930000 {
        compatible = "intel,keembay-display";
        reg = <0x0 0x20930000 0x0 0x3000>;
        reg-names = "lcd";
        interrupts = <0 33 4>;
        clocks = <&scmi_clk 0x83>,
                 <&scmi_clk 0x0>;
        clock-names = "clk_lcd", "clk_pll0";

        port {
            disp_out: endpoint {
                remote-endpoint = <&dsi_in>;
            };
        };
      };

      thermal-zones {
        soc-thermal {
          polling-delay-passive = <100>;
          polling-delay = <1000>;
          thermal-sensors = <&scmi_sensors0 3>;

          trips {
            mpu0_crit: mpu0_crit {
              temperature = <125000>; /* milliCelsius */
              hysteresis = <2000>; /* milliCelsius */
              type = "critical";
            };
          };
        };
      };
    };

    cpus {
      #size-cells = <0>;
      #address-cells = <2>;

      cpu@0 {
        device_type = "cpu";
        compatible = "arm,cortex-a57";
        reg = <0x0 0x0>;
        enable-method = "psci";
        clocks = <&scmi_dvfs 0>;
      };
    };

...
```

## Documentation/devicetree/bindings/firmware/arm,scpi.yaml
```yaml
# SPDX-License-Identifier: (GPL-2.0 OR BSD-2-Clause)
# Copyright 2021 ARM Ltd.
%YAML 1.2
---
$id: http://devicetree.org/schemas/firmware/arm,scpi.yaml#
$schema: http://devicetree.org/meta-schemas/core.yaml#

title: System Control and Power Interface (SCPI) Message Protocol bindings

maintainers:
  - Sudeep Holla <sudeep.holla@arm.com>

description: |
  Firmware implementing the SCPI described in ARM document number ARM DUI
  0922B ("ARM Compute Subsystem SCP: Message Interface Protocols")[0] can be
  used by Linux to initiate various system control and power operations.

  This binding is intended to define the interface the firmware implementing
  the SCPI provide for OSPM in the device tree.

  [0] http://infocenter.arm.com/help/topic/com.arm.doc.dui0922b/index.html

properties:
  $nodename:
    const: scpi

  compatible:
    oneOf:
      - description: SCPI compliant firmware complying to SCPI v1.0 or above
        items:
          - const: arm,scpi
      - description: |
          SCPI compliant firmware complying to all unversioned releases prior
          to SCPI v1.0
        items:
          - const: arm,scpi-pre-1.0

  mboxes:
    description: |
      List of phandle and mailbox channel specifiers. All the channels reserved
      by remote SCP firmware for use by SCPI message protocol should be
      specified in any order.
    minItems: 1

  shmem:
    description: |
      List of phandle pointing to the shared memory(SHM) area between the
      processors using these mailboxes for IPC, one for each mailbox SHM can
      be any memory reserved for the purpose of this communication between the
      processors.
    minItems: 1

additionalProperties:
  type: object

patternProperties:
  "^(sensors|power-domains)(-[0-9a-f]+)?$":
    type: object
    description: |
      Each sub-node represents one of the controller - power domains or sensors.

    properties:
      compatible:
        oneOf:
          - const: arm,scpi-sensors
          - const: arm,scpi-power-domains

  "^clocks(-[0-9a-f]+)?$":
    type: object
    description: |
      Each sub-node represents one of the types of clock controller -
      indexed or full range.

      "arm,scpi-dvfs-clocks" - all the clocks that are variable and index
      based. These clocks don't provide an entire range of values
      between the limits but only discrete points within the range. The
      firmware provides the mapping for each such operating frequency
      and the index associated with it. The firmware also manages the
      voltage scaling appropriately with the clock scaling.

      "arm,scpi-variable-clocks" - all the clocks that are variable and
      provide full range within the specified range. The firmware
      provides the range of values within a specified range.

    properties:
      compatible:
        oneOf:
          - const: arm,scpi-dvfs-clocks
          - const: arm,scpi-variable-clocks

required:
  - compatible
  - mboxes
  - shmem

allOf:
  - if:
      properties:
        compatible:
          contains:
            const: arm,scpi-sensors
    then:
      properties:
        '#thermal-sensor-cells':
          const: 1

      required:
        - '#thermal-sensor-cells'

  - if:
      properties:
        compatible:
          contains:
            const: arm,scpi-power-domains
    then:
      properties:
        '#power-domain-cells':
          const: 1

        num-domains:
          $ref: /schemas/types.yaml#/definitions/uint32
          description: |
            Total number of power domains provided by SCPI. This is needed as
            the SCPI message protocol lacks a mechanism to query this
            information at runtime.

      required:
        - '#power-domain-cells'
        - num-domains

  - if:
      properties:
        compatible:
          contains:
            enum:
              - arm,scpi-dvfs-clocks
              - arm,scpi-variable-clocks
    then:
      properties:
        '#clock-cells':
          const: 1
        clock-output-names:
          $ref: /schemas/types.yaml#/definitions/string-array
        clock-indices:
          $ref: /schemas/types.yaml#/definitions/uint32-array
          description: |
            The identifying number for the clocks(i.e.clock_id) in the node.
            It can be non linear and hence provide the mapping of identifiers
            into the clock-output-names array.

      required:
        - '#clock-cells'
        - clock-output-names
        - clock-indices

examples:
  - |
    firmware {
      scpi {
        compatible = "arm,scpi";
        mboxes = <&mhuA 1>;
        shmem = <&cpu_scp_hpri>; /* HP-NonSecure */

        scpi_devpd: power-domains-0 {
          compatible = "arm,scpi-power-domains";
          num-domains = <2>;
          #power-domain-cells = <1>;
        };

        clocks {
          scpi_dvfs: clocks-0 {
            compatible = "arm,scpi-dvfs-clocks";
            #clock-cells = <1>;
            clock-indices = <0>, <1>, <2>;
            clock-output-names = "atlclk", "aplclk","gpuclk";
          };

          scpi_clk: clocks-1 {
            compatible = "arm,scpi-variable-clocks";
            #clock-cells = <1>;
            clock-indices = <3>, <4>;
            clock-output-names = "pxlclk0", "pxlclk1";
          };
        };

        scpi_sensors: sensors-0 {
          compatible = "arm,scpi-sensors";
          #thermal-sensor-cells = <1>;
        };

      };
    };

    soc {
      #address-cells = <2>;
      #size-cells = <2>;

      sram@50000000 {
        compatible = "mmio-sram";
        reg = <0x0 0x50000000 0x0 0x10000>;

        #address-cells = <1>;
        #size-cells = <1>;
        ranges = <0 0x0 0x50000000 0x10000>;

        cpu_scp_lpri: scp-sram-section@0 {
          compatible = "arm,scpi-shmem";
          reg = <0x0 0x200>;
        };

        cpu_scp_hpri: scp-sram-section@200 {
          compatible = "arm,scpi-shmem";
          reg = <0x200 0x200>;
        };
      };

      mhuA: mailbox@2b2f0000 {
        #mbox-cells = <1>;
        compatible = "arm,mhu", "arm,primecell";
        reg = <0 0x2b2f0000 0 0x1000>;
        interrupts = <0 36 4>, /* LP-NonSecure */
                     <0 35 4>, /* HP-NonSecure */
                     <0 37 4>; /* Secure */
        clocks = <&clock 0 2 1>;
        clock-names = "apb_pclk";
      };

      gpu@ffe40000 {
        compatible = "amlogic,meson-g12a-mali", "arm,mali-bifrost";
        reg = <0x0 0xffe40000 0x0 0x10000>;
        interrupts = <0 160 4>, <0 161 4>, <0 162 4>;
        interrupt-names = "job", "mmu", "gpu";
        clocks = <&scpi_clk 1>;
        power-domains = <&scpi_devpd 8>;
        resets = <&scpi_reset 0>, <&scpi_reset 1>;
      };

      display@20930000 {
        compatible = "intel,keembay-display";
        reg = <0x0 0x20930000 0x0 0x3000>;
        reg-names = "lcd";
        interrupts = <0 33 4>;
        clocks = <&scpi_clk 0x83>,
                 <&scpi_clk 0x0>;
        clock-names = "clk_lcd", "clk_pll0";

        port {
            disp_out: endpoint {
                remote-endpoint = <&dsi_in>;
            };
        };
      };

      thermal-zones {
        soc-thermal {
          polling-delay-passive = <100>;
          polling-delay = <1000>;
          thermal-sensors = <&scpi_sensors0 3>;

          trips {
            mpu0_crit: mpu0_crit {
              temperature = <125000>; /* milliCelsius */
              hysteresis = <2000>; /* milliCelsius */
              type = "critical";
            };
          };
        };
      };
    };

    cpus {
      #size-cells = <0>;
      #address-cells = <2>;

      cpu@0 {
        device_type = "cpu";
        compatible = "arm,cortex-a57";
        reg = <0x0 0x0>;
        enable-method = "psci";
        clocks = <&scpi_dvfs 0>;
      };
    };

...
```

## Documentation/devicetree/bindings/firmware/dice.yaml
```yaml
# SPDX-License-Identifier: GPL-2.0-only OR BSD-2-Clause
%YAML 1.2
---
$id: http://devicetree.org/schemas/firmware/dice.yaml#
$schema: http://devicetree.org/meta-schemas/core.yaml#

title: Open Profile for DICE Device Tree Bindings

description: |
  This binding represents a reserved memory region containing secrets derived
  derived following the Open Profile for DICE.

  See https://pigweed.googlesource.com/open-dice/

maintainers:
  - David Brazdil <dbrazdil@google.com>

properties:
  compatible:
    enum:
      - google,dice

  memory-region:
    maxItems: 1
    description: |
      phandle to the reserved memory node to be associated with the device
      The reserved memory node should be defined as per the bindings,
      Documentation/devicetree/bindings/reserved-memory/reserved-memory.yaml

required:
  - compatible
  - memory-region

additionalProperties: false

examples:
  - |
    reserved-memory {
        #address-cells = <2>;
        #size-cells = <1>;

        dice_reserved: dice@12340000 {
            reg = <0x00 0x12340000 0x2000>;
            no-map;
        };
    };

    dice {
        compatible = "google,dice";
        memory-region = <&dice_reserved>;
    };
```
