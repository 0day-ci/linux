## Documentation/devicetree/bindings/dma/renesas,rz-dmac.yaml
```yaml
# SPDX-License-Identifier: (GPL-2.0-only OR BSD-2-Clause)
%YAML 1.2
---
$id: http://devicetree.org/schemas/dma/renesas,rz-dmac.yaml#
$schema: http://devicetree.org/meta-schemas/core.yaml#

title: Renesas RZ/G2L DMA Controller

maintainers:
  - Biju Das <biju.das.jz@bp.renesas.com>

allOf:
  - $ref: "dma-controller.yaml#"

properties:
  compatible:
    items:
      - enum:
          - renesas,r9a07g044-dmac # RZ/G2{L,LC}
      - const: renesas,rz-dmac

  reg:
    items:
      - description: Control and channel register block
      - description: DMA extended resource selector block

  interrupts:
    maxItems: 17

  interrupt-names:
    items:
      - const: ch0
      - const: ch1
      - const: ch2
      - const: ch3
      - const: ch4
      - const: ch5
      - const: ch6
      - const: ch7
      - const: ch8
      - const: ch9
      - const: ch10
      - const: ch11
      - const: ch12
      - const: ch13
      - const: ch14
      - const: ch15
      - const: error

  clocks:
    maxItems: 1

  '#dma-cells':
    const: 1
    description:
      The cell specifies the MID/RID of the DMAC port connected to
      the DMA client.

  dma-channels:
    const: 16

  power-domains:
    maxItems: 1

  resets:
    maxItems: 1

required:
  - compatible
  - reg
  - interrupts
  - interrupt-names
  - clocks
  - '#dma-cells'
  - dma-channels
  - power-domains
  - resets

additionalProperties: false

examples:
  - |
    #include <dt-bindings/interrupt-controller/arm-gic.h>
    #include <dt-bindings/clock/r9a07g044-cpg.h>

    dmac: dma-controller@11820000 {
        compatible = "renesas,r9a07g044-dmac",
                     "renesas,rz-dmac";
        reg = <0x11820000 0x10000>,
              <0x11830000 0x10000>;
        interrupts = <GIC_SPI 125 IRQ_TYPE_EDGE_RISING>,
                     <GIC_SPI 126 IRQ_TYPE_EDGE_RISING>,
                     <GIC_SPI 127 IRQ_TYPE_EDGE_RISING>,
                     <GIC_SPI 128 IRQ_TYPE_EDGE_RISING>,
                     <GIC_SPI 129 IRQ_TYPE_EDGE_RISING>,
                     <GIC_SPI 130 IRQ_TYPE_EDGE_RISING>,
                     <GIC_SPI 131 IRQ_TYPE_EDGE_RISING>,
                     <GIC_SPI 132 IRQ_TYPE_EDGE_RISING>,
                     <GIC_SPI 133 IRQ_TYPE_EDGE_RISING>,
                     <GIC_SPI 134 IRQ_TYPE_EDGE_RISING>,
                     <GIC_SPI 135 IRQ_TYPE_EDGE_RISING>,
                     <GIC_SPI 136 IRQ_TYPE_EDGE_RISING>,
                     <GIC_SPI 137 IRQ_TYPE_EDGE_RISING>,
                     <GIC_SPI 138 IRQ_TYPE_EDGE_RISING>,
                     <GIC_SPI 139 IRQ_TYPE_EDGE_RISING>,
                     <GIC_SPI 140 IRQ_TYPE_EDGE_RISING>,
                     <GIC_SPI 141 IRQ_TYPE_EDGE_RISING>;
        interrupt-names = "ch0", "ch1", "ch2", "ch3",
                          "ch4", "ch5", "ch6", "ch7",
                          "ch8", "ch9", "ch10", "ch11",
                          "ch12", "ch13", "ch14", "ch15",
                          "error";
        clocks = <&cpg CPG_MOD R9A07G044_CLK_DMAC>;
        power-domains = <&cpg>;
        resets = <&cpg R9A07G044_CLK_DMAC>;
        #dma-cells = <1>;
        dma-channels = <16>;
    };
```

## Documentation/devicetree/bindings/dma/renesas,rzn1-dmamux.yaml
```yaml
# SPDX-License-Identifier: (GPL-2.0-only OR BSD-2-Clause)
%YAML 1.2
---
$id: http://devicetree.org/schemas/dma/renesas,rzn1-dmamux.yaml#
$schema: http://devicetree.org/meta-schemas/core.yaml#

title: Renesas RZ/N1 DMA mux

maintainers:
  - Miquel Raynal <miquel.raynal@bootlin.com>

allOf:
  - $ref: "dma-router.yaml#"

properties:
  compatible:
    const: renesas,rzn1-dmamux

  '#dma-cells':
    const: 6
    description:
      The first four cells are dedicated to the master DMA controller. The fifth
      cell gives the DMA mux bit index that must be set starting from 0. The
      sixth cell gives the binary value that must be written there, ie. 0 or 1.

  dma-masters:
    minItems: 1
    maxItems: 2

  dma-requests:
    const: 32

additionalProperties: false

examples:
  - |
    dma-router {
      compatible = "renesas,rzn1-dmamux";
      #dma-cells = <6>;
      dma-masters = <&dma0 &dma1>;
      dma-requests = <32>;
    };
```

## Documentation/devicetree/bindings/dsp/mtk,mt8195-dsp.yaml
```yaml
# SPDX-License-Identifier: (GPL-2.0 OR BSD-2-Clause)
%YAML 1.2
---
$id: http://devicetree.org/schemas/dsp/mtk,mt8195-dsp.yaml#
$schema: http://devicetree.org/meta-schemas/core.yaml#

title: Mediatek mt8195 DSP core

maintainers:
  - YC Hung <yc.hung@mediatek.com>

description: |
  Some boards from mt8195 contain a DSP core used for
  advanced pre- and post- audio processing.
properties:
  compatible:
    const: mediatek,mt8195-dsp

  reg:
    items:
      - description: Address and size of the DSP Cfg registers
      - description: Address and size of the DSP SRAM

  reg-names:
    items:
      - const: cfg
      - const: sram

  interrupts:
    items:
      - description: watchdog interrupt

  interrupt-names:
    items:
      - const: wdt

  clocks:
    items:
      - description: mux for audio dsp clock
      - description: 26M clock
      - description: mux for audio dsp local bus
      - description: default audio dsp local bus clock source
      - description: clock gate for audio dsp clock
      - description: mux for audio dsp access external bus

  clock-names:
    items:
      - const: adsp_sel
      - const: clk26m_ck
      - const: audio_local_bus
      - const: mainpll_d7_d2
      - const: scp_adsp_audiodsp
      - const: audio_h

  power-domains:
    maxItems: 1

  mboxes:
    items:
      - description: a mailbox is ised for ipc reply between host and audio DSP.
      - description: a mailbox is ised for ipc reuqest between host and audio DSP.

  mbox-names:
    items:
      - const: mbox0
      - const: mbox1

  memory-region:      
    items:
      - description: A phandle to a reserved memory region is used for dma buffer between host and DSP.   
      - description: A phandle to a reserved memory region is used for DSP system memory.

required:
  - compatible
  - reg
  - reg-names
  - interrupts
  - interrupt-names
  - clocks
  - clock-names
  - memory-region
  - power-domains
  - mbox-names
  - mboxes

additionalProperties: false

examples:
  - |
    #include <dt-bindings/interrupt-controller/arm-gic.h>
    #include <dt-bindings/interrupt-controller/irq.h>
    adsp: dsp@10803000 {
       compatible =  "mediatek,mt8195-dsp";
       reg = <0x10803000  0x1000>,
             <0x10840000  0x40000>;
       reg-names = "cfg", "sram";
       interrupts = <GIC_SPI 694 IRQ_TYPE_LEVEL_HIGH 0>;
       interrupt-names = "wdt";
       clocks = <&topckgen 10>, //CLK_TOP_ADSP
                <&clk26m>,
                <&topckgen 107>, //CLK_TOP_AUDIO_LOCAL_BUS
                <&topckgen 136>, //CLK_TOP_MAINPLL_D7_D2
                <&scp_adsp 0>, //CLK_SCP_ADSP_AUDIODSP
                <&topckgen 34>; //CLK_TOP_AUDIO_H
       clock-names = "adsp_sel",
                     "clk26m_ck",
                     "audio_local_bus",
                     "mainpll_d7_d2",
                     "scp_adsp_audiodsp",
                     "audio_h";
       memory-region = <&adsp_dma_mem_reserved>,
                       <&adsp_mem_reserved>;
       power-domains = <&spm 6>; //MT8195_POWER_DOMAIN_ADSP
       mbox-names = "mbox0", "mbox1";
       mboxes = <&adsp_mailbox0>, <&adsp_mailbox1>;
       };
```

## Documentation/devicetree/bindings/edac/nuvoton,npcm-memory-controller.yaml
```yaml
# SPDX-License-Identifier: GPL-2.0-only OR BSD-2-Clause
%YAML 1.2
---
$id: http://devicetree.org/schemas/edac/nuvoton,npcm-memory-controller.yaml#
$schema: http://devicetree.org/meta-schemas/core.yaml#

title: Nuvoton NPCM Memory Controller

maintainers:
  - Medad CChien <ctcchien@nuvoton.com>

description: |
  The Nuvoton BMC SoC supports DDR4 memory with and without ECC (error
  correction check).

  The memory controller supports single bit error correction, double bit
  error detection (in-line ECC in which a section (1/8th) of the
  memory device used to store data is used for ECC storage).

  Note, the bootloader must configure ECC mode for the memory controller.

properties:
  compatible:
    enum:
      - nuvoton,npcm845-memory-controller
      - nuvoton,npcm750-memory-controller

  reg:
    maxItems: 1

  interrupts:
    minItems: 1
    items:
      - description: uncorrectable error interrupt
      - description: correctable error interrupt

  interrupt-names:
    minItems: 1
    items:
      - const: ue
      - const: ce

required:
  - compatible
  - reg
  - interrupts

additionalProperties: false

examples:
  - |
    #include <dt-bindings/interrupt-controller/arm-gic.h>
    ahb {
        #address-cells = <2>;
        #size-cells = <2>;
        mc: memory-controller@f0824000 {
            compatible = "nuvoton,npcm750-memory-controller";
            reg = <0x0 0xf0824000 0x0 0x1000>;
            interrupts = <GIC_SPI 25 IRQ_TYPE_LEVEL_HIGH>;
        };
    };
```

## Documentation/devicetree/bindings/extcon/ti,palmas-usb-vid.yaml
```yaml
# SPDX-License-Identifier: GPL-2.0-only
%YAML 1.2
---
$id: http://devicetree.org/schemas/extcon/ti,palmas-usb-vid.yaml#
$schema: http://devicetree.org/meta-schemas/core.yaml#

title: Texas Instruments Palmas family of Power-Management ICs (extcon)

maintainers:
  - MyungJoo Ham <myungjoo.ham@samsung.com>
  - Chanwoo Choi <cw00.choi@samsung.com>

properties:
  compatible:
    oneOf:
      - const: ti,palmas-usb-vid
      - const: ti,twl6035-usb-vid
      - const: ti,palmas-usb
        deprecated: true
      - const: ti,twl6035-usb
        deprecated: true

  ti,wakeup:
    $ref: /schemas/types.yaml#/definitions/flag
    description: To enable the wakeup comparator in probe

  ti,enable-id-detection:
    $ref: /schemas/types.yaml#/definitions/flag
    description: Perform ID detection. If id-gpios is specified it performs id-detection using
      GPIO else using OTG core.

  ti,enable-vbus-detection:
    $ref: /schemas/types.yaml#/definitions/flag
    description: Perform VBUS detection.

  id-gpios:
    description: GPIO for GPIO ID detection. See GPIO bindings.

  debounce-delay-ms:
    description: debounce delay for GPIO ID pin in milliseconds

additionalProperties: false

required:
  - compatible

examples:
  - |
    i2c {
      #address-cells = <1>;
      #size-cells = <0>;

      pmic@38 {
        compatible = "ti,tps65913", "ti,palmas";
        reg = <0x38>;

        #interrupt-cells = <2>;
        interrupt-controller;

        palmas_usb {
          compatible = "ti,palmas-usb-vid";
          ti,wakeup;
        };
      };
    };
```

## Documentation/devicetree/bindings/firmware/arm,scmi-devid.yaml
```yaml
# SPDX-License-Identifier: (GPL-2.0 OR BSD-2-Clause)
# Copyright 2022 EPAM Systems.
%YAML 1.2
---
$id: http://devicetree.org/schemas/firmware/arm,scmi-devid.yaml#
$schema: http://devicetree.org/meta-schemas/core.yaml#

title: System Control and Management Interface (SCMI) Device ID for permissions
    handling

maintainers:
  - Oleksii Moisieiev <oleksii_moisieiev@epam.com>

description: |
  SCMI device id property is intended to set the device id, needed to manage
  the device permissions via SCMI protocol in the firmware. The device Id
  should match device ids, defined in the firmware so the device permissions
  can be requested by sending BASE_SET_DEVICE_PERMISSIONS (see 4.2.2.10 of [0]).

  This property is useful on the virtualized systems, when several agents are
  running on the same time and permissions should be set for the devices,
  related to different agents.

  [0] https://developer.arm.com/documentation/den0056/latest

properties:
  scmi_devid:
    description: Identifier of the device, matching device id, defined in
      the firmware.
    $ref: /schemas/types.yaml#/definitions/uint32

additionalProperties: false

examples:
  - |
    ohci1: usb@ee0a0000 {
        /* ... */
        reg = <0 0xee0a0000 0 0x100>;
        scmi_devid = <11>;
        clocks = <&scmi_clock 4>;
    };
```
