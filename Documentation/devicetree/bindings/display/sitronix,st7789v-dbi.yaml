## Documentation/devicetree/bindings/display/sitronix,st7789v-dbi.yaml
```yaml
# SPDX-License-Identifier: (GPL-2.0-only OR BSD-2-Clause)
%YAML 1.2
---
$id: http://devicetree.org/schemas/display/sitronix,st7789v-dbi.yaml#
$schema: http://devicetree.org/meta-schemas/core.yaml#

title: Sitronix ST7789V Display Panels Device Tree Bindings

maintainers:
  - Carlis <zhangxuezhi1@yulong.com>

description:
  This binding is for display panels using a Sitronix ST7789V
  controller in SPI mode.

allOf:
  - $ref: panel/panel-common.yaml#

properties:
  compatible:
    oneOf:
      - description:
          Waveshare 2" 240x320 Color TFT LCD
        items:
          - enum:
              - waveshare,ws2inch
          - const: sitronix,st7789v-dbi

  spi-max-frequency:
    maximum: 32000000

  dc-gpios:
    maxItems: 1
    description: Display data/command selection (D/CX)

  backlight: true
  reg: true
  reset-gpios: true
  rotation: true

required:
  - compatible
  - reg
  - dc-gpios
  - reset-gpios

additionalProperties: false

examples:
  - |
    #include <dt-bindings/gpio/gpio.h>

    backlight: backlight {
            compatible = "gpio-backlight";
            gpios = <&gpio 18 GPIO_ACTIVE_HIGH>;
    };

    spi {
            #address-cells = <1>;
            #size-cells = <0>;

            display@0{
                    compatible = "waveshare,ws2inch", "sitronix,st7789v-dbi";
                    reg = <0>;
                    spi-max-frequency = <32000000>;
                    dc-gpios = <&gpio 25 GPIO_ACTIVE_HIGH>;
                    reset-gpios = <&gpio 27 GPIO_ACTIVE_HIGH>;
                    rotation = <270>;
            };
    };

...
```

## Documentation/devicetree/bindings/display/tegra/nvidia,tegra20-gr3d.yaml
```yaml
# SPDX-License-Identifier: (GPL-2.0-only OR BSD-2-Clause)
%YAML 1.2
---
$id: http://devicetree.org/schemas/display/tegra/nvidia,tegra20-gr3d.yaml#
$schema: http://devicetree.org/meta-schemas/core.yaml#

title: NVIDIA 3D graphics engine

maintainers:
  - Thierry Reding <thierry.reding@gmail.com>
  - Jon Hunter <jonathanh@nvidia.com>

properties:
  $nodename:
    pattern: "^gr3d@[0-9a-f]+$"

  compatible:
    enum:
      - nvidia,tegra20-gr3d
      - nvidia,tegra30-gr3d
      - nvidia,tegra114-gr3d

  reg:
    maxItems: 1

  clocks:
    minItems: 1
    maxItems: 2

  clock-names:
    minItems: 1
    maxItems: 2

  resets:
    minItems: 1
    maxItems: 2

  reset-names:
    minItems: 1
    maxItems: 2

  iommus:
    minItems: 1
    maxItems: 2

allOf:
  - if:
      properties:
        compatible:
          contains:
            const: nvidia,tegra30-gr3d
    then:
      properties:
        clocks:
          items:
            - description: primary module clock
            - description: secondary module clock

        clock-names:
          items:
            - const: 3d
            - const: 3d2

        resets:
          items:
            - description: primary module reset
            - description: secondary module reset

        reset-names:
          items:
            - const: 3d
            - const: 3d2

        iommus:
          maxItems: 2
    else:
      properties:
        clocks:
          items:
            - description: module clock

        clock-names:
          items:
            - const: 3d

        resets:
          items:
            - description: module reset

        reset-names:
          items:
            - const: 3d

        iommus:
          maxItems: 1

additionalProperties: false

examples:
  - |
    #include <dt-bindings/clock/tegra20-car.h>

    gr3d@54180000 {
        compatible = "nvidia,tegra20-gr3d";
        reg = <0x54180000 0x00040000>;
        clocks = <&tegra_car TEGRA20_CLK_GR3D>;
        resets = <&tegra_car 24>;
        reset-names = "3d";
    };
```

## Documentation/devicetree/bindings/display/vdrm.yaml
```yaml
# SPDX-License-Identifier: (GPL-2.0-only OR BSD-2-Clause)
%YAML 1.2
---
$id: http://devicetree.org/schemas/display/vdrm.yaml#
$schema: http://devicetree.org/meta-schemas/core.yaml#

title: Virtual DRM Device Tree Bindings

description:
  This document defines device tree properties virtual DRM. The initial
  position, size and z-position of the plane used in the virtual DRM is
  specified.
  The current limitation is that these settings are applied to all crtc.

properties:
  compatible:
    const: virt-drm

patternProperties:
  "^plane(@.*)?$":
    description: Information of the planes used in virtual DRM
    type: object

    properties:
      x:
        type: int
        description: x-coordinate of the left-top of the plane in pixels

      y:
        type: int
        description: y-coordinate of the left-top of the plane in pixels

      width:
        type: int
        description: width of the plane in pixels

      height:
        type: int
	description: height of the plane in pixels

      zpos:
        type: int
        description: z-position of the plane

    required:
      - x
      - y
      - width
      - height
      - zpos

required:
  - compatible
  - "^plane(@.*)?$"

examples:
 - |
   vdrm@0 {
       compatible = "virt-drm";
       plane@0 {
           x = <200>;
	   y = <100>;
	   width = <800>;
	   height = <600>;
	   zpos = <1>;
       };
   };
```

## Documentation/devicetree/bindings/dma/arm-pl08x.yaml
```yaml
# SPDX-License-Identifier: (GPL-2.0-only OR BSD-2-Clause)
%YAML 1.2
---
$id: http://devicetree.org/schemas/dma/arm-pl08x.yaml#
$schema: http://devicetree.org/meta-schemas/core.yaml#

title: ARM PrimeCells PL080 and PL081 and derivatives DMA controller

maintainers:
  - Vinod Koul <vkoul@kernel.org>

allOf:
  - $ref: "dma-controller.yaml#"

properties:
  compatible:
    oneOf:
      - items:
        - const: "arm,pl080"
        - const: "arm,primecell"
      - items:
        - const: "arm,pl081"
        - const: "arm,primecell"
      - items:
        - const: faraday,ftdma020
        - const: arm,pl080
        - const: arm,primecell
  arm,primecell-periphid:
    $ref: /schemas/types.yaml#/definitions/uint32
    description: on the FTDMAC020 the primecell ID is not hard-coded
                 in the hardware and must be specified here as <0x0003b080>. This number
                 follows the PrimeCell standard numbering using the JEP106 vendor code 0x38
                 for Faraday Technology.
  reg:
    minItems: 1
    description: Address range of the PL08x registers
  interrupts:
    minItems: 1
    description: The PL08x interrupt number
  clocks:
    minItems: 1
    description: The clock running the IP core clock
  clock-names:
    const: "apb_pclk"
  lli-bus-interface-ahb1:
    type: boolean
    description: if AHB master 1 is eligible for fetching LLIs
  lli-bus-interface-ahb2:
    type: boolean
    description: if AHB master 2 is eligible for fetching LLIs
  mem-bus-interface-ahb1:
    type: boolean
    description: if AHB master 1 is eligible for fetching memory contents
  mem-bus-interface-ahb2:
    type: boolean
    description: if AHB master 2 is eligible for fetching memory contents
  "#dma-cells":
    const: 2
    description: must be <2>. First cell should contain the DMA request,
                 second cell should contain either 1 or 2 depending on
                 which AHB master that is used.

  memcpy-burst-size:
    $ref: /schemas/types.yaml#/definitions/uint32
    enum:
        - 1
        - 4
        - 8
        - 16
        - 32
        - 64
        - 128
        - 256
    description: the size of the bursts for memcpy
  memcpy-bus-width:
    $ref: /schemas/types.yaml#/definitions/uint32
    enum:
        - 8
        - 16
        - 32
        - 64
    description: |
                 the bus width used for memcpy in bits: 8, 16 or 32 are legal
                 values, the Faraday FTDMAC020 can also accept 64 bits

required:
  - reg
  - interrupts
  - clocks
  - clock-names
  - "#dma-cells"

unevaluatedProperties: false

examples:
  - |
    dmac0: dma-controller@10130000 {
      compatible = "arm,pl080", "arm,primecell";
      reg = <0x10130000 0x1000>;
      interrupt-parent = <&vica>;
      interrupts = <15>;
      clocks = <&hclkdma0>;
      clock-names = "apb_pclk";
      lli-bus-interface-ahb1;
      lli-bus-interface-ahb2;
      mem-bus-interface-ahb2;
      memcpy-burst-size = <256>;
      memcpy-bus-width = <32>;
      #dma-cells = <2>;
    };
  - |
    dma-controller@67000000 {
      compatible = "faraday,ftdma020", "arm,pl080", "arm,primecell";
      /* Faraday Technology FTDMAC020 variant */
      arm,primecell-periphid = <0x0003b080>;
      reg = <0x67000000 0x1000>;
      interrupts = <9 IRQ_TYPE_EDGE_RISING>;
      resets = <&syscon GEMINI_RESET_DMAC>;
      clocks = <&syscon GEMINI_CLK_AHB>;
      clock-names = "apb_pclk";
      /* Bus interface AHB1 (AHB0) is totally tilted */
      lli-bus-interface-ahb2;
      mem-bus-interface-ahb2;
      memcpy-burst-size = <256>;
      memcpy-bus-width = <32>;
      #dma-cells = <2>;
    };
```

## Documentation/devicetree/bindings/dma/nvidia,tegra186-gpc-dma.yaml
```yaml
# SPDX-License-Identifier: (GPL-2.0-only OR BSD-2-Clause)
%YAML 1.2
---
$id: http://devicetree.org/schemas/dma/nvidia,tegra186-gpc-dma.yaml#
$schema: http://devicetree.org/meta-schemas/core.yaml#

title: Nvidia Tegra GPC DMA Controller Device Tree Bindings

description: |
  The Tegra Genernal Purpose Central (GPC) DMA controller is used for faster
  data transfers between memory to memory, memory to device and device to
  memory.

maintainers:
  - Jon Hunter <jonathanh@nvidia.com>
  - Rajesh Gumasta <rgumasta@nvidia.com>

allOf:
  - $ref: "dma-controller.yaml#"

properties:
  "#dma-cells":
    const: 1

  compatible:
    - enum:
      - nvidia,tegra186-gpcdma
      - nvidia,tegra194-gpcdma

  reg:
    maxItems: 1

  interrupts:
    minItems: 1
    maxItems: 32

  resets:
    maxItems: 1

  reset-names:
    const: gpcdma

  iommus:
    maxItems: 1

  nvidia,stream-id:
    description: |
      stream-id corresponding to GPC DMA clients.
      Defaults to TEGRA186_SID_GPCDMA_0 if not given

required:
  - compatible
  - reg
  - interrupts
  - resets
  - reset-names
  - "#dma-cells"
  - iommus

optional:
  - nvidia,stream-id

examples:
  - |
	gpcdma: dma@2600000 {
		compatible = "nvidia,tegra186-gpcdma";
		reg = <0x0 0x2600000 0x0 0x210000>;
		resets = <&bpmp TEGRA186_RESET_GPCDMA>;
		reset-names = "gpcdma";
		interrupts = 	<GIC_SPI 75 IRQ_TYPE_LEVEL_HIGH>,
				<GIC_SPI 76 IRQ_TYPE_LEVEL_HIGH>,
				<GIC_SPI 77 IRQ_TYPE_LEVEL_HIGH>,
				<GIC_SPI 78 IRQ_TYPE_LEVEL_HIGH>,
				<GIC_SPI 79 IRQ_TYPE_LEVEL_HIGH>,
				<GIC_SPI 80 IRQ_TYPE_LEVEL_HIGH>,
				<GIC_SPI 81 IRQ_TYPE_LEVEL_HIGH>,
				<GIC_SPI 82 IRQ_TYPE_LEVEL_HIGH>,
				<GIC_SPI 83 IRQ_TYPE_LEVEL_HIGH>,
				<GIC_SPI 84 IRQ_TYPE_LEVEL_HIGH>,
				<GIC_SPI 85 IRQ_TYPE_LEVEL_HIGH>,
				<GIC_SPI 86 IRQ_TYPE_LEVEL_HIGH>,
				<GIC_SPI 87 IRQ_TYPE_LEVEL_HIGH>,
				<GIC_SPI 88 IRQ_TYPE_LEVEL_HIGH>,
				<GIC_SPI 89 IRQ_TYPE_LEVEL_HIGH>,
				<GIC_SPI 90 IRQ_TYPE_LEVEL_HIGH>,
				<GIC_SPI 91 IRQ_TYPE_LEVEL_HIGH>,
				<GIC_SPI 92 IRQ_TYPE_LEVEL_HIGH>,
				<GIC_SPI 93 IRQ_TYPE_LEVEL_HIGH>,
				<GIC_SPI 94 IRQ_TYPE_LEVEL_HIGH>,
				<GIC_SPI 95 IRQ_TYPE_LEVEL_HIGH>,
				<GIC_SPI 96 IRQ_TYPE_LEVEL_HIGH>,
				<GIC_SPI 97 IRQ_TYPE_LEVEL_HIGH>,
				<GIC_SPI 98 IRQ_TYPE_LEVEL_HIGH>,
				<GIC_SPI 99 IRQ_TYPE_LEVEL_HIGH>,
				<GIC_SPI 100 IRQ_TYPE_LEVEL_HIGH>,
				<GIC_SPI 101 IRQ_TYPE_LEVEL_HIGH>,
				<GIC_SPI 102 IRQ_TYPE_LEVEL_HIGH>,
				<GIC_SPI 103 IRQ_TYPE_LEVEL_HIGH>,
				<GIC_SPI 104 IRQ_TYPE_LEVEL_HIGH>,
				<GIC_SPI 105 IRQ_TYPE_LEVEL_HIGH>,
				<GIC_SPI 106 IRQ_TYPE_LEVEL_HIGH>,
				<GIC_SPI 107 IRQ_TYPE_LEVEL_HIGH>;
		#dma-cells = <1>;
		iommus = <&smmu TEGRA_SID_GPCDMA_0>;
		dma-coherent;
	};
...
```

## Documentation/devicetree/bindings/dma/oxsemi,ox810se-dma.yaml
```yaml
# SPDX-License-Identifier: (GPL-2.0-only OR BSD-2-Clause)
%YAML 1.2
---
$id: http://devicetree.org/schemas/dma/oxsemi,ox810se-dma.yaml#
$schema: http://devicetree.org/meta-schemas/core.yaml#

title: Oxford Semiconductor DMA Controller Device Tree Bindings

maintainers:
  - Neil Armstrong <narmstrong@baylibre.com>

allOf:
  - $ref: "dma-controller.yaml#"

properties:
  "#dma-cells":
    const: 1

  compatible:
    const: oxsemi,ox810se-dma

  reg:
    maxItems: 2

  reg-names:
    items:
      - const: dma
      - const: sgdma

  interrupts:
    maxItems: 5

  clocks:
    maxItems: 1

  resets:
    maxItems: 2

  reset-names:
    items:
      - const: dma
      - const: sgdma

  dma-channels: true

  oxsemi,targets-types:
    description:
      Table with allowed memory ranges and memory type associated.
    $ref: "/schemas/types.yaml#/definitions/uint32-matrix"
    minItems: 4
    items:
      items:
        - description:
            The first cell defines the memory range start address
        - description:
            The first cell defines the memory range end address
        - description:
            The third cell represents memory type, 0 for SATA,
            1 for DPE RX, 2 for DPE TX, 5 for AUDIO TX, 6 for AUDIO RX,
            15 for DRAM MEMORY.
          enum: [ 0, 1, 2, 5, 6, 15 ]

required:
  - "#dma-cells"
  - dma-channels
  - compatible
  - reg
  - interrupts
  - clocks
  - resets
  - reset-names
  - oxsemi,targets-types

additionalProperties: false

examples:
  - |
    dma: dma-controller@600000 {
        compatible = "oxsemi,ox810se-dma";
        reg = <0x600000 0x100000>, <0xc00000 0x100000>;
        reg-names = "dma", "sgdma";
        interrupts = <13>, <14>, <15>, <16>, <20>;
        clocks = <&stdclk 1>;
        resets = <&reset 8>, <&reset 24>;
        reset-names = "dma", "sgdma";

        /* Encodes the authorized memory types */
        oxsemi,targets-types =
            <0x45900000 0x45a00000 0>,  /* SATA */
            <0x42000000 0x43000000 0>,  /* SATA DATA */
            <0x48000000 0x58000000 15>, /* DDR */
            <0x58000000 0x58020000 15>; /* SRAM */

        #dma-cells = <1>;
        dma-channels = <5>;
    };
...
```
