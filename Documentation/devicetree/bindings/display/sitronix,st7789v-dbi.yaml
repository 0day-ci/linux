## Documentation/devicetree/bindings/firmware/google,open-dice.yaml
```yaml
# SPDX-License-Identifier: GPL-2.0-only OR BSD-2-Clause
%YAML 1.2
---
$id: http://devicetree.org/schemas/firmware/google,open-dice.yaml#
$schema: http://devicetree.org/meta-schemas/core.yaml#

title: Open Profile for DICE Device Tree Bindings

description: |
  This binding represents a reserved memory region containing data
  generated by the Open Profile for DICE protocol.

  See https://pigweed.googlesource.com/open-dice/

maintainers:
  - David Brazdil <dbrazdil@google.com>

properties:
  compatible:
    enum:
      - google,open-dice

  memory-region:
    maxItems: 1
    description: |
      phandle to the reserved memory node to be associated with the device
      The reserved memory node should be defined as per the bindings,
      Documentation/devicetree/bindings/reserved-memory/reserved-memory.yaml

required:
  - compatible
  - memory-region

additionalProperties: false

examples:
  - |
    reserved-memory {
        #address-cells = <2>;
        #size-cells = <1>;

        dice_reserved: dice@12340000 {
            reg = <0x00 0x12340000 0x2000>;
            no-map;
        };
    };

    dice {
        compatible = "google,open-dice";
        memory-region = <&dice_reserved>;
    };
```

## Documentation/devicetree/bindings/firmware/qcom,scm.yaml
```yaml
# SPDX-License-Identifier: (GPL-2.0-only OR BSD-2-Clause)
%YAML 1.2
---
$id: "http://devicetree.org/schemas/firmware/qcom,scm.yaml#"
$schema: "http://devicetree.org/meta-schemas/core.yaml#"

title: QCOM Secure Channel Manager (SCM)

description: |
  Qualcomm processors include an interface to communicate to the secure firmware.
  This interface allows for clients to request different types of actions.  These
  can include CPU power up/down, HDCP requests, loading of firmware, and other
  assorted actions.

maintainers:
  - Andy Gross <andy.gross@linaro.org>

properties:
  compatible:
    items:
      - enum:
          - qcom,scm-apq8064
          - qcom,scm-apq8084
          - qcom,scm-ipq4019
          - qcom,scm-ipq806x
          - qcom,scm-ipq8074
          - qcom,scm-mdm9607
          - qcom,scm-msm8226
          - qcom,scm-msm8660
          - qcom,scm-msm8916
          - qcom,scm-msm8953
          - qcom,scm-msm8960
          - qcom,scm-msm8974
          - qcom,scm-msm8994
          - qcom,scm-msm8996
          - qcom,scm-msm8998
          - qcom,scm-sc7180
          - qcom,scm-sc7280
          - qcom,scm-sdm845
          - qcom,scm-sdx55
          - qcom,scm-sm8150
          - qcom,scm-sm8250
          - qcom,scm-sm8350
      - const: qcom,scm

  clocks:
    minItems: 1
    maxItems: 3

  clock-names: true

  qcom,dload-mode:
    $ref: /schemas/types.yaml#/definitions/phandle
    description: >
      TCSR hardware block and offset of the download mode control register

allOf:
  - if:
      properties:
        compatible:
          contains:
            enum:
              - qcom,scm-apq8064
              - qcom,scm-msm8660
              - qcom,scm-msm8960
    then:
      properties:
        clock-names:
          items:
            - const: core

      required:
        - clocks
        - clock-names

  - if:
      properties:
        compatible:
          contains:
            enum:
              - qcom,scm-apq8084
              - qcom,scm-msm8916
              - qcom,scm-msm8953
              - qcom,scm-msm8974
    then:
      properties:
        clock-names:
          items:
            - const: core
            - const: iface
            - const: bus

      required:
        - clocks
        - clock-names

required:
  - compatible

additionalProperties: false

examples:
  - |
    firmware {
        scm {
            compatible = "qcom,msm8916", "qcom,scm";
            clocks = <&gcc 104>,
                     <&gcc 77>,
                     <&gcc 86>;
            clock-names = "core", "bus", "iface";
        };
    };
```

## Documentation/devicetree/bindings/firmware/xilinx/xlnx,zynqmp-firmware.yaml
```yaml
# SPDX-License-Identifier: (GPL-2.0-only OR BSD-2-Clause)
%YAML 1.2
---
$id: http://devicetree.org/schemas/firmware/xilinx/xlnx,zynqmp-firmware.yaml#
$schema: http://devicetree.org/meta-schemas/core.yaml#

title: Xilinx firmware driver

maintainers:
  - Nava kishore Manne <nava.manne@xilinx.com>

description:
  The zynqmp-firmware node describes the interface to platform firmware.
  ZynqMP has an interface to communicate with secure firmware. Firmware
  driver provides an interface to firmware APIs. Interface APIs can be
  used by any driver to communicate to PMUFW(Platform Management Unit).
  These requests include clock management, pin control, device control,
  power management service, FPGA service and other platform management
  services.

properties:
  compatible:
    oneOf:
      - description:
          For implementations complying for Zynq Ultrascale+ MPSoC.
        const: xlnx,zynqmp-firmware

      - description:
          For implementations complying for Versal.
        const: xlnx,versal-firmware

  method:
    description: |
                 The method of calling the PM-API firmware layer.
                 Permitted values are.
                 - "smc" : SMC #0, following the SMCCC
                 - "hvc" : HVC #0, following the SMCCC

    $ref: /schemas/types.yaml#/definitions/string-array
    enum:
      - smc
      - hvc

patternProperties:
  "versal_fpga":
    $ref: "../../fpga/xlnx,versal-fpga.yaml#"
    description: Compatible of the FPGA device.
    type: object

    required:
      - compatible

required:
  - compatible

examples:
  - |
    versal-firmware {
      compatible = "xlnx,versal-firmware";
      method = "smc";
      versal_fpga: versal_fpga {
        compatible = "xlnx,versal-fpga";
      };
    };

additionalProperties: false
```

## Documentation/devicetree/bindings/fpga/xlnx,alveo-partition.yaml
```yaml
# SPDX-License-Identifier: (GPL-2.0-only OR BSD-2-Clause)
%YAML 1.2
---
$id: http://devicetree.org/schemas/fpga/xlnx,alveo-partition.yaml#
$schema: http://devicetree.org/meta-schemas/core.yaml#

title: Xilinx Alveo platform partition bindings

description: |
  Xilinx Alveo platform is a PCI device and has one or more partitions. A
  partition is programmed dynamically and contains a set of hardware
  peripherals also referred to as endpoints which appear on the PCI BARs.
  This binding is defined for endpoint address translation which uses the
  the following encoding:

    0xIooooooo 0xoooooooo

  Where:

    I = BAR index
    oooooo oooooooo = BAR offset

  As a PCI device, the Alveo platform is enumerated at runtime. Thus,
  the partition node is created by Alveo device driver. The device driver
  gets the BAR base address of the PCI device and creates the 'range'
  property for address translation.

allOf:
  - $ref: /schemas/simple-bus.yaml#

maintainers:
  - Lizhi Hou <lizhi.hou@xilinx.com>

properties:
  compatible:
    contains:
      const: xlnx,alveo-partition

  "#address-cells":
    const: 2

  "#size-cells":
    const: 2

  ranges: true

patternProperties:
  "^.*@[0-9a-f]+$":
    description: hardware endpoints belong to this partition.
    type: object

required:
  - compatible
  - "#address-cells"
  - "#size-cells"
  - ranges

additionalProperties: false

examples:
  - |
    bus {
        #address-cells = <2>;
        #size-cells = <2>;
        xrt-part-bus@0 {
            compatible = "xlnx,alveo-partition", "simple-bus";
            #address-cells = <2>;
            #size-cells = <2>;
            ranges = <0x0 0x0 0x0 0xe0000000 0x0 0x2000000
                      0x20000000 0x0 0x0 0xe4200000 0x0 0x40000>;
            pr-isolate-ulp@41000 {
                compatible = "xlnx,alveo-pr-isolation";
                reg = <0x0 0x41000 0 0x1000>;
            };
        };
    };
```

## Documentation/devicetree/bindings/fpga/xlnx,alveo-pr-isolation.yaml
```yaml
# SPDX-License-Identifier: (GPL-2.0-only OR BSD-2-Clause)
%YAML 1.2
---
$id: http://devicetree.org/schemas/fpga/xlnx,alveo-pr-isolation.yaml#
$schema: http://devicetree.org/meta-schemas/core.yaml#

title: Xilinx Partial Reconfig Isolation for Alveo platforms

description: |
  The Partial Reconfig ensures glitch free operation of the inputs from
  a reconfigurable partition during partial reconfiguration on Alveo
  platform.

maintainers:
  - Lizhi Hou <lizhi.hou@xilinx.com>

properties:
  compatible:
    const: xlnx,alveo-pr-isolation

  reg:
    maxItems: 1

required:
  - compatible
  - reg

additionalProperties: false

examples:
  - |
    bus {
        #address-cells = <2>;
        #size-cells = <2>;

        pr-isolation-ulp@41000 {
            compatible = "xlnx,alveo-pr-isolation";
            reg = <0 0x41000 0 0x1000>;
        };
    };
```

## Documentation/devicetree/bindings/gpio/aspeed,sgpio.yaml
```yaml
# SPDX-License-Identifier: (GPL-2.0-only OR BSD-2-Clause)
%YAML 1.2
---
$id: http://devicetree.org/schemas/gpio/sgpio-aspeed.yaml#
$schema: http://devicetree.org/meta-schemas/core.yaml#

title: Aspeed SGPIO controller

maintainers:
  - Andrew Jeffery <andrew@aj.id.au>

description:
  This SGPIO controller is for ASPEED AST2400, AST2500 and AST2600 SoC,
  AST2600 have two sgpio master one with 128 pins another one with 80 pins,
  AST2500/AST2400 have one sgpio master with 80 pins. Each of the Serial
  GPIO pins can be programmed to support the following options
  - Support interrupt option for each input port and various interrupt
    sensitivity option (level-high, level-low, edge-high, edge-low)
  - Support reset tolerance option for each output port
  - Directly connected to APB bus and its shift clock is from APB bus clock
    divided by a programmable value.
  - Co-work with external signal-chained TTL components (74LV165/74LV595)

properties:
  compatible:
    enum:
      - aspeed,ast2400-sgpiom
      - aspeed,ast2500-sgpiom
      - aspeed,ast2600-sgpiom

  reg:
    maxItems: 1

  gpio-controller: true

  '#gpio-cells':
    const: 2

  interrupts:
    maxItems: 1

  interrupt-controller: true

  clocks:
    maxItems: 1

  ngpios:
    minimum: 0
    maximum: 128

  max-ngpios:
    description:
      represents the number of actual hardware-supported GPIOs (ie,
      slots within the clocked serial GPIO data). Since each HW GPIO is both an
      input and an output, we provide max_ngpios * 2 lines on our gpiochip
      device. We also use it to define the split between the inputs and
      outputs; the inputs start at line 0, the outputs start at max_ngpios.
    minimum: 0
    maximum: 128

  bus-frequency: true

required:
  - compatible
  - reg
  - gpio-controller
  - '#gpio-cells'
  - interrupts
  - interrupt-controller
  - ngpios
  - max-ngpios
  - clocks
  - bus-frequency

additionalProperties: false

examples:
  - |
    #include <dt-bindings/clock/aspeed-clock.h>
    sgpio: sgpio@1e780200 {
        #gpio-cells = <2>;
        compatible = "aspeed,ast2500-sgpiom";
        gpio-controller;
        interrupts = <40>;
        reg = <0x1e780200 0x0100>;
        clocks = <&syscon ASPEED_CLK_APB>;
        interrupt-controller;
        ngpios = <8>;
        max-ngpios = <80>;
        bus-frequency = <12000000>;
    };
```

## Documentation/devicetree/bindings/gpio/brcm,bcm63xx-gpio.yaml
```yaml
# SPDX-License-Identifier: GPL-2.0-only OR BSD-2-Clause
%YAML 1.2
---
$id: http://devicetree.org/schemas/gpio/brcm,bcm63xx-gpio.yaml#
$schema: http://devicetree.org/meta-schemas/core.yaml#

title: Broadcom BCM63xx GPIO controller

maintainers:
  - Álvaro Fernández Rojas <noltari@gmail.com>
  - Jonas Gorski <jonas.gorski@gmail.com>

description: |+
  The GPIO controller node should be the child of a syscon node.

  Refer to the the bindings described in
  Documentation/devicetree/bindings/mfd/syscon.yaml

properties:
  compatible:
    enum:
      - brcm,bcm6318-gpio
      - brcm,bcm6328-gpio
      - brcm,bcm6358-gpio
      - brcm,bcm6362-gpio
      - brcm,bcm6368-gpio
      - brcm,bcm63268-gpio

  data:
    $ref: /schemas/types.yaml#/definitions/uint32
    description: |
      Offset in the register map for the data register (in bytes).

  dirout:
    $ref: /schemas/types.yaml#/definitions/uint32
    description: |
      Offset in the register map for the dirout register (in bytes).

  gpio-controller: true

  "#gpio-cells":
    const: 2

  gpio-ranges:
    maxItems: 1

  reg:
    maxItems: 1

required:
  - compatible
  - gpio-controller
  - gpio-ranges
  - '#gpio-cells'

additionalProperties: false

examples:
  - |
    gpio@0 {
      compatible = "brcm,bcm6328-gpio";
      reg = <0x0 0x10>;

      data = <0xc>;
      dirout = <0x4>;

      gpio-controller;
      gpio-ranges = <&pinctrl 0 0 32>;
      #gpio-cells = <2>;
    };

  - |
    gpio@0 {
      compatible = "brcm,bcm63268-gpio";
      reg = <0x0 0x10>;

      data = <0xc>;
      dirout = <0x4>;

      gpio-controller;
      gpio-ranges = <&pinctrl 0 0 52>;
      #gpio-cells = <2>;
    };
```

## Documentation/devicetree/bindings/gpio/cypress,cy8c95x0.yaml
```yaml
# SPDX-License-Identifier: (GPL-2.0-only OR BSD-2-Clause)
%YAML 1.2
---
$id: http://devicetree.org/schemas/gpio/cypress,cy8c95x0.yaml#
$schema: http://devicetree.org/meta-schemas/core.yaml#

title: Cypress CY8C95X0 I2C GPIO expander

maintainers:
  - Patrick Rudolph <patrick.rudolph@9elements.com>

description:
  This supports the 20/40/60 pin Cypress cyC95x0 GPIO I2C expanders.

properties:
  compatible:
    enum:
      - cypress,cy8c9520
      - cypress,cy8c9540
      - cypress,cy8c9560

  #address-cells:
    const: 2

  reg:
    maxItems: 1

  gpio-controller: true

  '#gpio-cells':
    const: 2

  interrupts:
    maxItems: 1

  interrupt-controller: true

  ngpios:
    minimum: 1
    maximum: 60

  gpio-line-names:
    minItems: 1
    maxItems: 60

  vdd-supply:
    description:
      Optional power supply.

required:
  - compatible
  - #address-cells
  - #size-cells
  - reg
  - gpio-controller
  - #gpio-cells

additionalProperties: false

examples:
  - |
    gpo0: gpo@20 {
        #address-cells = <1>;
        #size-cells = <0>;
        compatible = "cypress,cy8c9520";
        reg = <0x20>;
        gpio-controller;
        #gpio-cells = <2>;
        #interrupt-cells=<2>;
        interrupt-parent = <&irq_ctrl>;
        interrupts = <10 IRQ_TYPE_LEVEL_HIGH>;
        interrupt-controller;
        vdd-supply = <&p3v3>;
        ngpios = <16>;
        gpio-reserved-ranges = <5 1>;

        gpio-line-names =
        /* GPORT0 */
        "", "PWRGD_PVTT_ABC_CPU0",
        "SMB_VR_CPU0_PVCCIN_ALERT", "SMB_VR_CPU0_DEF_ALERT",
        "PWRGD_PVTT_DEF_CPU0", "", "RST_LVC3_CPU0_RESET_N",
        "SMB_VR_CPU0_PVCCIO_ALERT",
        /* GPORT1 */
        "FM_CPU0_ADR_COMPLETE_DLY", "FM_CPU0_ADR_COMPLETE_N",
        "PWRGD_LVC3_CPU0_PWRGOOD", "H_LVT3_CPU0_PROCHOT_N",
        "H_LVT3_CPU0_MEM_ABC_HOT_N", "H_LVT3_CPU0_MEM_DEF_HOT_N",
        "PWRGD_LVC3_CPU0_ABC_DRAM_G", "PWRGD_LVC3_CPU0_DEF_DRAM_G";
    };
```

## Documentation/devicetree/bindings/gpio/delta,tn48m-gpio.yaml
```yaml
# SPDX-License-Identifier: (GPL-2.0-only OR BSD-2-Clause)
%YAML 1.2
---
$id: http://devicetree.org/schemas/gpio/delta,tn48m-gpio.yaml#
$schema: http://devicetree.org/meta-schemas/core.yaml#

title: Delta Networks TN48M CPLD GPIO controller

maintainers:
  - Robert Marko <robert.marko@sartura.hr>

description: |
  This module is part of the Delta TN48M multi-function device. For more
  details see ../mfd/delta,tn48m-cpld.yaml.

  GPIO controller module provides GPIO-s for the SFP slots.
  It is split into 3 controllers, one output only for the SFP TX disable
  pins, one input only for the SFP present pins and one input only for
  the SFP LOS pins.

properties:
  compatible:
    enum:
      - delta,tn48m-gpio-sfp-tx-disable
      - delta,tn48m-gpio-sfp-present
      - delta,tn48m-gpio-sfp-los

  reg:
    maxItems: 1

  "#gpio-cells":
    const: 2

  gpio-controller: true

required:
  - compatible
  - reg
  - "#gpio-cells"
  - gpio-controller

additionalProperties: false
```
