## Documentation/devicetree/bindings/display/panel/panel-lvds.yaml
```yaml
# SPDX-License-Identifier: (GPL-2.0-only OR BSD-2-Clause)
%YAML 1.2
---
$id: http://devicetree.org/schemas/display/panel/panel-lvds.yaml#
$schema: http://devicetree.org/meta-schemas/core.yaml#

title: Generic LVDS Display Panel Device Tree Bindings

maintainers:
  - Lad Prabhakar <prabhakar.mahadev-lad.rj@bp.renesas.com>
  - Thierry Reding <thierry.reding@gmail.com>

allOf:
  - $ref: panel-common.yaml#
  - $ref: /schemas/display/lvds.yaml/#

select:
  properties:
    compatible:
      contains:
        enum:
          - auo,b101ew05
          - tbs,a711-panel

  required:
    - compatible

properties:
  compatible:
    items:
      - enum:
          - auo,b101ew05
          - tbs,a711-panel

      - const: panel-lvds

unevaluatedProperties: false

required:
  - compatible
  - data-mapping
  - width-mm
  - height-mm
  - panel-timing
  - port

...
```

## Documentation/devicetree/bindings/display/panel/panel-mipi-dbi-spi.yaml
```yaml
# SPDX-License-Identifier: GPL-2.0-only
%YAML 1.2
---
$id: http://devicetree.org/schemas/display/panel/panel-mipi-dbi-spi.yaml#
$schema: http://devicetree.org/meta-schemas/core.yaml#

title: MIPI DBI SPI Panels Device Tree Bindings

maintainers:
  - Noralf Trønnes <noralf@tronnes.org>

description:
  This binding is for display panels using a MIPI DBI controller
  in SPI mode.

allOf:
  - $ref: panel-common.yaml#
  - $ref: /schemas/spi/spi-peripheral-props.yaml#

properties:
  compatible:
    const: panel-mipi-dbi-spi

  write-only:
    type: boolean
    description:
      Controller is not readable (ie. MISO is not wired up).

  dc-gpios:
    maxItems: 1
    description: |
      Controller data/command selection (D/CX) in 4-line SPI mode.
      If not set, the controller is in 3-line SPI mode.

required:
  - compatible
  - reg

unevaluatedProperties: false

examples:
  - |
    #include <dt-bindings/gpio/gpio.h>

    spi {
            #address-cells = <1>;
            #size-cells = <0>;

            display@0{
                    compatible = "panel-mipi-dbi-spi";
                    reg = <0>;
                    spi-max-frequency = <40000000>;
                    dc-gpios = <&gpio 24 GPIO_ACTIVE_HIGH>;
                    reset-gpios = <&gpio 25 GPIO_ACTIVE_HIGH>;
                    write-only;
            };
    };

...
```

## Documentation/devicetree/bindings/display/panel/samsung,lms380kf01.yaml
```yaml
# SPDX-License-Identifier: (GPL-2.0-only OR BSD-2-Clause)
%YAML 1.2
---
$id: http://devicetree.org/schemas/display/panel/samsung,lms380kf01.yaml#
$schema: http://devicetree.org/meta-schemas/core.yaml#

title: Samsung LMS380KF01 display panel

description: The LMS380KF01 is a 480x800 DPI display panel from Samsung Mobile
  Displays (SMD) utilizing the WideChips WS2401 display controller. It can be
  used with internal or external backlight control.

maintainers:
  - Linus Walleij <linus.walleij@linaro.org>

allOf:
  - $ref: panel-common.yaml#

properties:
  compatible:
    const: samsung,lms380kf01

  reg: true

  interrupts:
    description: provides an optional ESD (electrostatic discharge)
      interrupt that signals abnormalities in the display hardware.
      This can also be raised for other reasons like erroneous
      configuration.
    maxItems: 1

  reset-gpios: true

  vci-supply:
    description: regulator that supplies the VCI analog voltage
      usually around 3.0 V

  vccio-supply:
    description: regulator that supplies the VCCIO voltage usually
      around 1.8 V

  backlight: true

  spi-cpha:
    $ref: /schemas/types.yaml#/definitions/flag
    description: inherited as a SPI client node. Must be set.

  spi-cpol:
    $ref: /schemas/types.yaml#/definitions/flag
    description: inherited as a SPI client node. Must be set.

  spi-max-frequency:
    $ref: /schemas/types.yaml#/definitions/uint32
    description: inherited as a SPI client node.
    maximum: 1200000

  port: true

required:
  - compatible
  - reg
  - spi-cpha
  - spi-cpol

additionalProperties: false

examples:
  - |
    #include <dt-bindings/gpio/gpio.h>
    #include <dt-bindings/interrupt-controller/irq.h>

    spi {
      #address-cells = <1>;
      #size-cells = <0>;

      panel@0 {
        compatible = "samsung,lms380kf01";
        spi-max-frequency = <1200000>;
        spi-cpha;
        spi-cpol;
        reg = <0>;
        vci-supply = <&lcd_3v0_reg>;
        vccio-supply = <&lcd_1v8_reg>;
        reset-gpios = <&gpio4 11 GPIO_ACTIVE_LOW>;
        interrupt-parent = <&gpio2>;
        interrupts = <29 IRQ_TYPE_EDGE_RISING>;

        port {
          panel_in: endpoint {
            remote-endpoint = <&display_out>;
          };
        };
      };
    };

...
```

## Documentation/devicetree/bindings/display/panel/sony,synaptics-jdi.yaml
```yaml
# SPDX-License-Identifier: (GPL-2.0-only OR BSD-2-Clause)
%YAML 1.2
---
$id: http://devicetree.org/schemas/display/panel/sony,synaptics-jdi.yaml#
$schema: http://devicetree.org/meta-schemas/core.yaml#

title: SONY Synaptics JDI panel

maintainers:
  - Konrad Dybcio <konrad.dybcio@somainline.org>

description: |+
  This panel seems to only be found in SONY Xperia
  X, X Performance, X Compact, XZ and XZs
  smartphones and we have no straightforward way of
  actually getting the correct model number,
  as no schematics are released publicly.

allOf:
  - $ref: panel-common.yaml#

properties:
  compatible:
    items:
      - enum:
          - sony,synaptics-jdi-dora
          - sony,synaptics-jdi-kagura
          - sony,synaptics-jdi-keyaki
          - sony,synaptics-jdi-kugo
          - sony,synaptics-jdi-suzu

  reg: true

  reset-gpios: true

  avdd-supply:
    description: avdd supply

  vddio-supply:
    description: vddio supply

  vsn-supply:
    description: voltage negative supply

  vsp-supply:
    description: voltage positive supply

  tvdd-supply:
    description: tvdd supply

  preset-gpio:
    description: panel reset pin

  pvddio-gpio:
    description: panel vddio pin

  treset-gpio:
    description: touch reset pin

required:
  - compatible
  - reg
  - preset-gpio
  - pvddio-gpio
  - treset-gpio
  - avdd-supply
  - vddio-supply
  - vsn-supply
  - vsp-supply
  - tvdd-supply

additionalProperties: false

examples:
  - |
    #include <dt-bindings/gpio/gpio.h>

    dsi {
            #address-cells = <1>;
            #size-cells = <0>;
            panel: panel@0 {
                    reg = <0>;

                    pvddio-gpio = <&tlmm 51 GPIO_ACTIVE_HIGH>;
                    preset-gpio = <&tlmm 8 GPIO_ACTIVE_HIGH>;
                    treset-gpio = <&tlmm 89 GPIO_ACTIVE_HIGH>;

                    vddio-supply = <&pm8994_s4>;
                    avdd-supply = <&pm8994_l2>;
                    tvdd-supply = <&panel_tvdd>;

                    backlight = <&pmi8994_wled>;

                    port {
                      panel_in: endpoint {
                        remote-endpoint = <&dsi0_out>;
                      };
                    };
            };
    };
```

## Documentation/devicetree/bindings/display/panel/truly,nt35521.yaml
```yaml
# SPDX-License-Identifier: (GPL-2.0-only OR BSD-2-Clause)
%YAML 1.2
---
$id: http://devicetree.org/schemas/display/panel/truly,nt35521.yaml#
$schema: http://devicetree.org/meta-schemas/core.yaml#

title: Truly NT35521 5.24" 1280x720 MIPI-DSI Panel

maintainers:
  - Shawn Guo <shawn.guo@linaro.org>

description: |
  The Truly NT35521 is a 5.24" 1280x720 MIPI-DSI panel.  The panel backlight
  is managed through DSI link.

allOf:
  - $ref: panel-common.yaml#

properties:
  compatible:
    const: truly,nt35521

  reg: true

  reset-gpios: true

  enable-gpios: true

  pwr-positive5-gpios:
    maxItems: 1

  pwr-negative5-gpios:
    maxItems: 1

required:
  - compatible
  - reg
  - reset-gpios
  - enable-gpios
  - pwr-positive5-gpios
  - pwr-negative5-gpios

additionalProperties: false

examples:
  - |
    #include <dt-bindings/gpio/gpio.h>

    dsi {
        #address-cells = <1>;
        #size-cells = <0>;

        panel@0 {
            compatible = "truly,nt35521";
            reg = <0>;
            reset-gpios = <&msmgpio 25 GPIO_ACTIVE_LOW>;
            pwr-positive5-gpios = <&msmgpio 114 GPIO_ACTIVE_HIGH>;
            pwr-negative5-gpios = <&msmgpio 17 GPIO_ACTIVE_HIGH>;
            enable-gpios = <&msmgpio 10 GPIO_ACTIVE_HIGH>;
        };
    };
...
```

## Documentation/devicetree/bindings/display/rockchip/rockchip-vop2.yaml
```yaml
# SPDX-License-Identifier: GPL-2.0
%YAML 1.2
---
$id: http://devicetree.org/schemas/display/rockchip/rockchip-vop2.yaml#
$schema: http://devicetree.org/meta-schemas/core.yaml#

title: Rockchip SoC display controller (VOP2)

description:
  VOP2 (Video Output Processor v2) is the display controller for the Rockchip
  series of SoCs which transfers the image data from a video memory
  buffer to an external LCD interface.

maintainers:
  - Sandy Huang <hjc@rock-chips.com>
  - Heiko Stuebner <heiko@sntech.de>

properties:
  compatible:
    enum:
      - rockchip,rk3568-vop
      - rockchip,rk3566-vop

  reg:
    minItems: 1
    items:
      - description:
          Must contain one entry corresponding to the base address and length
          of the register space.
      - description:
          Can optionally contain a second entry corresponding to
          the CRTC gamma LUT address.

  interrupts:
    maxItems: 1
    description:
      The VOP interrupt is shared by several interrupt sources, such as
      frame start (VSYNC), line flag and other status interrupts.

  clocks:
    items:
      - description: Clock for ddr buffer transfer.
      - description: Clock for the ahb bus to R/W the phy regs.
      - description: Pixel clock for video port 0.
      - description: Pixel clock for video port 1.
      - description: Pixel clock for video port 2.

  clock-names:
    items:
      - const: aclk_vop
      - const: hclk_vop
      - const: dclk_vp0
      - const: dclk_vp1
      - const: dclk_vp2

  port:
    $ref: /schemas/graph.yaml#/properties/port

  assigned-clocks:
    maxItems: 2

  assigned-clock-rates:
    maxItems: 2

  iommus:
    maxItems: 1

  power-domains:
    maxItems: 1

required:
  - compatible
  - reg
  - interrupts
  - clocks
  - clock-names
  - port

additionalProperties: false

examples:
  - |
    #include <dt-bindings/clock/rk3568-cru.h>
    #include <dt-bindings/interrupt-controller/arm-gic.h>
    #include <dt-bindings/power/rk3568-power.h>
    vop: vop@fe040000 {
      compatible = "rockchip,rk3568-vop";
      reg = <0x0 0xfe040000 0x0 0x3000>, <0x0 0xfe044000 0x0 0x1000>;
      interrupts = <GIC_SPI 148 IRQ_TYPE_LEVEL_HIGH>;
      clocks = <&cru ACLK_VOP>,
               <&cru HCLK_VOP>,
               <&cru DCLK_VOP0>,
               <&cru DCLK_VOP1>,
               <&cru DCLK_VOP2>;
      clock-names = "aclk_vop",
                    "hclk_vop",
                    "dclk_vp0",
                    "dclk_vp1",
                    "dclk_vp2";
      power-domains = <&power RK3568_PD_VO>;
      iommus = <&vop_mmu>;
      vop_out: port {
        #address-cells = <1>;
        #size-cells = <0>;
        vp0_out_dsi0: endpoint@0 {
          reg = <0>;
          remote-endpoint = <&dsi0_in_vp0>;
        };
        vp0_out_hdmi: endpoint@1 {
          reg = <1>;
          remote-endpoint = <&dsi0_in_vp0>;
        };
      };
    };
```

## Documentation/devicetree/bindings/display/simple-dbi.yaml
```yaml
# SPDX-License-Identifier: GPL-2.0-only
%YAML 1.2
---
$id: http://devicetree.org/schemas/display/simple-dbi.yaml#
$schema: http://devicetree.org/meta-schemas/core.yaml#

title: Generic MIPI DCS-compatible DBI panels Device Tree Bindings

maintainers:
  - Icenowy Zheng <icenowy@sipeed.com>

description:
  This binding is for display panels that utilizes MIPI DBI Type C, follows
  MIPI DCS and needs no vendor-specific initialization commands.

properties:
  compatible:
    oneOf:
      - description:
          Zhishengxin ZSX154-B1206 1.54" 240x240 SPI LCD
        items:
          - const: zsx,zsx154-b1206

  spi-max-frequency:
    maximum: 30000000

  dc-gpios:
    maxItems: 1
    description: Display data/command selection (D/CX)

  backlight: true
  reg: true
  reset-gpios: true
  rotation: true

required:
  - compatible
  - reg

allOf:
  - $ref: panel/panel-common.yaml#
  - if:
      properties:
        compatible:
          contains:
            const: zsx,zsx154-b1206

    then:
      required:
        - dc-gpios
        - reset-gpios

additionalProperties: false

examples:
  - |
    #include <dt-bindings/gpio/gpio.h>

    spi {
            #address-cells = <1>;
            #size-cells = <0>;

            display@0 {
                    compatible = "zsx,zsx154-b1206";
                    reg = <0>;
                    spi-max-frequency = <30000000>;
                    dc-gpios = <&pio 7 4 GPIO_ACTIVE_HIGH>;
                    reset-gpios = <&r_pio 2 21 GPIO_ACTIVE_HIGH>;
            };
    };

...
```
