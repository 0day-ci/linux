## Documentation/devicetree/bindings/display/mediatek/mediatek,dpintf.yaml
```yaml
# SPDX-License-Identifier: (GPL-2.0-only OR BSD-2-Clause)
%YAML 1.2
---
$id: http://devicetree.org/schemas/display/mediatek/mediatek,dpintf.yaml#
$schema: http://devicetree.org/meta-schemas/core.yaml#

title: Mediatek DP_INTF Controller Device Tree Bindings

maintainers:
  - CK Hu <ck.hu@mediatek.com>
  - Jitao shi <jitao.shi@mediatek.com>

description: |
  The Mediatek DP_INTF function block is a sink of the display subsystem
  connected to the display port controller.

properties:
  compatible:
    enum:
      - mediatek,mt8195-dpintf

  reg:
    maxItems: 1

  interrupts:
    maxItems: 1

  clocks:
    items:
      - description: hf_fmm Clock
      - description: hf_fdp Clock
      - description: Pixel Clock
      - description: DP_INTF PLL

  clock-names:
    items:
      - const: hf_fmm
      - const: hf_fdp
      - const: pixel
      - const: pll

  port:
    $ref: /schemas/graph.yaml#/properties/port
    description:
      Output port node. This port should be connected to the input port of an
      attached display port controller.

required:
  - compatible
  - reg
  - interrupts
  - clocks
  - clock-names
  - port

additionalProperties: false

examples:
  - |
    #include <dt-bindings/interrupt-controller/arm-gic.h>
    #include <dt-bindings/interrupt-controller/irq.h>
    #include <dt-bindings/clock/mt8195-clk.h>

	dp_intf1: dp_intf1@1c113000 {
		compatible = "mediatek,mt8195-dpintf";
		reg = <0 0x1c113000 0 0x1000>;
		interrupts = <GIC_SPI 513 IRQ_TYPE_LEVEL_HIGH 0>;
		clocks = <&vdosys1 CLK_VDO1_DP_INTF0_MM>,
			 <&vdosys1 CLK_VDO1_DPINTF>,
			 <&topckgen CLK_TOP_DP_SEL>,
			 <&topckgen CLK_TOP_TVDPLL2>;
		clock-names = "hf_fmm",
			      "hf_fdp",
			      "pixel",
			      "pll";
	};

...
```

## Documentation/devicetree/bindings/display/mediatek/mediatek,dsc.yaml
```yaml
# SPDX-License-Identifier: (GPL-2.0-only OR BSD-2-Clause)
%YAML 1.2
---
$id: http://devicetree.org/schemas/display/mediatek/mediatek,dsc.yaml#
$schema: http://devicetree.org/meta-schemas/core.yaml#

title: mediatek DSC Controller Device Tree Bindings

maintainers:
  - CK Hu <ck.hu@mediatek.com>
  - Jitao shi <jitao.shi@mediatek.com>
  - Jason-JH Lin <jason-jh.lin@mediatek.com>

description: |
  The DSC standard is a specification of the algorithms used for
  compressing and decompressing image display streams, including
  the specification of the syntax and semantics of the compressed
  video bit stream. DSC is designed for real-time systems with
  real-time compression, transmission, decompression and Display.

properties:
  compatible:
    oneOf:
      - items:
          - const: mediatek,mt8195-disp-dsc

  reg:
    maxItems: 1

  interrupts:
    maxItems: 1

  clocks:
    items:
      - description: DSC Wrapper Clock

  power-domains:
    description: A phandle and PM domain specifier as defined by bindings of
      the power controller specified by phandle. See
      Documentation/devicetree/bindings/power/power-domain.yaml for details.

  mediatek,gce-client-reg:
    description: The register of display function block to be set by gce.
      There are 4 arguments in this property, such as gce node, subsys id, offset
      and register size. The subsys id that is mapping to the register of display
      function blocks is defined in the gce header
      include/include/dt-bindings/gce/<chip>-gce.h of each chips.
      For example, The mediatek,gce-client-reg property of OVL in mt8173 is
      <&gce SUBSYS_1400XXXX 0xc000 0x1000>.
    $ref: /schemas/types.yaml#/definitions/phandle-array
    maxItems: 1

required:
  - compatible
  - reg
  - interrupts
  - clocks

additionalProperties: false

examples:
  - |
    dsc0: disp_dsc_wrap@1c009000 {
        compatible = "mediatek,mt8195-disp-dsc";
        reg = <0 0x1c009000 0 0x1000>;
        interrupts = <GIC_SPI 645 IRQ_TYPE_LEVEL_HIGH 0>;
        power-domains = <&spm MT8195_POWER_DOMAIN_VDOSYS0>;
        clocks = <&vdosys0 CLK_VDO0_DSC_WRAP0>;
        mediatek,gce-client-reg =
             <&gce1 SUBSYS_1c00XXXX 0x9000 0x1000>;
    };

...
```

## Documentation/devicetree/bindings/display/mediatek/mediatek,mt8195-hdmi.yaml
```yaml
# SPDX-License-Identifier: (GPL-2.0-only OR BSD-2-Clause)
%YAML 1.2
---
$id: http://devicetree.org/schemas/display/mediatek/mediatek,mt8195-hdmi.yaml#
$schema: http://devicetree.org/meta-schemas/core.yaml#

title: Mediatek HDMI Encoder Device Tree Bindings for mt8195

maintainers:
  - CK Hu <ck.hu@mediatek.com>
  - Jitao shi <jitao.shi@mediatek.com>

description: |
  The Mediatek HDMI encoder can generate HDMI 1.4a or MHL 2.0 signals from
  its parallel input.

properties:
  compatible:
    enum:
      - mediatek,mt8195-hdmi

  reg:
    maxItems: 1

  interrupts:
    maxItems: 1

  clocks:
    items:
      - description: PLL divider
      - description: PLL divider
      - description: HDCP engine clock
      - description: PLL divider
      - description: HDCP engine clock
      - description: Bus clock
      - description: HDMI clock for vpp_split module

  clock-names:
    items:
      - const: univpll_d6_d4
      - const: msdcpll_d2
      - const: hdmi_apb_sel
      - const: univpll_d4_d8
      - const: hdcp_sel
      - const: hdcp24_sel
      - const: split_hdmi

  phys:
    maxItems: 1

  phy-names:
    items:
      - const: hdmi

required:
  - compatible
  - reg
  - interrupts
  - clocks
  - clock-names
  - phys
  - phy-names

additionalProperties: false

examples:
  - |
    #include <dt-bindings/clock/mt8195-clk.h>
    #include <dt-bindings/interrupt-controller/arm-gic.h>
    #include <dt-bindings/interrupt-controller/irq.h>
    hdmi0: hdmi@1c300000 {
      compatible = "mediatek,mt8195-hdmi";
      reg = <0 0x1c300000 0 0x1000>;
      power-domains = <&spm MT8195_POWER_DOMAIN_HDMI_TX>;
      clocks = <&topckgen CLK_TOP_UNIVPLL_D6_D4>,
             <&topckgen CLK_TOP_MSDCPLL_D2>,
             <&topckgen CLK_TOP_HDMI_APB>,
             <&topckgen CLK_TOP_UNIVPLL_D4_D8>,
             <&topckgen CLK_TOP_HDCP>,
             <&topckgen CLK_TOP_HDCP_24M>,
             <&vppsys1 CLK_VPP1_VPP_SPLIT_HDMI>;
      clock-names = "univpll_d6_d4",
        "msdcpll_d2",
        "hdmi_apb_sel",
        "univpll_d4_d8",
        "hdcp_sel",
        "hdcp24_sel",
        "split_hdmi";
      interrupts = <GIC_SPI 677 IRQ_TYPE_LEVEL_HIGH 0>;
      pinctrl-names = "default";
      pinctrl-0 = <&hdmi_pin>;
      phys = <&hdmi_phy>;
      phy-names = "hdmi";
      cec = <&cec>;
      ddc-i2c-bus = <&hdmiddc0>;
      status = "disabled";
    };

...
```

## Documentation/devicetree/bindings/display/msm/dsi-phy-7nm.yaml
```yaml
# SPDX-License-Identifier: GPL-2.0-only or BSD-2-Clause
%YAML 1.2
---
$id: http://devicetree.org/schemas/display/msm/dsi-phy-7nm.yaml#
$schema: http://devicetree.org/meta-schemas/core.yaml#

title: Qualcomm Display DSI 7nm PHY

maintainers:
  - Rajeev Nandan <rajeevny@codeaurora.org>

allOf:
  - $ref: dsi-phy-common.yaml#

properties:
  compatible:
    oneOf:
      - const: qcom,dsi-phy-7nm
      - const: qcom,dsi-phy-7nm-7280
      - const: qcom,dsi-phy-7nm-8150

  reg:
    items:
      - description: dsi phy register set
      - description: dsi phy lane register set
      - description: dsi pll register set

  reg-names:
    items:
      - const: dsi_phy
      - const: dsi_phy_lane
      - const: dsi_pll

  vdds-supply:
    description: Phandle to 0.9V power supply regulator device node.

required:
  - compatible
  - reg
  - reg-names
  - vdds-supply

unevaluatedProperties: false

examples:
  - |
     #include <dt-bindings/clock/qcom,dispcc-sc7280.h>
     #include <dt-bindings/clock/qcom,rpmh.h>

     dsi-phy@ae94400 {
         compatible = "qcom,dsi-phy-7nm-7280";
         reg = <0x0ae94400 0x200>,
               <0x0ae94600 0x280>,
               <0x0ae94900 0x280>;
         reg-names = "dsi_phy",
                     "dsi_phy_lane",
                     "dsi_pll";

         #clock-cells = <1>;
         #phy-cells = <0>;

         clocks = <&dispcc DISP_CC_MDSS_AHB_CLK>,
                  <&rpmhcc RPMH_CXO_CLK>;
         clock-names = "iface", "ref";

         vdds-supply = <&vreg_l10c_0p8>;
     };
...
```

## Documentation/devicetree/bindings/display/msm/qcom,hdmi.yaml
```yaml
# SPDX-License-Identifier: (GPL-2.0-only OR BSD-2-Clause)
%YAML 1.2
---

$id: "http://devicetree.org/schemas/display/msm/qcom,hdmi.yaml#"
$schema: "http://devicetree.org/meta-schemas/core.yaml#"

title: Qualcomm Adreno/Snapdragon HDMI output

maintainers:
  - Rob Clark <robdclark@gmail.com>

allOf:
  - if:
      properties:
        compatible:
          contains:
            const: qcom,hdmi-tx-8996
    then:
      properties:
        clocks:
          minItems: 5
          maxItems: 5

        clock-names:
          items:
            - const: mdp_core
            - const: iface
            - const: core
            - const: alt_iface
            - const: extp
    else:
      properties:
        clocks:
          minItems: 1
          maxItems: 5

        clock-names:
          minItems: 1
          maxItems: 5


properties:
  compatible:
    enum:
      - qcom,hdmi-tx-8996
      - qcom,hdmi-tx-8994
      - qcom,hdmi-tx-8084
      - qcom,hdmi-tx-8974
      - qcom,hdmi-tx-8660
      - qcom,hdmi-tx-8960

  clocks: true

  clock-names: true

  reg:
    minItems: 1
    maxItems: 3
    description: Physical base address and length of the controller's registers

  reg-names:
    minItems: 1
    items:
      - const: core_physical
      - const: qfprom_physical
      - const: hdcp_physical

  interrupts:
    maxItems: 1
    description: The interrupt signal from the hdmi block.

  power-domains:
    description: should be <&mmcc MDSS_GDSC>

  core-vdda-supply: true

  core-vcc-supply: true

  hdmi-mux-supply:
    description: phandle to mux regulator

  phys:
    description: the phandle for the HDMI PHY device

  phy-names:
    description: the name of the corresponding PHY device

  hpd-gpios:
    maxItems: 1
    description: hpd pin

  qcom,hdmi-tx-ddc-clk-gpios:
    maxItems: 1
    description: HDMI DDC clock

  qcom,hdmi-tx-ddc-data-gpios:
    maxItems: 1
    description: HDMI DDC data

  qcom,hdmi-tx-mux-en-gpios:
    maxItems: 1
    description: HDMI mux enable pin

  qcom,hdmi-tx-mux-sel-gpios:
    maxItems: 1
    description: HDMI mux select pin

  qcom,hdmi-tx-mux-lpm-gpios:
    maxItems: 1
    description: HDMI mux lpm pin

  pinctrl-0: true
  pinctrl-1: true

  pinctrl-names:
    minItems: 1
    items:
      - const: default
      - const: sleep

  '#phy-cells':
    const: 0

  '#sound-dai-cells':
    const: 1

  ports:
    type: object
    $ref: /schemas/graph.yaml#/properties/ports
    properties:
      port@0:
        $ref: /schemas/graph.yaml#/$defs/port-base
        unevaluatedProperties: false
        description: |
          Input endpoints of the controller.
        properties:
          endpoint:
            $ref: /schemas/media/video-interfaces.yaml#
            unevaluatedProperties: false
            properties:
              data-lanes:
                maxItems: 4
                minItems: 4
                items:
                  enum: [0, 1, 2, 3]

      port@1:
        $ref: /schemas/graph.yaml#/$defs/port-base
        unevaluatedProperties: false
        description: |
          Output endpoints of the controller.
        properties:
          endpoint:
            $ref: /schemas/media/video-interfaces.yaml#
            unevaluatedProperties: false
            properties:
              data-lanes:
                maxItems: 4
                minItems: 4
                items:
                  enum: [0, 1, 2, 3]

    required:
      - port@0

required:
  - compatible
  - clocks
  - clock-names
  - reg
  - reg-names
  - interrupts
  - phys
  - phy-names

additionalProperties: false

examples:
  - |
    hdmi: hdmi@4a00000 {
      compatible = "qcom,hdmi-tx-8960";
      reg-names = "core_physical";
      reg = <0x04a00000 0x2f0>;
      interrupts = <0 79 0>;
      power-domains = <&mmcc 1>;
      clock-names =
          "core",
          "master_iface",
          "slave_iface";
      clocks =
          <&clk 61>,
          <&clk 72>,
          <&clk 98>;
      qcom,hdmi-tx-ddc-clk-gpios = <&msmgpio 70 0>;
      qcom,hdmi-tx-ddc-data-gpios = <&msmgpio 71 0>;
      hpd-gpios = <&msmgpio 72 0>;
      core-vdda-supply = <&pm8921_hdmi_mvs>;
      hdmi-mux-supply = <&ext_3p3v>;
      pinctrl-names = "default", "sleep";
      pinctrl-0 = <&hpd_active  &ddc_active  &cec_active>;
      pinctrl-1 = <&hpd_suspend &ddc_suspend &cec_suspend>;

      phys = <&hdmi_phy>;
      phy-names = "hdmi_phy";
    };
```

## Documentation/devicetree/bindings/display/panel/innolux,himax8279d.yaml
```yaml
# SPDX-License-Identifier: (GPL-2.0-only OR BSD-2-Clause)
%YAML 1.2
---
$id: http://devicetree.org/schemas/display/panel/innolux,himax8279d.yaml#
$schema: http://devicetree.org/meta-schemas/core.yaml#

title: INNOLUX HIMAX8279D DSI Display Panel

maintainers:
  - xiazhengqiao <xiazhengqiao@huaqin.corp-partner.google.com>

allOf:
  - $ref: panel-common.yaml#

properties:
  compatible:
    enum:
        # STARRY 2081101QFH032011-53G 10.1" WUXGA TFT LCD panel
      - starry,2081101qfh032011-53g

  reg:
    description: the virtual channel number of a DSI peripheral

  enable-gpios:
    description: a GPIO spec for the enable pin

  pp1800-supply:
    description: core voltage supply

  avdd-supply:
    description: phandle of the regulator that provides positive voltage

  avee-supply:
    description: phandle of the regulator that provides negative voltage

  backlight:
    description: phandle of the backlight device attached to the panel

  port: true

required:
  - compatible
  - reg
  - enable-gpios
  - pp1800-supply
  - avdd-supply
  - avee-supply

additionalProperties: false

examples:
  - |
    dsi {
        #address-cells = <1>;
        #size-cells = <0>;
        panel@0 {
            compatible = "starry,2081101qfh032011-53g";
            reg = <0>;
            enable-gpios = <&pio 45 0>;
            avdd-supply = <&ppvarn_lcd>;
            avee-supply = <&ppvarp_lcd>;
            pp1800-supply = <&pp1800_lcd>;
            backlight = <&backlight_lcd0>;
            port {
                panel_in: endpoint {
                    remote-endpoint = <&dsi_out>;
                };
            };
        };
    };

...
```

## Documentation/devicetree/bindings/display/panel/lgphilips,sw43101.yaml
```yaml
# SPDX-License-Identifier: (GPL-2.0-only OR BSD-2-Clause)
%YAML 1.2
---
$id: http://devicetree.org/schemas/display/panel/lgphilips,sw43101.yaml#
$schema: http://devicetree.org/meta-schemas/core.yaml#

title: LG.Philips SW43101 1080x1920 OLED panel

maintainers:
  - Yassine Oudjana <y.oudjana@protonmail.com>

allOf:
  - $ref: panel-common.yaml#

properties:
  compatible:
    const: lgphilips,sw43101

  reg: true
  reset-gpios: true

  vdd-supply:
    description: Digital power supply

  avdd-supply:
    description: Analog power supply

  elvdd-supply:
    description: Positive electroluminescence power supply

  elvss-supply:
    description: Negative electroluminescence power supply

  port: true

required:
  - compatible
  - reg
  - reset-gpios
  - vdd-supply
  - avdd-supply
  - elvdd-supply
  - elvss-supply
  - port

additionalProperties: false

examples:
  - |
    #include <dt-bindings/gpio/gpio.h>

    dsi {
        #address-cells = <1>;
        #size-cells = <0>;

        panel@0 {
            compatible = "lgphilips,sw43101";
            reg = <0>;

            reset-gpios = <&msmgpio 8 GPIO_ACTIVE_LOW>;

            vdd-supply = <&vreg_l14a_1p8>;
            avdd-supply = <&vlin1_7v3>;
            elvdd-supply = <&elvdd>;
            elvss-supply = <&elvss>;

            port {
                panel_in: endpoint {
                    remote-endpoint = <&dsi_out>;
                };
            };
        };
    };

...
```
