## Documentation/devicetree/bindings/display/dp-aux-bus.yaml
```yaml
# SPDX-License-Identifier: (GPL-2.0-only OR BSD-2-Clause)
%YAML 1.2
---
$id: http://devicetree.org/schemas/display/dp-aux-bus.yaml#
$schema: http://devicetree.org/meta-schemas/core.yaml#

title: DisplayPort AUX bus

maintainers:
  - Douglas Anderson <dianders@chromium.org>

description:
  DisplayPort controllers provide a control channel to the sinks that
  are hooked up to them. This is the DP AUX bus. Over the DP AUX bus
  we can query properties about a sink and also configure it. In
  particular, DP sinks support DDC over DP AUX which allows tunneling
  a standard I2C DDC connection over the AUX channel.

  To model this relationship, DP sinks should be placed as children
  of the DP controller under the "aux-bus" node.

  At the moment, this binding only handles the eDP case. It is
  possible it will be extended in the future to handle the DP case.
  For DP, presumably a connector would be listed under the DP AUX
  bus instead of a panel.

properties:
  $nodename:
    const: "aux-bus"

  panel:
    $ref: panel/panel-common.yaml#

additionalProperties: false

required:
  - panel

examples:
  - |
    #include <dt-bindings/clock/qcom,rpmh.h>
    #include <dt-bindings/gpio/gpio.h>
    #include <dt-bindings/interrupt-controller/irq.h>

    i2c {
      #address-cells = <1>;
      #size-cells = <0>;

      bridge@2d {
        compatible = "ti,sn65dsi86";
        reg = <0x2d>;

        interrupt-parent = <&tlmm>;
        interrupts = <10 IRQ_TYPE_LEVEL_HIGH>;

        enable-gpios = <&tlmm 102 GPIO_ACTIVE_HIGH>;

        vpll-supply = <&src_pp1800_s4a>;
        vccio-supply = <&src_pp1800_s4a>;
        vcca-supply = <&src_pp1200_l2a>;
        vcc-supply = <&src_pp1200_l2a>;

        clocks = <&rpmhcc RPMH_LN_BB_CLK2>;
        clock-names = "refclk";

        no-hpd;

        ports {
          #address-cells = <1>;
          #size-cells = <0>;

          port@0 {
            reg = <0>;
            endpoint {
              remote-endpoint = <&dsi0_out>;
            };
          };

          port@1 {
            reg = <1>;
            sn65dsi86_out: endpoint {
              remote-endpoint = <&panel_in_edp>;
            };
          };
        };

        aux-bus {
          panel {
            compatible = "boe,nv133fhm-n62";
            power-supply = <&pp3300_dx_edp>;
            backlight = <&backlight>;
            hpd-gpios = <&sn65dsi86_bridge 2 GPIO_ACTIVE_HIGH>;

            port {
              panel_in_edp: endpoint {
                remote-endpoint = <&sn65dsi86_out>;
              };
            };
          };
        };
      };
    };
```

## Documentation/devicetree/bindings/display/faraday,tve200.yaml
```yaml
# SPDX-License-Identifier: (GPL-2.0-only OR BSD-2-Clause)
%YAML 1.2
---
$id: http://devicetree.org/schemas/display/faraday,tve200.yaml#
$schema: http://devicetree.org/meta-schemas/core.yaml#

title: Faraday TV Encoder TVE200

maintainers:
  - Linus Walleij <linus.walleij@linaro.org>

properties:
  compatible:
    oneOf:
      - const: faraday,tve200
      - items:
          - const: cortina,gemini-tvc
          - const: faraday,tve200

  reg:
    minItems: 1

  interrupts:
    minItems: 1

  clock-names:
    items:
      - const: PCLK
      - const: TVE

  clocks:
    minItems: 2

  resets:
    minItems: 1

  "#address-cells":
    const: 1

  "#size-cells":
    const: 0

patternProperties:
  "^port@[0-9]+$":
    type: object
    description: describes LCD panel signals, following the common binding
      for video transmitter interfaces; see
      Documentation/devicetree/bindings/media/video-interfaces.txt
      It should have one endpoint connected to a remote endpoint where
      the display is connected.

    properties:
      reg:
        const: 0

    required:
      - reg

required:
  - compatible
  - reg
  - interrupts
  - clock-names
  - clocks
  - "#address-cells"
  - "#size-cells"

additionalProperties: false

examples:
  - |
    #include <dt-bindings/clock/cortina,gemini-clock.h>
    #include <dt-bindings/interrupt-controller/irq.h>
    #include <dt-bindings/reset/cortina,gemini-reset.h>
    display-controller@6a000000 {
      #address-cells = <1>;
      #size-cells = <0>;
      compatible = "faraday,tve200";
      reg = <0x6a000000 0x1000>;
      interrupts = <13 IRQ_TYPE_EDGE_RISING>;
      resets = <&syscon GEMINI_RESET_TVC>;
      clocks = <&syscon GEMINI_CLK_GATE_TVC>,
               <&syscon GEMINI_CLK_TVC>;
      clock-names = "PCLK", "TVE";

      port@0 {
        reg = <0>;
        display_out: endpoint {
          remote-endpoint = <&panel_in>;
        };
      };
    };
```

## Documentation/devicetree/bindings/display/hpe,gxp-thumbnail.txt
```
* GXP HPE VIDEO THUMBNAIL DRIVER

Required properties:
- compatible: Must be "hpe,gxp-thumbnail".
- reg       : Physical base address and length of the controller's registers.
- clocks    : phandle + clock specifier pair of the FB reference clock.
- bits-per-pixel: Bits per pixel, must be 32.
- width: Width in pixels, must be 800.
- height: Height in pixels, must be 600.

Optional properties:
- lcd-supply: Regulator for LCD supply voltage.

Example:
	thumbnail: thumbnail@c0000500 {
		compatible = "hpe,gxp-thumbnail";
		reg = <0xc0000500 0x20>;
		bits-per-pixel = <32>;
		width = <800>;
		height = <600>;
	};
```

## Documentation/devicetree/bindings/display/imx/fsl,imx21-lcdc.yaml
```yaml
# SPDX-License-Identifier: (GPL-2.0-only OR BSD-2-Clause)
%YAML 1.2
---
$id: http://devicetree.org/schemas/display/imx/fsl,imx21-lcdc.yaml#
$schema: http://devicetree.org/meta-schemas/core.yaml#

title: i.MX21 LCD Controller

maintainers:
  - Philipp Zabel <p.zabel@pengutronix.de>

properties:
  compatible:
    oneOf:
      - const: fsl,imx21-lcdc
      - items:
          - enum:
              - fsl,imx25-lcdc
              - fsl,imx27-lcdc
          - const: fsl,imx21-lcdc

  reg:
    maxItems: 1

  clocks:
    maxItems: 3

  clock-names:
    items:
      - const: ipg
      - const: per
      - const: ahb

  resets:
    maxItems: 1

  port:
    type: object
    description:
      "Video port for DPI RGB output."

required:
  - compatible
  - reg
  - interrupts
  - clocks
  - clock-names
  - port

additionalProperties: false

examples:
  - |
    lcdc: lcdc@53fbc000 {
        compatible = "fsl,imx25-lcdc", "fsl,imx21-lcdc";
        reg = <0x53fbc000 0x4000>;
        interrupts = <39>;
        clocks = <&clks 103>, <&clks 66>, <&clks 49>;
        clock-names = "ipg", "ahb", "per";

        port {
             parallel_out: endpoint {
                 remote-endpoint = <&panel_in>;
             };
        };

    };

    panel: panel {
        compatible = "edt,etm0700g0dh6";
        power-supply = <&lcd_supply>;
        backlight = <&bl>;

        port {
                panel_in: endpoint {
                        remote-endpoint = <&parallel_out>;
                };
        };
    };
```

## Documentation/devicetree/bindings/display/imx/fsl,imx8qxp-dprc.yaml
```yaml
# SPDX-License-Identifier: (GPL-2.0-only OR BSD-2-Clause)
%YAML 1.2
---
$id: http://devicetree.org/schemas/display/imx/fsl,imx8qxp-dprc.yaml#
$schema: http://devicetree.org/meta-schemas/core.yaml#

title: Freescale i.MX8qm/qxp Display Prefetch Resolve Channel

maintainers:
  - Liu Ying <victor.liu@nxp.com>

description: |
  The i.MX8qm/qxp Display Prefetch Resolve Channel(DPRC) is an engine which
  fetches display data before the display pipeline needs the data to drive
  pixels in the active display region.  This data is transformed, or resolved,
  from a variety of tiled buffer formats into linear format, if needed.
  The DPR works with a double bank memory structure.  This memory structure is
  implemented in the Resolve Tile Memory(RTRAM) and the banks are referred to
  as A and B.  Each bank is either 4 or 8 lines high depending on the source
  frame buffer format.

properties:
  compatible:
    enum:
      - fsl,imx8qxp-dpr-channel
      - fsl,imx8qm-dpr-channel

  reg:
    maxItems: 1

  interrupts:
    maxItems: 1

  clocks:
    items:
      - description: apb clock
      - description: b clock
      - description: rtram clock

  clock-names:
    items:
      - const: apb
      - const: b
      - const: rtram

  fsl,sc-resource:
    $ref: /schemas/types.yaml#/definitions/uint32
    description: The SCU resource ID associated with this DPRC instance.

  fsl,prgs:
    $ref: /schemas/types.yaml#/definitions/phandle-array
    description: |
      List of phandle which points to Prefetch Resolve Gaskets(PRGs)
      associated with this DPRC instance.

  power-domains:
    maxItems: 1

required:
  - compatible
  - reg
  - interrupts
  - clocks
  - clock-names
  - fsl,sc-resource
  - fsl,prgs
  - power-domains

additionalProperties: false

examples:
  - |
    #include <dt-bindings/clock/imx8-lpcg.h>
    #include <dt-bindings/firmware/imx/rsrc.h>
    #include <dt-bindings/interrupt-controller/arm-gic.h>
    dpr-channel@56100000 {
        compatible = "fsl,imx8qxp-dpr-channel";
        reg = <0x56100000 0x10000>;
        interrupts = <GIC_SPI 51 IRQ_TYPE_LEVEL_HIGH>;
        clocks = <&dc0_dpr1_lpcg IMX_LPCG_CLK_4>,
                 <&dc0_dpr1_lpcg IMX_LPCG_CLK_5>,
                 <&dc0_rtram1_lpcg IMX_LPCG_CLK_0>;
        clock-names = "apb", "b", "rtram";
        fsl,sc-resource = <IMX_SC_R_DC_0_VIDEO0>;
        fsl,prgs = <&dc0_prg4>, <&dc0_prg5>;
        power-domains = <&pd IMX_SC_R_DC_0>;
    };
```
