## Documentation/devicetree/bindings/serial/sunplus,sp7021-uart.yaml
```yaml
# SPDX-License-Identifier: (GPL-2.0-only OR BSD-2-Clause)
# Copyright (C) Sunplus Co., Ltd. 2021
%YAML 1.2
---
$id: "http://devicetree.org/schemas/serial/sunplus,sp7021-uart.yaml#"
$schema: "http://devicetree.org/meta-schemas/core.yaml#"

title: Sunplus SoC SP7021 UART Controller Device Tree Bindings

maintainers:
  - Tony Huang <tony.huang@sunplus.com>
  - Hammer Hsieh <hammer.hsieh@sunplus.com>
  - Wells Lu <wells.lu@sunplus.com>

allOf:
  - $ref: serial.yaml#

properties:
  compatible:
    const: sunplus,sp7021-uart

  reg:
    minItems: 1
    maxItems: 2

  interrupts:
    maxItems: 1

  clocks:
    minItems: 1
    maxItems: 2

  clock-names:
    oneOf:
      - items:
          - const: UADMA
          - pattern: '^PERI[0-1]$'
      - items:
          - const: HWUA
          - pattern: '^PERI[0-1]$'

  resets:
    maxItems: 1

  which-uart:
    description:
      UA1-4 support DMA mode, UA0 support PIO mode only.
    $ref: /schemas/types.yaml#/definitions/uint32
    enum: [ 1, 2, 3, 4]

required:
  - compatible
  - reg
  - clocks
  - resets

if:
  properties:
    compatible:
      contains:
        enum:
          - sunplus,sp7021-uart-rxdma
          - sunplus,sp7021-uart-txdma
then:
  required:
    - clock-names
    - which-uart

additionalProperties: false

examples:
  - |
    #include <dt-bindings/interrupt-controller/irq.h>
    aliases {
            serial0 = &uart0;
            serial1 = &uart1;
            serial2 = &uart2;
            serial10 = &uartdmarx0;
            serial20 = &uartdmatx0;
            serial11 = &uartdmarx1;
            serial21 = &uartdmatx1;
    };

    // UART0 PIO mode only
    uart0: serial@9c000900 {
        compatible = "sunplus,sp7021-uart";
        reg = <0x9c000900 0x80>;
        interrupt-parent = <&intc>;
        interrupts = <53 IRQ_TYPE_LEVEL_HIGH>;
        clocks = <&clkc 0x28>;
        resets = <&rstc 0x18>;
    };

    // UART1 PIO mode
    uart1: serial@9c000980 {
        compatible = "sunplus,sp7021-uart";
        reg = <0x9c000980 0x80>;
        interrupt-parent = <&intc>;
        interrupts = <54 IRQ_TYPE_LEVEL_HIGH>;
        clocks = <&clkc 0x29>;
        resets = <&rstc 0x19>;
    };

    // UART1 DMA mode for RX
    uartdmarx0: serial@9c008980 {
        compatible = "sunplus,sp7021-uart-rxdma";
        reg = <0x9c008980 0x40>;
        interrupt-parent = <&intc>;
        interrupts = <138 IRQ_TYPE_LEVEL_HIGH>;
        clocks = <&clkc 0x2f>, <&clkc 0x1b>;
        clock-names = "UADMA", "PERI0";
        resets = <&rstc 0x1f>;
        which-uart = <1>;
    };

    // UART1 DMA mode for TX
    uartdmatx0: serial@9c008a00 {
        compatible = "sunplus,sp7021-uart-txdma";
        reg = <0x9c008a00 0x40>, <0x9c008880 0x80>;
        clocks = <&clkc 0x2d>, <&clkc 0x1b>;
        clock-names = "HWUA", "PERI0";
        resets = <&rstc 0x1d>;
        which-uart = <1>;
    };

    // UART2 PIO mode
    uart2: serial@9c000800 {
        compatible = "sunplus,sp7021-uart";
        reg = <0x9c000800 0x80>;
        interrupt-parent = <&intc>;
        interrupts = <55 IRQ_TYPE_LEVEL_HIGH>;
        clocks = <&clkc 0x2a>;
        resets = <&rstc 0x1a>;
    };

    // UART2 DMA mode for RX
    uartdmarx1: serial@9c0089c0 {
        compatible = "sunplus,sp7021-uart-rxdma";
        reg = <0x9c0089c0 0x40>;
        interrupt-parent = <&intc>;
        interrupts = <139 IRQ_TYPE_LEVEL_HIGH>;
        clocks = <&clkc 0x2f>,	<&clkc 0x1f>;
        clock-names = "UADMA", "PERI1";
        resets = <&rstc 0x1f>;
        which-uart = <2>;
    };

    // UART2 DMA mode for TX
    uartdmatx1: serial@9c008a40 {
        compatible = "sunplus,sp7021-uart-txdma";
        reg = <0x9c008a40 0x40>, <0x9c008900 0x80>;
        clocks = <&clkc 0x2d>, <&clkc 0x1f>;
        clock-names = "HWUA", "PERI1";
        resets = <&rstc 0x1d>;
        which-uart = <2>;
    };
...
```

## Documentation/devicetree/bindings/serial/sunplus,uart.yaml
```yaml
# SPDX-License-Identifier: (GPL-2.0-only OR BSD-2-Clause)
# Copyright (C) Sunplus Co., Ltd. 2021
%YAML 1.2
---
$id: "http://devicetree.org/schemas/serial/sunplus,uart.yaml#"
$schema: "http://devicetree.org/meta-schemas/core.yaml#"

title: Sunplus SoC UART Controller Device Tree Bindings

maintainers:
  - Tony Huang <tony.huang@sunplus.com>
  - Hammer Hsieh <hammer.hsieh@sunplus.com>
  - Wells Lu <wells.lu@sunplus.com>

allOf:
  - $ref: serial.yaml#

properties:
  compatible:
    const: sunplus,sp7021-uart

  reg:
    minItems: 1
    maxItems: 2

  interrupts:
    maxItems: 1

  clocks:
    minItems: 1
    maxItems: 2

  clock-names:
    oneOf:
      - items:
        - const: UADMA
        - const: PERI0
      - items:
        - const: UADMA
        - const: PERI1
      - items:
        - const: HWUA
        - const: PERI0
      - items:
        - const: HWUA
        - const: PERI1

  resets:
    maxItems: 1

  which-uart:
    $ref: /schemas/types.yaml#/definitions/uint32
    enum: [ 1, 2, 3, 4]

required:
  - compatible
  - reg
  - clocks
  - resets

additionalProperties: false

examples:
  - |
    #include <dt-bindings/interrupt-controller/irq.h>
    #include <dt-bindings/clock/sp-sp7021.h>
    #include <dt-bindings/reset/sp-sp7021.h>
    aliases {
            serial0 = &uart0;
            serial1 = &uart1;
            serial10 = &uartdmarx0;
            serial20 = &uartdmatx0;
    };

    uart0: serial@9c000900 {
      compatible = "sunplus,sp7021-uart";
      reg = <0x9c000900 0x80>;
      interrupt-parent = <&intc>;
      interrupts = <53 IRQ_TYPE_LEVEL_HIGH>;
      clocks = <&clkc UA0>;
      resets = <&rstc RST_UA0>;
    };

    // UART1 PIO mode
    uart1: serial@9c000980 {
        compatible = "sunplus,sp7021-uart";
        reg = <0x9c000980 0x80>;
        interrupt-parent = <&intc>;
        interrupts = <54 IRQ_TYPE_LEVEL_HIGH>;
        clocks = <&clkc UA1>;
        resets = <&rstc RST_UA1>;
    };

    // UART1 DMA mode for RX
    uartdmarx0: serial@9c008980 {
        compatible = "sunplus,sp7021-uart";
        reg = <0x9c008980 0x40>;
        interrupt-parent = <&intc>;
        interrupts = <138 IRQ_TYPE_LEVEL_HIGH>;
        clocks = <&clkc UADMA>, <&clkc PERI0>;
        clock-names = "UADMA", "PERI0";
        resets = <&rstc RST_UADMA>;
        which-uart = <1>;
    };

    // UART1 DMA mode for TX
    uartdmatx0: serial@9c008a00 {
        compatible = "sunplus,sp7021-uart";
        reg = <0x9c008a00 0x40>, <0x9c008880 0x80>;
        clocks = <&clkc HWUA>, <&clkc PERI0>;
        clock-names = "HWUA", "PERI0";
        resets = <&rstc RST_HWUA>;
        which-uart = <1>;
    };

...
```

## Documentation/devicetree/bindings/soc/actions/owl-socinfo.yaml
```yaml
# SPDX-License-Identifier: (GPL-2.0-only OR BSD-2-Clause)
%YAML 1.2
---
$id: http://devicetree.org/schemas/soc/actions/owl-socinfo.yaml#
$schema: http://devicetree.org/meta-schemas/core.yaml#

title: Actions Semi Owl SoC info module

maintainers:
  - Cristian Ciocaltea <cristian.ciocaltea@gmail.com>

description: |
  Actions Semi Owl SoC info module provides access to various information
  about the S500, S700 and S900 SoC variants, such as serial number or id.

select:
  properties:
    compatible:
      contains:
        enum:
          - actions,s500-soc
          - actions,s700-soc
          - actions,s900-soc
  required:
    - compatible

properties:
  compatible:
    items:
      - enum:
          - actions,s500-soc
          - actions,s700-soc
          - actions,s900-soc
      - const: simple-bus

required:
  - compatible

additionalProperties: true

examples:
  - |
    / {
        compatible = "roseapplepi,roseapplepi", "actions,s500";
        model = "Roseapple Pi";
        #address-cells = <1>;
        #size-cells = <1>;

        soc {
            compatible = "actions,s500-soc", "simple-bus";
            #address-cells = <1>;
            #size-cells = <1>;
            ranges;
        };
    };

...
```

## Documentation/devicetree/bindings/soc/aspeed/uart-routing.yaml
```yaml
# SPDX-License-Identifier: (GPL-2.0-only OR BSD-2-Clause)
# # Copyright (c) 2018 Google LLC
# # Copyright (c) 2021 Aspeed Technology Inc.
%YAML 1.2
---
$id: "http://devicetree.org/schemas/soc/aspeed/uart-routing.yaml#"
$schema: "http://devicetree.org/meta-schemas/core.yaml#"

title: Aspeed UART Routing Controller

maintainers:
  - Oskar Senft <osk@google.com>
  - Chia-Wei Wang <chiawei_wang@aspeedtech.com>

description:
  The Aspeed UART routing control allow to dynamically route the inputs for
  the built-in UARTS and physical serial I/O ports.

  This allows, for example, to connect the output of UART to another UART.
  This can be used to enable Host <-> BMC communication via UARTs, e.g. to
  allow access to the Host's serial console.

  This driver is for the BMC side. The sysfs files allow the BMC userspace
  which owns the system configuration policy, to configure how UARTs and
  physical serial I/O ports are routed.

  Two types of files, uart* and io*, are presented in sysfs. The uart*
  configures the input signal of a UART controller whereas io* configures
  that of a physical serial port.

  When read, each file shows the list of available options with currently
  selected option marked by brackets "[]". The list of available options
  depends on the selected file.

  e.g.
  cat /sys/bus/platform/drivers/aspeed-uart-routing/*.uart_routing/uart1
  [io1] io2 io3 io4 uart2 uart3 uart4 io6

  In this case, UART1 gets its input from IO1 (physical serial port 1).

properties:
  compatible:
    items:
      - enum:
          - aspeed,ast2400-uart-routing
          - aspeed,ast2500-uart-routing
          - aspeed,ast2600-uart-routing
  reg:
    maxItems: 1

required:
  - compatible

additionalProperties: false

examples:
  - |
    lpc: lpc@1e789000 {
        compatible = "aspeed,ast2600-lpc-v2", "simple-mfd", "syscon";
        reg = <0x1e789000 0x1000>;

        #address-cells = <1>;
        #size-cells = <1>;
        ranges = <0x0 0x1e789000 0x1000>;

        uart_routing: uart-routing@98 {
            compatible = "aspeed,ast2600-uart-routing";
            reg = <0x98 0x8>;
        };
    };
```

## Documentation/devicetree/bindings/soc/hpe/gxp.yaml
```yaml
# SPDX-License-Identifier: (GPL-2.0-only OR BSD-2-Clause)
%YAML 1.2
---
$id: http://devicetree.org/schemas/soc/hpe/gxp.yaml#
$schema: http://devicetree.org/meta-schemas/core.yaml#

title: HPE bmc GXP SoC driver

maintainers:
  - Nick Hawkins <nick.hawkins@hpe.com>
  - Jean-Marie Verdun <verdun@hpe.com>

properties:
  compatible:
    const: hpe,gxp

  "#address-cells":
    const: 1

  "#size-cells":
    const: 0

required:
  - compatible

additionalProperties: false

examples:
  - |
    gxp {
        model = "Hewlett Packard Enterprise GXP BMC";
        compatible = "hpe,gxp";
        #address-cells: 1;
        #size-cells: 0;
    };
```

## Documentation/devicetree/bindings/soc/hpe/hpe,gxp-chif.txt
```
* HPE GXP CHIF INTERFACE

Define the basic CHannel InterFace (CHIF) communication path between BMC and Host through PCI.
Interrupts are handled through PCI function 2

Required parent device properties:
- compatible : Should be "hpe,gxp-chif".
- interrupts : The interrupt number.

Example:

	chif {
			compatible = "hpe,gxp-chif";
			interrupts = <12>;
		};
	};
```

## Documentation/devicetree/bindings/soc/hpe/hpe,gxp-csm.txt
```
* HPE GXP PCI CSM INTERFACE

Required parent device properties:
- compatible : Should be "hpe,gxp-csm", "simple-mfd", "syscon".
- reg : Specifies base physical address and size of control registers.

Example:

	csm: csm@8000005c {
		compatible = "hpe,gxp-csm", "simple-mfd", "syscon";
		reg = <0x8000005c 0x2>, <0x800000de 0x1>, <0x800000e7 0x1>;
	};
```

## Documentation/devicetree/bindings/soc/hpe/hpe,gxp-dbg.txt
```
* HPE GXP DBG INTERFACE

Specify host debug interface. Used presently to report ROM POST code during host initialization phases

Required parent device properties:
- compatible : Should be "hpe,gxp-dbg".
- reg : Specifies base physical address and size of the control/data registers.
- interrupts: The interrupt number.
- interrupt-parent: The interrupt controller to which the interface is wired to

Example:

	post@800000a0 {
		compatible = "hpe,gxp-dbg";
		reg = <0x800000a0 0x20>;
		interrupts = <10>;
		interrupt-parent = <&vic1>;
	};
```

## Documentation/devicetree/bindings/soc/hpe/hpe,gxp-fn2.txt
```
* HPE GXP PCI FN2 INTERFACE CONTROLLER

Required parent device properties:
- compatible : Should be "hpe,gxp-fn2", "simple-mfd", "syscon".
- reg : Specifies base physical address and size of the control/data/memory mapped registers.
- xreg_handle : Phandle to the xregister controller interface.
- #gpio-cells : The number of cells to describe a GPIO, this should be 2.
- interrupts : interrupt number to which PCI FN2 is connected to
- interrupt-parets : interrupt controller to which PCI FN2 is connected to

Example:

	fn2: fn2@80200000 {
		compatible = "hpe,gxp-fn2", "simple-mfd", "syscon";
		reg = <0x80200000 0x100000>;
		xreg_handle = <&xreg>;
		interrupts = <0>;
		interrupt-parent = <&vic1>;
		#gpio-cells = <2>;
	};
```

## Documentation/devicetree/bindings/soc/hpe/hpe,gxp-xreg.txt
```
* HPE GXP XREG INTERFACE

Required parent device properties:
- compatible : Should be "hpe,gxp-fn2", "simple-mfd", "syscon".
- reg : Specifies base physical address and size of the control registers.
- interrupts: The interrupt number.
- interrupt-parent: main interrupt controller to which xreg is connected to
- #gpio-cells : The number of cells to describe a GPIO, this should be 2.

Example:

	xreg: xreg@d1000300 {
		compatible = "hpe,gxp-xreg", "simple-mfd", "syscon";
		reg = <0xd1000300 0xFF>;
		interrupts = <26>;
		interrupt-parent = <&vic0>;
		#gpio-cells = <2>;
	};
```

## Documentation/devicetree/bindings/soc/imx/fsl,anatop.yaml
```yaml
# SPDX-License-Identifier: (GPL-2.0-only OR BSD-2-Clause)
%YAML 1.2
---
$id: http://devicetree.org/schemas/soc/imx/fsl,anatop.yaml#
$schema: http://devicetree.org/meta-schemas/core.yaml#

title: Freescale Anatop binding

maintainers:
  - Dong Aisheng <aisheng.dong@nxp.com>

properties:
  compatible:
    oneOf:
      - items:
          - const: fsl,imx6q-anatop
          - const: syscon
          - const: simple-mfd
      - items:
          - enum:
              - fsl,imx6sl-anatop
              - fsl,imx6sll-anatop
              - fsl,imx6sx-anatop
              - fsl,imx6ul-anatop
              - fsl,imx7d-anatop
          - const: fsl,imx6q-anatop
          - const: syscon
          - const: simple-mfd
      - items:
          - enum:
              - fsl,imx8mq-anatop
              - fsl,imx8mm-anatop
              - fsl,vf610-anatop
          - const: syscon
      - items:
          - enum:
              - fsl,imx8mn-anatop
              - fsl,imx8mp-anatop
          - const: fsl,imx8mm-anatop
          - const: syscon

  reg:
    maxItems: 1

  interrupts:
    items:
      - description: Temperature Sensor
      - description: PMU interrupt 1
      - description: PMU interrupt 2
    minItems: 1
    maxItems: 3

required:
  - compatible
  - reg

additionalProperties: true

examples:
  - |
    #include <dt-bindings/interrupt-controller/irq.h>
    anatop: anatop@20c8000 {
        compatible = "fsl,imx6q-anatop", "syscon", "simple-mfd";
        reg = <0x020c8000 0x1000>;
        interrupts = <0 49 IRQ_TYPE_LEVEL_HIGH>,
                     <0 54 IRQ_TYPE_LEVEL_HIGH>,
                     <0 127 IRQ_TYPE_LEVEL_HIGH>;
        };
```
