## Documentation/devicetree/bindings/soc/imx/fsl,gpr.yaml
```yaml
# SPDX-License-Identifier: (GPL-2.0-only OR BSD-2-Clause)
%YAML 1.2
---
$id: http://devicetree.org/schemas/soc/imx/fsl,gpr.yaml#
$schema: http://devicetree.org/meta-schemas/core.yaml#

title: Freescale IOMUX GPR binding

maintainers:
  - Dong Aisheng <aisheng.dong@nxp.com>

description: |
  32-bit general purpose registers - several (GPR0 to GPRn) 32-bit
  registers according to SoC requirements for any usage.

  The General Purpose Registers IOMUXC_GPR are used to select operating
  modes for general features in the SoC, usually not related to the IOMUX
  itself.

properties:
  compatible:
    oneOf:
      - items:
          - const: fsl,imx53-iomuxc-gpr
          - const: syscon
      - items:
          - const: fsl,imx6q-iomuxc-gpr
          - const: syscon
          - const: simple-mfd
      - items:
          - enum:
              - fsl,imx6sl-iomuxc-gpr
              - fsl,imx6sll-iomuxc-gpr
              - fsl,imx6sx-iomuxc-gpr
              - fsl,imx6ul-iomuxc-gpr
              - fsl,imx7d-iomuxc-gpr
          - const: fsl,imx6q-iomuxc-gpr
          - const: syscon
      - items:
          - const: fsl,imx7d-iomuxc-gpr
          - const: fsl,imx6q-iomuxc-gpr
          - const: syscon
          - const: simple-mfd
      - items:
          - const: fsl,imx8mq-iomuxc-gpr
          - const: fsl,imx6q-iomuxc-gpr
          - const: syscon
          - const: simple-mfd
      - items:
          - enum:
              - fsl,imx8mm-iomuxc-gpr
              - fsl,imx8mn-iomuxc-gpr
              - fsl,imx8mp-iomuxc-gpr
          - const: syscon
  reg:
    maxItems: 1

required:
  - compatible
  - reg

additionalProperties: true

examples:
  - |
    gpr: iomuxc-gpr@20e0000 {
        compatible = "fsl,imx6q-iomuxc-gpr", "syscon", "simple-mfd";
        reg = <0x20e0000 0x38>;
    };
```

## Documentation/devicetree/bindings/soc/imx/fsl,imx-blk-ctl.yaml
```yaml
# SPDX-License-Identifier: (GPL-2.0-only OR BSD-2-Clause)
%YAML 1.2
---
$id: http://devicetree.org/schemas/soc/imx/fsl,imx-blk-ctl.yaml#
$schema: http://devicetree.org/meta-schemas/core.yaml#

title: NXP i.MX BLK_CTL

maintainers:
  - Peng Fan <peng.fan@nxp.com>

description:
  i.MX BLK_CTL is a conglomerate of different GPRs that are
  dedicated to a specific subsystem. It usually contains
  clocks and resets amongst other things. Here we take the clocks
  and resets as virtual PDs, the reason we could not take it as
  clock provider is there is A/B lock issue between power domain
  and clock.

properties:
  compatible:
    items:
      - enum:
          - fsl,imx8mm-dispmix-blk-ctl
          - fsl,imx8mm-vpumix-blk-ctl
      - const: syscon

  reg:
    maxItems: 1

  "#power-domain-cells":
    const: 1

  power-domains:
    minItems: 1
    maxItems: 32

  power-domain-names:
    minItems: 1
    maxItems: 32

  clocks:
    minItems: 1
    maxItems: 32

required:
  - compatible
  - reg
  - power-domains
  - power-domain-names

additionalProperties: false

examples:
  - |
    #include <dt-bindings/clock/imx8mm-clock.h>

    dispmix_blk_ctl: blk-ctl@32e28000 {
      compatible = "fsl,imx8mm-dispmix-blk-ctl", "syscon";
      reg = <0x32e28000 0x100>;
      #power-domain-cells = <1>;
      power-domains = <&pgc_dispmix>, <&pgc_mipi>;
      power-domain-names = "dispmix", "mipi";
      clocks = <&clk IMX8MM_CLK_DISP_ROOT>, <&clk IMX8MM_CLK_DISP_AXI_ROOT>,
               <&clk IMX8MM_CLK_DISP_APB_ROOT>;
    };
```

## Documentation/devicetree/bindings/soc/mediatek/devapc.yaml
```yaml
# SPDX-License-Identifier: (GPL-2.0 OR BSD-2-Clause)
# # Copyright 2020 MediaTek Inc.
%YAML 1.2
---
$id: "http://devicetree.org/schemas/soc/mediatek/devapc.yaml#"
$schema: "http://devicetree.org/meta-schemas/core.yaml#"

title: MediaTek Device Access Permission Control driver

description: |
  MediaTek bus fabric provides TrustZone security support and data
  protection to prevent slaves from being accessed by unexpected masters.
  The security violation is logged and sent to the processor for further
  analysis and countermeasures.

maintainers:
  - Neal Liu <neal.liu@mediatek.com>

properties:
  compatible:
    enum:
      - mediatek,mt6779-devapc
      - mediatek,mt8192-devapc

  version:
    description: The version of the hardware architecture
    $ref: /schemas/types.yaml#/definitions/uint32
    enum: [1, 2]
    maxItems: 1

  slave_type_num:
    description: The number of the devapc set
    $ref: /schemas/types.yaml#/definitions/uint32
    enum: [1, 4]
    maxItems: 1

  reg:
    description: The base address of devapc register bank
    maxItems: 4

  vio_idx_num:
    description: The number of the devices controlled by devapc
    $ref: /schemas/types.yaml#/definitions/uint32-array
    maxItems: 1

  interrupts:
    description: A single interrupt specifier
    maxItems: 1

  clocks:
    description: Contains module clock source and clock names
    maxItems: 1

  clock-names:
    description: Names of the clocks list in clocks property
    maxItems: 1

required:
  - compatible
  - version
  - slave_type_num
  - reg
  - vio_idx_num
  - interrupts
  - clocks
  - clock-names

additionalProperties: false

examples:
  - |
    #include <dt-bindings/interrupt-controller/arm-gic.h>
    #include <dt-bindings/clock/mt6779-clk.h>

    devapc: devapc@10207000 {
      compatible = "mediatek,mt6779-devapc";
      version = <1>;
      slave_type_num = <1>;
      reg = <0x10207000 0x1000>;
      vio_idx_num = <511>;
      interrupts = <GIC_SPI 168 IRQ_TYPE_LEVEL_LOW>;
      clocks = <&infracfg_ao CLK_INFRA_DEVICE_APC>;
      clock-names = "devapc-infra-clock";
    };
  - |
    #include <dt-bindings/interrupt-controller/arm-gic.h>
    #include <dt-bindings/clock/mt8192-clk.h>

    devapc: devapc@10207000 {
        compatible = "mediatek,mt8192-devapc";
        version = <2>;
        slave_type_num = <4>;
        reg = <0 0x10207000 0 0x1000>,
            <0 0x10274000 0 0x1000>,
            <0 0x10275000 0 0x1000>,
            <0 0x11020000 0 0x1000>;
        vio_idx_num = <367 292 242 58>;
        interrupts = <GIC_SPI 187 IRQ_TYPE_LEVEL_HIGH>;
        clocks = <&infracfg_ao CLK_INFRA_DEVICE_APC>;
        clock-names = "devapc-infra-clock";
    };
```

## Documentation/devicetree/bindings/soc/mediatek/mediatek,wdma.yaml
```yaml
# SPDX-License-Identifier: (GPL-2.0-only OR BSD-2-Clause)
%YAML 1.2
---
$id: http://devicetree.org/schemas/soc/mediatek/mediatek,wdma.yaml#
$schema: http://devicetree.org/meta-schemas/core.yaml#

title: Mediatek Write Direct Memory Access

maintainers:
  - Matthias Brugger <matthias.bgg@gmail.com>

description: |
  Mediatek Write Direct Memory Access(WDMA) component used to write
  the data into DMA.

properties:
  compatible:
    items:
      - enum:
          - mediatek,mt8183-mdp3-wdma

  reg:
    maxItems: 1

  mediatek,gce-client-reg:
    description: The register of client driver can be configured by gce with
      4 arguments defined in this property, such as phandle of gce, subsys id,
      register offset and size. Each GCE subsys id is mapping to a client
      defined in the header include/dt-bindings/gce/<chip>-gce.h.
    $ref: /schemas/types.yaml#/definitions/phandle-array
    maxItems: 1

  power-domains:
    maxItems: 1

  clocks:
    minItems: 1

  iommus:
    maxItems: 1

additionalProperties: false

examples:
  - |
    #include <dt-bindings/clock/mt8183-clk.h>
    #include <dt-bindings/gce/mt8183-gce.h>
    #include <dt-bindings/power/mt8183-power.h>
    #include <dt-bindings/memory/mt8183-larb-port.h>

    mdp3_wdma: mdp3_wdma@14006000 {
      compatible = "mediatek,mt8183-mdp3-wdma";
      reg = <0x14006000 0x1000>;
      mediatek,gce-client-reg = <&gce SUBSYS_1400XXXX 0x6000 0x1000>;
      power-domains = <&spm MT8183_POWER_DOMAIN_DISP>;
      clocks = <&mmsys CLK_MM_MDP_WDMA0>;
      iommus = <&iommu>;
    };
```
