## Documentation/devicetree/bindings/rtc/intel,pch-rtc.yaml
```yaml
# SPDX-License-Identifier: (GPL-2.0-only OR BSD-2-Clause)
%YAML 1.2
---
$id: http://devicetree.org/schemas/rtc/intel,pch-rtc.yaml#
$schema: http://devicetree.org/meta-schemas/core.yaml#

title: Intel Series PCH built-in read-only RTC

maintainers:
  - Ivan Mikhaylov <i.mikhaylov@yadro.com>

allOf:
  - $ref: rtc.yaml#

properties:
  compatible:
    enum:
      - intel,pch-rtc

  reg:
    maxItems: 1

required:
  - compatible
  - reg

additionalProperties: false

examples:
  - |
    i2c {
        #address-cells = <1>;
        #size-cells = <0>;

        rtc@0 {
            compatible = "intel,pch-rtc";
            reg = <0x44>;
        };
    };
```

## Documentation/devicetree/bindings/rtc/nxp,pcf2127.yaml
```yaml
# SPDX-License-Identifier: GPL-2.0-only OR BSD-2-Clause
%YAML 1.2
---
$id: http://devicetree.org/schemas/rtc/nxp,pcf2127.yaml#
$schema: http://devicetree.org/meta-schemas/core.yaml#

title: NXP PCF2127 Real Time Clock

allOf:
  - $ref: "rtc.yaml#"

maintainers:
  - Alexandre Belloni <alexandre.belloni@bootlin.com>

properties:
  compatible:
    enum:
      - nxp,pcf2127
      - nxp,pcf2131

  reg:
    maxItems: 1

  interrupts:
    maxItems: 1

  alarm-output-a:
    $ref: /schemas/types.yaml#/definitions/flag
    description:
      Enable alarm interrupt on INT_A output pin.

  alarm-output-b:
    $ref: /schemas/types.yaml#/definitions/flag
    description:
      Enable alarm interrupt on INT_B output pin.

  start-year: true

  reset-source: true

required:
  - compatible
  - reg

if:
  not:
    properties:
      compatible:
        contains:
          enum:
            - nxp,pcf2131
then:
  properties:
    alarm-output-a: false
    alarm-output-b: false

additionalProperties: false

examples:
  - |
    #include <dt-bindings/interrupt-controller/irq.h>
    i2c {
        #address-cells = <1>;
        #size-cells = <0>;

        rtc@51 {
            compatible = "nxp,pcf2127";
            reg = <0x51>;
            pinctrl-0 = <&rtc_nint_pins>;
            interrupts-extended = <&gpio1 16 IRQ_TYPE_LEVEL_HIGH>;
            reset-source;
        };
    };

  - |
    #include <dt-bindings/interrupt-controller/irq.h>
    i2c {
        #address-cells = <1>;
        #size-cells = <0>;

        rtc@53 {
            compatible = "nxp,pcf2131";
            reg = <0x53>;
            pinctrl-0 = <&rtc_nint_pins>;
            interrupts-extended = <&gpio1 16 IRQ_TYPE_LEVEL_HIGH>;
            reset-source;
            alarm-output-b;
        };
    };

...
```

## Documentation/devicetree/bindings/rtc/ricoh,rs5c372.yaml
```yaml
# SPDX-License-Identifier: (GPL-2.0-only OR BSD-2-Clause)
%YAML 1.2
---
$id: http://devicetree.org/schemas/rtc/ricoh,rs5c372.yaml#
$schema: http://devicetree.org/meta-schemas/core.yaml#

title: Ricoh RS5C372, R2025S/D, RV5C38[67] and R222[13] Real Time Clock

maintainers:
  - Alexandre Belloni <alexandre.belloni@bootlin.com>

allOf:
  - $ref: rtc.yaml#

properties:
  compatible:
    enum:
      - ricoh,r2025sd
      - ricoh,r2221tl
      - ricoh,rs5c372a
      - ricoh,rs5c372b
      - ricoh,rv5c386
      - ricoh,rv5c387a

  reg:
    maxItems: 1

  ricoh,trim:
    $ref: /schemas/types.yaml#/definitions/uint8
    description: |
      Raw value of Oscillation Adjustment Register (0x7) which changes
      time counts of 1 second. Normally, the second counter is incremented
      once per 32768 clock pulses. The value causes to increment
      decrement time counts when second digits read 00, 20, 40 seconds
      (R222[13] can operate on 00 seconds if MSB set).
      See datasheets for details.

  start-year: true

required:
  - compatible
  - reg

additionalProperties: false

examples:
  - |
    i2c {
        #address-cells = <1>;
        #size-cells = <0>;

        rtc@32 {
            compatible = "ricoh,r2221tl";
            reg = <0x32>;
            ricoh,trim = /bits/ 8 <0x23>;
        };
    };
...
```

## Documentation/devicetree/bindings/rtc/sunplus,sp7021-rtc.yaml
```yaml
# SPDX-License-Identifier: (GPL-2.0-only OR BSD-2-Clause)
# Copyright (C) Sunplus Co., Ltd. 2021
%YAML 1.2
---
$id: http://devicetree.org/schemas/rtc/sunplus,sp7021-rtc.yaml#
$schema: http://devicetree.org/meta-schemas/core.yaml#

title: Sunplus sp7021 Real Time Clock controller

maintainers:
  - Vincent Shih <vincent.shih@sunplus.com>

properties:
  compatible:
    const: sunplus,sp7021-rtc

  reg:
    maxItems: 1

  reg-names:
    items:
      - const: rtc_reg

  clocks:
    maxItems: 1

  resets:
    maxItems: 1

  interrupts:
    maxItems: 1

required:
  - compatible
  - reg
  - reg-names
  - clocks
  - resets
  - interrupts

additionalProperties: false

examples:
  - |
    #include <dt-bindings/clock/sp-sp7021.h>
    #include <dt-bindings/reset/sp-sp7021.h>
    #include <dt-bindings/interrupt-controller/irq.h>

    rtc: serial@9c003A00 {
        compatible = "sunplus,sp7021-rtc";
        reg = <0x9c003A00 0x80>;
        reg-names = "rtc_reg";
        clocks = <&clkc RTC>;
        resets = <&rstc RST_RTC>;
        interrupt-parent = <&intc>;
        interrupts = <163 IRQ_TYPE_EDGE_RISING>;
    };
...
```

## Documentation/devicetree/bindings/rtc/ti,palmas-rtc.yaml
```yaml
# SPDX-License-Identifier: GPL-2.0-only
%YAML 1.2
---
$id: http://devicetree.org/schemas/rtc/ti,palmas-rtc.yaml#
$schema: http://devicetree.org/meta-schemas/core.yaml#

title: Texas Instruments Palmas family of Power-Management ICs (RTC)

maintainers:
  - Alexandre Belloni <alexandre.belloni@bootlin.com>

properties:
  compatible:
    const: ti,palmas-rtc

  interrupts:
    maxItems: 1

  ti,backup-battery-chargeable:
    $ref: /schemas/types.yaml#/definitions/flag
    description: The Palmas series device like TPS65913 or TPS80036 supports the backup battery
      for powering the RTC when main battery is removed or in very low power state. The backup
      battery can be chargeable or non-chargeable. This flag will tells whether battery is
      chargeable or not. If charging battery then driver can enable the charging.

  ti,backup-battery-charge-high-current:
    $ref: /schemas/types.yaml#/definitions/flag
    description: Enable high current charging in backup battery. Device supports the < 100uA and >
      100uA charging. The high current will be > 100uA. Absence of this property will charge
      battery to lower current i.e. < 100uA.

allOf:
  - $ref: rtc.yaml

additionalProperties: false

required:
  - compatible
  - interrupts

examples:
  - |
    i2c {
      #address-cells = <1>;
      #size-cells = <0>;

      tps65913@58 {
        compatible = "ti,tps65913", "ti,palmas";
        reg = <0x58>;

        #interrupt-cells = <2>;
        interrupt-controller;

        rtc {
          compatible = "ti,palmas-rtc";
          interrupt-parent = <&palmas>;
          interrupts = <8 0>;
          ti,backup-battery-chargeable;
          ti,backup-battery-charge-high-current;
        };
      };
    };
```

## Documentation/devicetree/bindings/rtc/xlnx,zynqmp-rtc.yaml
```yaml
# SPDX-License-Identifier: (GPL-2.0-only OR BSD-2-Clause)
%YAML 1.2
---
$id: http://devicetree.org/schemas/rtc/xlnx,zynqmp-rtc.yaml#
$schema: http://devicetree.org/meta-schemas/core.yaml#

title: Xilinx Zynq Ultrascale+ MPSoC Real Time Clock

description:
  RTC controller for the Xilinx Zynq MPSoC Real Time Clock.
  The RTC controller has separate IRQ lines for seconds and alarm.

maintainers:
  - Michal Simek <michal.simek@xilinx.com>

allOf:
  - $ref: rtc.yaml#

properties:
  compatible:
    const: xlnx,zynqmp-rtc

  reg:
    maxItems: 1

  interrupts:
    minItems: 2

  clocks:
    items:
      - description: rtc_clk is the operating frequency of crystal.

  clock-names:
    items:
      - const: "rtc_clk"

  interrupt-names:
    items:
      - const: alarm
      - const: sec

required:
  - compatible
  - reg
  - interrupts
  - interrupt-names

additionalProperties: false

examples:
  - |
    soc {
      #address-cells = <2>;
      #size-cells = <2>;

      rtc: rtc@ffa60000 {
        compatible = "xlnx,zynqmp-rtc";
        reg = <0x0 0xffa60000 0x0 0x100>;
        interrupt-parent = <&gic>;
        interrupts = <0 26 4>, <0 27 4>;
        interrupt-names = "alarm", "sec";
        clock-names = "rtc_clk";
        clocks = <&rtc_clk>;
      };
    };
```

## Documentation/devicetree/bindings/serial/brcm,bcm6345-uart.yaml
```yaml
# SPDX-License-Identifier: GPL-2.0-only OR BSD-2-Clause
%YAML 1.2
---
$id: http://devicetree.org/schemas/serial/brcm,bcm6345-uart.yaml#
$schema: http://devicetree.org/meta-schemas/core.yaml#

title: BCM63xx UART

maintainers:
  - Rafał Miłecki <rafal@milecki.pl>

allOf:
  - $ref: serial.yaml#

properties:
  compatible:
    const: brcm,bcm6345-uart

  reg:
    maxItems: 1
    description: The base address of the UART register bank

  interrupts:
    description: A single interrupt specifier

  clocks:
    description: >
      Clock driving the hardware; used to figure out the baud rate divisor

  clock-names:
    const: refclk

unevaluatedProperties: false

required:
  - reg
  - interrupts
  - clocks

examples:
  - |
    serial@14e00520 {
        compatible = "brcm,bcm6345-uart";
        reg = <0x14e00520 0x18>;
        interrupt-parent = <&periph_intc>;
        interrupts = <2>;
        clocks = <&periph_clk>;
        clock-names = "refclk";
    };

    clocks {
        periph_clk: periph_clk {
            compatible = "fixed-clock";
            #clock-cells = <0>;
            clock-frequency = <54000000>;
        };
    };
```

## Documentation/devicetree/bindings/serial/fsl,s32-linflexuart.yaml
```yaml
# SPDX-License-Identifier: (GPL-2.0-only OR BSD-2-Clause)
%YAML 1.2
---
$id: http://devicetree.org/schemas/serial/fsl,s32-linflexuart.yaml#
$schema: http://devicetree.org/meta-schemas/core.yaml#

title: Freescale LINFlexD UART

description: |
  The LINFlexD controller implements several LIN protocol versions, as well
  as support for full-duplex UART communication through 8-bit and 9-bit
  frames. See chapter 47 ("LINFlexD") in the reference manual
  https://www.nxp.com/webapp/Download?colCode=S32V234RM.

maintainers:
  - Greg Kroah-Hartman <gregkh@linuxfoundation.org>
  - Rob Herring <robh@kernel.org>

allOf:
  - $ref: "serial.yaml"

properties:
  compatible:
    minItems: 1
    maxItems: 2
    oneOf:
      - description: The LINFlexD controller on S32G2 SoC, which can be
          configured in UART mode.
        items:
          - enum:
              - fsl,s32g2-linflexuart
          - const: fsl,s32v234-linflexuart

      - description: The LINFlexD controller on S32V234 SoC, which can be
          configured in UART mode.
        items:
          - const: fsl,s32v234-linflexuart

  reg:
    maxItems: 1

  interrupts:
    maxItems: 1

required:
  - compatible
  - reg
  - interrupts

unevaluatedProperties: false

examples:
  - |
    /* S32V234 */
    serial@40053000 {
        compatible = "fsl,s32v234-linflexuart";
        reg = <0x40053000 0x1000>;
        interrupts = <0 59 4>;
    };

    /* S32G2 */
    serial@401c8000 {
        compatible = "fsl,s32g2-linflexuart", "fsl,s32v234-linflexuart";
        reg = <0x401c8000 0x3000>;
        interrupts = <0 82 1>;
    };
```

## Documentation/devicetree/bindings/serial/hpe,gxp-vuart-cfg.txt
```
*HPE Virtual UART Controller CONFIGURATION

This controller is used to forward host serial to BMC chip

Required properties:

- compatible : Must contain "hpe,gxp-vuarta_cfg", "simple-mfd", "syscon".
- reg : Specifies base physical address and size of the configuration register.
- reg-io-width: io register width in bytes, must be 1.

Example:

	vuart_a_cfg: vuarta_cfg@80fc0230 {
		compatible = "hpe,gxp-vuarta_cfg", "simple-mfd", "syscon";
		reg = <0x80fc0230 0x100>;
		reg-io-width = <1>;
	};
```

## Documentation/devicetree/bindings/serial/hpe,gxp-vuart.txt
```
*HPE VUART Controller port

Required properties:

- compatible :  Must contain "hpe,gxp-vuart".
- reg        :  Specifies base physical address and size of the registers.
- interrupts :  The interrupt number.
- clock-frequency: The frequency of the clock input to the UART in Hz.
- status: The status signal from the controller.

Example:

	vuart_a: vuart_a@80fd0200 {
		compatible = "hpe,gxp-vuart";
		reg = <0x80fd0200 0x100>;
		interrupts = <2>;
		interrupt-parent = <&vic1>;
		clock-frequency = <1846153>;
		reg-shift = <0>;
		status = "okay";
		serial-line = <3>;
		vuart_cfg = <&vuart_a_cfg>;
	};
```
