## Documentation/devicetree/bindings/soc/qcom/qcom,apr.yaml
```yaml
# SPDX-License-Identifier: (GPL-2.0 OR BSD-2-Clause)
%YAML 1.2
---
$id: "http://devicetree.org/schemas/soc/qcom/qcom,apr.yaml#"
$schema: "http://devicetree.org/meta-schemas/core.yaml#"

title: Qualcomm APR/GPR (Asynchronous/Generic Packet Router) binding

maintainers:
  - Srinivas Kandagatla <srinivas.kandagatla@linaro.org>

description: |
  This binding describes the Qualcomm APR/GPR, APR/GPR is a IPC protocol for
  communication between Application processor and QDSP. APR/GPR is mainly
  used for audio/voice services on the QDSP.

properties:
  compatible:
    enum:
      - qcom,apr
      - qcom,apr-v2
      - qcom,gpr

  qcom,apr-domain:
    $ref: /schemas/types.yaml#/definitions/uint32
    enum: [1, 2, 3, 4, 5, 6, 7]
    description:
      Selects the processor domain for apr
        1 = APR simulator
        2 = PC Domain
        3 = Modem Domain
        4 = ADSP Domain
        5 = Application processor Domain
        6 = Modem2 Domain
        7 = Application Processor2 Domain

  qcom,gpr-domain:
    $ref: /schemas/types.yaml#/definitions/uint32
    enum: [1, 2, 3]
    description:
      Selects the processor domain for gpr
        1 = Modem Domain
        2 = Audio DSP Domain
        3 = Application Processor Domain

  '#address-cells':
    const: 1

  '#size-cells':
    const: 0

#APR/GPR Services
patternProperties:
  "^apr-service@[0-9a-e]$":
    type: object
    description:
      APR node's client devices use subnodes for desired static port services.

    properties:
      compatible:
        enum:
          - qcom,q6core
          - qcom,q6asm
          - qcom,q6afe
          - qcom,q6adm

      reg:
        enum: [3, 4, 5, 6, 7, 8, 9, 10, 11, 12, 13]
        description:
          APR Service ID
            3 = DSP Core Service
            4 = Audio  Front End Service.
            5 = Voice Stream Manager Service.
            6 = Voice processing manager.
            7 = Audio Stream Manager Service.
            8 = Audio Device Manager Service.
            9 = Multimode voice manager.
            10 = Core voice stream.
            11 = Core voice processor.
            12 = Ultrasound stream manager.
            13 = Listen stream manager.

      qcom,protection-domain:
        $ref: /schemas/types.yaml#/definitions/string-array
        description: protection domain service name and path for apr service
          has dependency on.
        items:
          - const: avs/audio
          - const: msm/adsp/audio_pd

      '#address-cells':
        const: 1

      '#size-cells':
        const: 0

    additionalProperties: false

  "^gpr-service@[0-9a-e]$":
    type: object
    description:
      GPR node's client devices use subnodes for desired static port services.

    properties:
      compatible:
        enum:
          - qcom,q6apm
          - qcom,q6prm

      reg:
        enum: [1, 2, 3, 4]
        description:
          GPR Service ID
            1 = Audio Process Manager Service
            2 = Proxy Resource Manager Service.
            3 = AMDB Service.
            4 = Voice processing manager.

      qcom,protection-domain:
        $ref: /schemas/types.yaml#/definitions/string-array
        description: protection domain service name and path for apr service
          has dependency on.
        items:
          - const: avs/audio
          - const: msm/adsp/audio_pd

      '#address-cells':
        const: 1

      '#size-cells':
        const: 0

    additionalProperties: false

required:
  - compatible

allOf:
  - if:
      properties:
        compatible:
          contains:
            enum:
              - qcom,apr-v2
              - qcom,apr
    then:
      required:
        - qcom,apr-domain

  - if:
      properties:
        compatible:
          contains:
            enum:
              - qcom,gpr
    then:
      required:
        - qcom,gpr-domain

additionalProperties: false

examples:
  - |
    #include <dt-bindings/soc/qcom,apr.h>
    apr {
        compatible = "qcom,apr-v2";
        qcom,apr-domain = <APR_DOMAIN_ADSP>;
        #address-cells = <1>;
        #size-cells = <0>;

        q6core: apr-service@3 {
          compatible = "qcom,q6core";
          reg = <APR_SVC_ADSP_CORE>;
          qcom,protection-domain = "avs/audio", "msm/adsp/audio_pd";
        };

        q6afe: apr-service@4 {
          compatible = "qcom,q6afe";
          reg = <APR_SVC_AFE>;
          qcom,protection-domain = "avs/audio", "msm/adsp/audio_pd";
        };

        q6asm: apr-service@7 {
          compatible = "qcom,q6asm";
          reg = <APR_SVC_ASM>;
          qcom,protection-domain = "avs/audio", "msm/adsp/audio_pd";
        };

        q6adm: apr-service@8 {
          compatible = "qcom,q6adm";
          reg = <APR_SVC_ADM>;
          qcom,protection-domain = "avs/audio", "msm/adsp/audio_pd";
        };
    };

  - |
    #include <dt-bindings/soc/qcom,gpr.h>
    gpr {
        compatible = "qcom,gpr";
        qcom,gpr-domain = <GPR_DOMAIN_ID_ADSP>;
        #address-cells = <1>;
        #size-cells = <0>;

        gpr-service@1 {
          compatible = "qcom,q6apm";
          reg = <GPR_APM_MODULE_IID>;
          qcom,protection-domain = "avs/audio", "msm/adsp/audio_pd";
        };
    };
```

## Documentation/devicetree/bindings/soc/qcom/qcom,eud.yaml
```yaml
# SPDX-License-Identifier: (GPL-2.0 OR BSD-2-Clause)
%YAML 1.2
---
$id: "http://devicetree.org/schemas/soc/qcom/qcom,eud.yaml#"
$schema: "http://devicetree.org/meta-schemas/core.yaml#"

title: Qualcomm Embedded USB Debugger

maintainers:
  - Souradeep Chowdhury <schowdhu@codeaurora.org>

description: |
  This binding is used to describe the Qualcomm Embedded USB Debugger, which is
  mini USB-hub implemented on chip to support USB-based debug capabilities.

properties:
  compatible:
    items:
      - enum:
          - qcom,sc7280-eud
      - const: qcom,eud

  reg:
    items:
      - description: EUD Base Register Region
      - description: EUD Mode Manager Register

  interrupts:
    description:
      EUD interrupt


  port:
    description:
      Any connector to the data bus of this controller should be modelled
      using the OF graph bindings specified, if the "usb-role-switch"
      property is used. See graph.txt
    $ref: /schemas/graph.yaml#/properties/port

required:
  - compatible
  - reg

additionalProperties: false

examples:
  - |
    eud@88e0000 {
           compatible = "qcom,sc7280-eud","qcom,eud";
           reg = <0 0x88e0000 0 0x2000>,
                 <0 0x88e2000 0 0x1000>;
    };
```

## Documentation/devicetree/bindings/soc/qcom/qcom,glink.yaml
```yaml
# SPDX-License-Identifier: (GPL-2.0-only OR BSD-2-Clause)
%YAML 1.2
---
$id: "http://devicetree.org/schemas/soc/qcom/qcom,glink.yaml#"
$schema: "http://devicetree.org/meta-schemas/core.yaml#"

title: Qualcomm GLINK edge

description: |
  Qualcomm GLINK edge, a fifo based mechanism for communication between
  subsystem-pairs on various Qualcomm platforms. Two types of edges can be
  described by the binding; the GLINK RPM edge and a SMEM based.

maintainers:
  - Bjorn Andersson <bjorn.andersson@linaro.org>

properties:
  $nodename:
    pattern: "^(rpm-)?glink(-edge)?$"

  compatible:
    const: qcom,glink-rpm

  label:
    $ref: /schemas/types.yaml#/definitions/string
    description: should specify the subsystem name this edge corresponds to

  interrupts:
    description: >
      should specify the IRQ used by the remote processor to
      signal this processor about communication related events
    maxItems: 1

  mboxes:
    description: >
      reference to the "rpm_hlos" mailbox in APCS, as described
      in mailbox/mailbox.txt

  qcom,remote-pid:
    $ref: /schemas/types.yaml#/definitions/uint32
    description: specifies the identifier of the remote endpoint of this edge

  qcom,rpm-msg-ram:
    $ref: /schemas/types.yaml#/definitions/phandle
    description: RPM message memory resource

patternProperties:
  ".*":
    type: object
    properties:
      qcom,glink-channels:
        $ref: /schemas/types.yaml#/definitions/string
        description: >
          a list of channels tied to this function, used for matching
          the function to a set of virtual channels

      'qcom,intents':
        $ref: /schemas/types.yaml#/definitions/uint32-array
        description: >
          a list of size, amount pairs describing what intents should
          be preallocated for this virtual channel. This can be used
          to tweak the default intents available for the channel to
          meet expectations of the remote

    required:
      - qcom,glink-channels

    additionalProperties: true

required:
  - interrupts
  - mboxes
  - qcom,smem
  - qcom,local-pid
  - qcom,remote-pid

anyOf:
  - required:
      - qcom,remote-pid
  - required:
      - qcom,rpm-msg-ram

additionalProperties: false

examples:
  # The following example represents the GLINK RPM node on a MSM8996 device,
  # with the function for the "rpm_request" channel defined, which
  # is used for regulators and root clocks.
  - |
    rpm-glink {
        compatible = "qcom,glink-rpm";

        interrupts = <0 168 1>;

        qcom,rpm-msg-ram = <&rpm_msg_ram>;

        mboxes = <&apcs_glb 0>;

        rpm-requests {
            compatible = "qcom,rpm-msm8996";
            qcom,glink-channels = "rpm_requests";

            qcom,intents = <0x400 5
                            0x800 1>;
        };
    };
```

## Documentation/devicetree/bindings/soc/qcom/qcom,gpr.yaml
```yaml
# SPDX-License-Identifier: (GPL-2.0 OR BSD-2-Clause)
%YAML 1.2
---
$id: "http://devicetree.org/schemas/soc/qcom/qcom,gpr.yaml#"
$schema: "http://devicetree.org/meta-schemas/core.yaml#"

title: Qualcomm Generic Packet Router binding

maintainers:
  - Srinivas Kandagatla <srinivas.kandagatla@linaro.org>

description: |
  This binding describes the Qualcomm Generic Packet Router,Shared Memory Manager,
  used to send and receive packets between Audio DSP and Application processor.

properties:
  compatible:
    const: qcom,gpr

  qcom,glink-channels:
    const: adsp_apps
    description:
      glink channel associated with gpr function

  qcom,protection-domain:
    $ref: /schemas/types.yaml#/definitions/string-array
    description: protection domain service name and path for gpr service
      has dependency on.
    items:
      - const: avs/audio
      - const: msm/adsp/audio_pd

  qcom,gpr-domain:
    $ref: /schemas/types.yaml#/definitions/uint32
    enum: [1, 2, 3]
    description:
      Selects the processor domain for gpr
        1 = Modem Domain
        2 = Audio DSP Domain
        3 = Application Processor Domain

  '#address-cells':
    const: 1

  '#size-cells':
    const: 0

#GPR Services
patternProperties:
  'gprservice@[0-9]+$':
    type: object
    description:
      GPR node's client devices use subnodes for desired static port services.

    properties:
      reg:
        maxItems: 1
        description: Service port id

    additionalProperties: false

required:
  - compatible
  - qcom,glink-channels
  - qcom,gpr-domain

additionalProperties: false

examples:
  - |
    #include <dt-bindings/soc/qcom,gpr.h>
    gpr {
        compatible = "qcom,gpr";
        qcom,glink-channels = "adsp_apps";
        qcom,gpr-domain = <GPR_DOMAIN_ID_ADSP>;
        qcom,protection-domain = "avs/audio", "msm/adsp/audio_pd";
        #address-cells = <1>;
        #size-cells = <0>;

        gprservice@1 {
          reg = <GPR_APM_MODULE_IID>;
        };
    };
```

## Documentation/devicetree/bindings/soc/qcom/qcom,smp2p.yaml
```yaml
# SPDX-License-Identifier: (GPL-2.0-only OR BSD-2-Clause)
%YAML 1.2
---
$id: "http://devicetree.org/schemas/soc/qcom/qcom,smp2p.yaml#"
$schema: "http://devicetree.org/meta-schemas/core.yaml#"

title: Qualcomm Shared Memory Point 2 Point

description: |
  The Shared Memory Point to Point (SMP2P) protocol facilitates communication of
  a single 32-bit value between two processors.  Each value has a single writer
  (the local side) and a single reader (the remote side).  Values are uniquely
  identified in the system by the directed edge (local processor ID to remote
  processor ID) and a string identifier.

maintainers:
  - Bjorn Andersson <bjorn.andersson@linaro.org>

properties:
  compatible:
    const: qcom,smp2p

  interrupts:
    maxItems: 1

  mboxes:
    description: >
      reference to the associated doorbell in APCS, as described
      in mailbox/mailbox.txt

  qcom,ipc:
    $ref: /schemas/types.yaml#/definitions/uint32-matrix
    description: >
      three entries specifying the outgoing ipc bit used for
      signaling the remote end of the smp2p edge
    minItems: 1
    maxItems: 32 # no hard limit
    items:
      items:
        - description: phandle to a syscon node representing the apcs registers
        - description: offset to the register within the syscon
        - description: the IPC bit within the register

  qcom,smem:
    $ref: /schemas/types.yaml#/definitions/uint32-matrix
    description: indentifiers of the smem items used for this edge
    items:
      - items:
          - description: identifier of inbound smem items
      - items:
          - description: identifier of outbound smem items

  qcom,local-pid:
    $ref: /schemas/types.yaml#/definitions/uint32
    description: specifies the identifier of the local endpoint of this edge

  qcom,remote-pid:
    $ref: /schemas/types.yaml#/definitions/uint32
    description: specifies the identifier of the remote endpoint of this edge

patternProperties:
  "^((master|slave)-kernel|ipa-ap-to-modem|ipa-modem-to-ap|)$":
    type: object
    properties:
      interrupt-controller:
        description: >
          marks the entry as inbound, if not specified
          this node will denote the outgoing entry

      '#interrupt-cells':
        const: 2

      qcom,entry-name:
        $ref: /schemas/types.yaml#/definitions/string
        description: >
          specifies the name of this entry, for inbound entries this will be
          used to match against the remotely allocated entry and for outbound
          entries this name is used for allocating entries

      '#qcom,smem-state-cells':
        $ref: /schemas/types.yaml#/definitions/uint32
        description: required for outgoing entries
        const: 1

    required:
      - qcom,entry-name

    oneOf:
      - required:
          - interrupt-controller
          - '#interrupt-cells'
      - required:
          - '#qcom,smem-state-cells'

    additionalProperties: false

required:
  - compatible
  - qcom,smem
  - qcom,local-pid
  - qcom,remote-pid

anyOf:
  - required:
      - mboxes
  - required:
      - qcom,ipc

additionalProperties: false

examples:
  # The following example shows the SMP2P setup with the wireless processor,
  # defined from the 8974 apps processor's point-of-view. It encompasses one
  # inbound and one outbound entry:
  - |
    wcnss-smp2p {
        compatible = "qcom,smp2p";
        qcom,smem = <431>, <451>;

        interrupts = <0 143 1>;

        qcom,ipc = <&apcs 8 18>;

        qcom,local-pid = <0>;
        qcom,remote-pid = <4>;

        wcnss_smp2p_out: master-kernel {
            qcom,entry-name = "master-kernel";

            #qcom,smem-state-cells = <1>;
        };

        wcnss_smp2p_in: slave-kernel {
            qcom,entry-name = "slave-kernel";

            interrupt-controller;
            #interrupt-cells = <2>;
        };
    };
```
