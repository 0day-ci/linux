## Documentation/devicetree/bindings/sound/amlogic,axg-fifo.yaml
```yaml
# SPDX-License-Identifier: (GPL-2.0-only OR BSD-2-Clause)
%YAML 1.2
---
$id: http://devicetree.org/schemas/sound/amlogic,axg-fifo.yaml#
$schema: http://devicetree.org/meta-schemas/core.yaml#

title: Amlogic Audio FIFO controllers

maintainers:
  - Jerome Brunet <jbrunet@baylibre.com>

allOf:
  - $ref: name-prefix.yaml#

properties:
  $nodename:
    pattern: "^audio-controller@.*"

  "#sound-dai-cells":
    const: 0

  compatible:
    oneOf:
      - items:
          - enum:
              - amlogic,g12a-frddr
              - amlogic,sm1-frddr
          - const: amlogic,axg-frddr
      - const: amlogic,axg-frddr
      - items:
          - enum:
              - amlogic,g12a-toddr
              - amlogic,sm1-toddr
          - const: amlogic,axg-toddr
      - const: amlogic,axg-toddr

  reg:
    items:
      - description: physical base address of the controller

  interrupts:
    items:
      - description: FIFO interrupt

  clocks:
    items:
      - description: FIFO peripheral clock provided by the audio clock controller

  resets:
    minItems: 1
    items:
      - description: memory ARB line
      - description: optional device reset line

  reset-names:
    minItems: 1
    items:
      - const: arb
      - const: rst

  amlogic,fifo-depth:
    description: >
      The size of the controller's fifo in bytes. This
      is useful for determining certain configuration such
      as the flush threshold of the fifo
    $ref: /schemas/types.yaml#/definitions/uint32

  sound-name-prefix: true

required:
  - compatible
  - reg
  - interrupts
  - clocks
  - resets
  - reset-names
  - '#sound-dai-cells'
  - amlogic,fifo-depth

additionalProperties: false

examples:
  - |
    #include <dt-bindings/clock/axg-audio-clkc.h>
    #include <dt-bindings/interrupt-controller/irq.h>
    #include <dt-bindings/reset/amlogic,meson-axg-audio-arb.h>

    frddr_a: audio-controller@1c0 {
        compatible = "amlogic,axg-frddr";
        reg = <0x1c0 0x1c>;
        #sound-dai-cells = <0>;
        interrupts = <88 IRQ_TYPE_EDGE_RISING>;
        clocks = <&clkc_audio AUD_CLKID_FRDDR_A>;
        resets = <&arb AXG_ARB_FRDDR_A>;
        reset-names = "arb";
        amlogic,fifo-depth = <512>;
    };
```

## Documentation/devicetree/bindings/sound/audio-graph-card2-items.yaml
```yaml
# SPDX-License-Identifier: (GPL-2.0-only OR BSD-2-Clause)
%YAML 1.2
---
$id: http://devicetree.org/schemas/sound/audio-graph-card2-items.yaml#
$schema: http://devicetree.org/meta-schemas/core.yaml#

title: Audio Graph Card2 Items Bindings

maintainers:
  - Kuninori Morimoto <kuninori.morimoto.gx@renesas.com>

properties:
  compatible:
    enum:
      - audio-graph-card2-dsp
      - audio-graph-card2-multi
      - audio-graph-card2-codec2codec

  "#address-cells":
    const: 1

  "#size-cells":
    const: 0

patternProperties:
  "^ports(@[0-1])?$":
    $ref: /schemas/graph.yaml#/properties/ports
    properties:
      port(@[0-9a-f]+)?:
        $ref: audio-graph-port.yaml#
        unevaluatedProperties: false
    additionalProperties: true

required:
  - compatible

additionalProperties: true

examples:
  - |
    mix {
        compatible = "audio-graph-card2-dsp";

        /* sample ports
        ports@0 {
            port@0 { mix_fe0_ep: endpoint { remote-endpoint = <&cpu0_ep>; }; };
            port@1 { mix_fe1_ep: endpoint { remote-endpoint = <&cpu1_ep>; }; };
        };
        ports@1 {
            port@0 { mix_be0_ep: endpoint { remote-endpoint = <&codec0_ep>; }; };
        };
        */
    };

    multi {
        compatible = "audio-graph-card2-multi";

        /* sample ports
        ports@0 {
            port@0 { multi_00_ep: endpoint { remote-endpoint = <&cpu2_ep>; }; };
            port@1 { multi_01_ep: endpoint { remote-endpoint = <&cpu3_ep>; }; };
        };
        ports@1 {
            port@0 { multi_10_ep: endpoint { remote-endpoint = <&codec1_ep>; }; };
            port@1 { multi_11_ep: endpoint { remote-endpoint = <&codec2_ep>; }; };
        };
        */
    };

    codec2codec {
        compatible = "audio-graph-card2-codec2codec";

        /* sample ports
        rate = <48000>;
        ports {
            port@0 { c2c_0_ep: endpoint { remote-endpoint = <&codec3_ep>; }; };
            port@1 { c2c_1_ep: endpoint { remote-endpoint = <&codec4_ep>; }; };
        };
        */
    };
```

## Documentation/devicetree/bindings/sound/audio-graph-card2.yaml
```yaml
# SPDX-License-Identifier: (GPL-2.0-only OR BSD-2-Clause)
%YAML 1.2
---
$id: http://devicetree.org/schemas/sound/audio-graph-card2.yaml#
$schema: http://devicetree.org/meta-schemas/core.yaml#

title: Audio Graph Card2 Device Tree Bindings

maintainers:
  - Kuninori Morimoto <kuninori.morimoto.gx@renesas.com>

properties:
  compatible:
    enum:
      - audio-graph-card2
  links:
    $ref: /schemas/types.yaml#/definitions/phandle-array
  routing:
    description: |
      A list of the connections between audio components.
      Each entry is a pair of strings, the first being the
      connection's sink, the second being the connection's source.
    $ref: /schemas/types.yaml#/definitions/non-unique-string-array

required:
  - compatible
  - links

unevaluatedProperties: false

examples:
  - |
    sound {
        compatible = "audio-graph-card2";

        links = <&cpu_port>;
    };

    cpu {
        cpu_port: port { cpu_ep: endpoint { remote-endpoint = <&codec_ep>; }; };
    };

    codec {
        port { codec_ep: endpoint { remote-endpoint = <&cpu_ep>; }; };
    };
```

## Documentation/devicetree/bindings/sound/awinic,aw8738.yaml
```yaml
# SPDX-License-Identifier: (GPL-2.0-only OR BSD-2-Clause)
%YAML 1.2
---
$id: http://devicetree.org/schemas/sound/awinic,aw8738.yaml#
$schema: http://devicetree.org/meta-schemas/core.yaml#

title: Awinic AW8738 Audio Amplifier

maintainers:
  - Stephan Gerhold <stephan@gerhold.net>

description:
  The Awinic AW8738 is a simple audio amplifier using
  one-wire pulse control to set the amplifier mode.

allOf:
  - $ref: name-prefix.yaml#

properties:
  compatible:
    const: awinic,aw8738

  enable-gpios:
    maxItems: 1

  awinic,mode:
    description: Amplifier mode (number of pulses for one-wire pulse control)
    $ref: /schemas/types.yaml#/definitions/uint32
    minimum: 1

  sound-name-prefix: true

required:
  - compatible
  - enable-gpios
  - awinic,mode

additionalProperties: false

examples:
  - |
    #include <dt-bindings/gpio/gpio.h>
    audio-amplifier {
        compatible = "awinic,aw8738";
        enable-gpios = <&msmgpio 114 GPIO_ACTIVE_HIGH>;
        awinic,mode = <5>;
        sound-name-prefix = "Speaker Amp";
    };
```
