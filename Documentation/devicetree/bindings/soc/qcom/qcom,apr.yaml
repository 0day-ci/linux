## Documentation/devicetree/bindings/sound/everest,es8156.yaml
```yaml
# SPDX-License-Identifier: (GPL-2.0-only OR BSD-2-Clause)
%YAML 1.2
---
$id: http://devicetree.org/schemas/sound/everest,es8156.yaml#
$schema: http://devicetree.org/meta-schemas/core.yaml#

title: Everest ES8156 audio CODEC

maintainers:
  - Shumin Chen <chenshumin86@sina.com>

properties:
  compatible:
    const: everest,es8156

  reg:
    maxItems: 1

  clocks:
    items:
      - description: clock for master clock (MCLK)

  clock-names:
    items:
      - const: mclk

  "#sound-dai-cells":
    const: 0

required:
  - compatible
  - reg
  - "#sound-dai-cells"

additionalProperties: false

examples:
  - |
    i2c0 {
      #address-cells = <1>;
      #size-cells = <0>;
      es8156: codec@8 {
        compatible = "everest,es8156";
        reg = <0x11>;
        clocks = <&clks 10>;
        clock-names = "mclk";
        #sound-dai-cells = <0>;
      };
    };
```

## Documentation/devicetree/bindings/sound/imx-audio-akcodec.yaml
```yaml
# SPDX-License-Identifier: (GPL-2.0-only OR BSD-2-Clause)
%YAML 1.2
---
$id: http://devicetree.org/schemas/sound/imx-audio-akcodec.yaml#
$schema: http://devicetree.org/meta-schemas/core.yaml#

title: NXP i.MX audio complex with AK4458/AK5558/AK5552/AK4497 codec

maintainers:
  - Shengjiu Wang <shengjiu.wang@nxp.com>

properties:
  compatible:
    enum:
      - fsl,imx8mq-audio-akcodec
      - fsl,imx-audio-akcodec

  model:
    $ref: /schemas/types.yaml#/definitions/string
    description: User specified audio sound card name

  audio-routing:
    $ref: /schemas/types.yaml#/definitions/non-unique-string-array
    description:
      A list of the connections between audio components. Each entry is a
      pair of strings, the first being the connection's sink, the second
      being the connection's source. Valid names could be power supplies,
      MicBias of codec and the jacks on the board.

patternProperties:
  ".*-dai-link$":
    description:
      Each subnode represents a dai link. Subnodes of each dai links would be
      cpu/codec dais.

    type: object

    properties:
      link-name:
        description: Indicates dai-link name and PCM stream name.
        $ref: /schemas/types.yaml#/definitions/string
        maxItems: 1

      format:
        description: audio format.
        items:
          enum:
            - i2s
            - dsp_b

      cpu:
        description: Holds subnode which indicates cpu dai.
        type: object
        properties:
          sound-dai: true

      codec:
        description: Holds subnode which indicates codec dai.
        type: object
        properties:
          sound-dai: true

    required:
      - link-name
      - cpu

    additionalProperties: false

required:
  - compatible
  - model

additionalProperties: false

examples:
  - |
    sound-ak4458 {
        compatible = "fsl,imx-audio-akcodec";
        model = "ak4458-audio";
        pri-dai-link {
            link-name = "akcodec";
            format = "i2s";
            cpu {
                 sound-dai = <&sai1>;
            };
            codec {
                 sound-dai = <&ak4458_1>, <&ak4458_2>;
            };
        };
        fe-dai-link {
            link-name = "HiFi-ASRC-FE";
            format = "i2s";
            cpu {
                sound-dai = <&easrc>;
            };
        };
        be-dai-link {
            link-name = "HiFi-ASRC-BE";
            format = "dsp_b";
            cpu {
                sound-dai = <&sai1>;
            };
            codec {
                sound-dai = <&ak4458_1>, <&ak4458_2>;
            };
        };
    };
```

## Documentation/devicetree/bindings/sound/mchp,pdmc.yaml
```yaml
# SPDX-License-Identifier: (GPL-2.0 OR BSD-2-Clause)
%YAML 1.2
---
$id: http://devicetree.org/schemas/sound/mchp,pdmc.yaml#
$schema: http://devicetree.org/meta-schemas/core.yaml#

title: Microchip PDMC Device Tree Bindings

maintainers:
  - Codrin Ciubotariu <codrin.ciubotariu@microchip.com>

description:
  The Microchip Pulse Density Microphone Controller (PDMC) interfaces up to 4 digital microphones
  having Pulse Density Modulated (PDM) outputs.

properties:
  "#sound-dai-cells":
    const: 0

  compatible:
    const: microchip,sama7g5-pdmc

  reg:
    maxItems: 1

  interrupts:
    maxItems: 1

  clocks:
    items:
      - description: Peripheral Bus Clock
      - description: Generic Clock

  clock-names:
    items:
      - const: pclk
      - const: gclk

  dmas:
    description: RX DMA Channel
    maxItems: 1

  dma-names:
    const: rx

  microchip,mic-pos:
    description: |
      Position of PDM microphones on the DS line and the sampling edge (rising or falling) of the
      CLK line. A microphone is represented as a pair of DS line and the sampling edge. The first
      microhpone is mapped to channel 0, the second to channel 1, etc.
    $ref: /schemas/types.yaml#/definitions/uint32-matrix
    items:
      items:
        - description: value for DS line
        - description: value for sampling edge
      anyOf:
        - enum:
            - [0, 0]
            - [0, 1]
            - [1, 0]
            - [1, 1]
    minItems: 1
    maxItems: 4
    uniqueItems: true

required:
  - "#sound-dai-cells"
  - compatible
  - reg
  - interrupts
  - clocks
  - clock-names
  - dmas
  - dma-names
  - microchip,mic-pos

additionalProperties: false

examples:
  - |
    #include <dt-bindings/clock/at91.h>
    #include <dt-bindings/dma/at91.h>
    #include <dt-bindings/interrupt-controller/arm-gic.h>
    #include <dt-bindings/sound/mchp,pdmc.h>

    pdmc: pdmc@e1608000 {
        #sound-dai-cells = <0>;
        compatible = "microchip,sama7g5-pdmc";
        reg = <0xe1608000 0x4000>;
        interrupts = <GIC_SPI 68 IRQ_TYPE_LEVEL_HIGH>;
        dmas = <&dma0 AT91_XDMAC_DT_PERID(37)>;
        dma-names = "rx";
        clocks = <&pmc PMC_TYPE_PERIPHERAL 68>, <&pmc PMC_TYPE_GCK 68>;
        clock-names = "pclk", "gclk";
        microchip,mic-pos = <MCHP_PDMC_DS0 MCHP_PDMC_CLK_POSITIVE>,
                            <MCHP_PDMC_DS0 MCHP_PDMC_CLK_NEGATIVE>,
                            <MCHP_PDMC_DS1 MCHP_PDMC_CLK_POSITIVE>,
                            <MCHP_PDMC_DS1 MCHP_PDMC_CLK_NEGATIVE>;
    };
```

## Documentation/devicetree/bindings/sound/mt8186-mt6366-da7219-max98357.yaml
```yaml
# SPDX-License-Identifier: (GPL-2.0-only OR BSD-2-Clause)
%YAML 1.2
---
$id: http://devicetree.org/schemas/sound/mt8186-mt6366-da7219-max98357.yaml#
$schema: http://devicetree.org/meta-schemas/core.yaml#

title: Mediatek MT8186 with MT6366, DA7219 and MAX98357 ASoC sound card driver

maintainers:
  - Jiaxin Yu <jiaxin.yu@mediatek.com>

description:
  This binding describes the MT8186 sound card.

properties:
  compatible:
    enum:
      - mediatek,mt8186_mt6366_da7219_max98357_sound

  mediatek,platform:
    $ref: "/schemas/types.yaml#/definitions/phandle"
    description: The phandle of MT8186 ASoC platform.

  mediatek,hdmi-codec:
    $ref: "/schemas/types.yaml#/definitions/phandle"
    description: The phandle of HDMI codec.

additionalProperties: false

required:
  - compatible
  - mediatek,platform

examples:
  - |

    sound: mt8192-sound {
        compatible = "mediatek,mt8186_mt6366_da7219_max98357_sound";
        mediatek,platform = <&afe>;
        mediatek,hdmi-codec = <&anx_bridge_dp>;
        pinctrl-names = "aud_clk_mosi_off",
                        "aud_clk_mosi_on";
        pinctrl-0 = <&aud_clk_mosi_off>;
        pinctrl-1 = <&aud_clk_mosi_on>;
    };

...
```

## Documentation/devicetree/bindings/sound/mt8186-mt6366-rt1019-rt5682s.yaml
```yaml
# SPDX-License-Identifier: (GPL-2.0-only OR BSD-2-Clause)
%YAML 1.2
---
$id: http://devicetree.org/schemas/sound/mt8186-mt6366-rt1019-rt5682s.yaml#
$schema: http://devicetree.org/meta-schemas/core.yaml#

title: Mediatek MT8186 with MT6366, RT1019 and RT5682S ASoC sound card driver

maintainers:
  - Jiaxin Yu <jiaxin.yu@mediatek.com>

description:
  This binding describes the MT8186 sound card.

properties:
  compatible:
    enum:
      - mediatek,mt8186_mt6366_rt1019_rt5682s_sound

  mediatek,platform:
    $ref: "/schemas/types.yaml#/definitions/phandle"
    description: The phandle of MT8186 ASoC platform.

  mediatek,hdmi-codec:
    $ref: "/schemas/types.yaml#/definitions/phandle"
    description: The phandle of HDMI codec.

additionalProperties: false

required:
  - compatible
  - mediatek,platform

examples:
  - |

    sound: mt8186-sound {
        compatible = "mediatek,mt8186_mt6366_rt1019_rt5682s_sound";
        mediatek,platform = <&afe>;
        mediatek,hdmi-codec = <&it6505dptx>;
        pinctrl-names = "aud_clk_mosi_off",
                        "aud_clk_mosi_on";
        pinctrl-0 = <&aud_clk_mosi_off>;
        pinctrl-1 = <&aud_clk_mosi_on>;
    };

...
```

## Documentation/devicetree/bindings/sound/mt8195-afe-pcm.yaml
```yaml
# SPDX-License-Identifier: (GPL-2.0-only OR BSD-2-Clause)
%YAML 1.2
---
$id: http://devicetree.org/schemas/sound/mt8195-afe-pcm.yaml#
$schema: http://devicetree.org/meta-schemas/core.yaml#

title: Mediatek AFE PCM controller for mt8195

maintainers:
  - Trevor Wu <trevor.wu@mediatek.com>

properties:
  compatible:
    const: mediatek,mt8195-audio

  interrupts:
    maxItems: 1

  mediatek,topckgen:
    $ref: "/schemas/types.yaml#/definitions/phandle"
    description: The phandle of the mediatek topckgen controller

  power-domains:
    maxItems: 1

  clocks:
    items:
      - description: audio 26M clock
      - description: AFE clock
      - description: audio infra sys clock
      - description: audio infra 26M clock

  clock-names:
    items:
      - const: clk26m
      - const: aud_afe
      - const: infra_ao_audio
      - const: infra_ao_audio_26m_b

  etdm-in1-chn-disabled:
    $ref: /schemas/types.yaml#/definitions/uint8-array
    maxItems: 24
    description: Specify which input channel should be disabled.

  etdm-in2-chn-disabled:
    $ref: /schemas/types.yaml#/definitions/uint8-array
    maxItems: 16
    description: Specify which input channel should be disabled.

patternProperties:
  "^etdm-in[1-2]-mclk-source$":
    $ref: /schemas/types.yaml#/definitions/uint32
    description: Specify etdm in mclk source clock.
    enum:
      - 0 # xtal_26m_ck
      - 1 # apll1_ck
      - 2 # apll2_ck
      - 3 # apll3_ck
      - 4 # apll4_ck
      - 5 # apll5_ck
      - 6 # hdmirx_apll_ck

  "^etdm-out[1-3]-mclk-source$":
    $ref: /schemas/types.yaml#/definitions/uint32
    description: Specify etdm out mclk source clock.

  "^etdm-in[1-2]-mclk-alwasys-on-rate$":
    $ref: /schemas/types.yaml#/definitions/uint32
    description: Specify etdm in mclk output rate for always on case.

  "^etdm-out[1-3]-mclk-alwasys-on-rate$":
    $ref: /schemas/types.yaml#/definitions/uint32
    description: Specify etdm out mclk output rate for always on case.

  "^etdm-in[1-2]-data-mode$":
    $ref: /schemas/types.yaml#/definitions/uint32
    description: Specify etdm in data mode.
    enum:
      - 0 # one pin (TDM)
      - 1 # multi pin (I2S)

  "^etdm-out[1-3]-data-mode$":
    $ref: /schemas/types.yaml#/definitions/uint32
    description: Specify etdm out data mode.

  "^etdm-in[1-2]-cowork-source$":
    $ref: /schemas/types.yaml#/definitions/uint32
    description: |
      etdm modules can share the same external clock pin. Specify
      which etdm clock source is required by this etdm in moudule.
    enum:
      - 0 # etdm1_in
      - 1 # etdm2_in
      - 2 # etdm1_out
      - 3 # etdm2_out
      - 4 # etdm3_out

  "^etdm-out[1-3]-cowork-source$":
    $ref: /schemas/types.yaml#/definitions/uint32
    description: |
      etdm modules can share the same external clock pin. Specify
      which etdm clock source is required by this etdm out moudule.

required:
  - compatible
  - interrupts
  - mediatek,topckgen
  - power-domains
  - clocks
  - clock-names

additionalProperties: false

examples:
  - |
    #include <dt-bindings/clock/mt8195-clk.h>
    #include <dt-bindings/interrupt-controller/arm-gic.h>
    #include <dt-bindings/interrupt-controller/irq.h>
    #include <dt-bindings/power/mt8195-power.h>

    afe: mt8195-afe-pcm {
        compatible = "mediatek,mt8195-audio";
        interrupts = <GIC_SPI 822 IRQ_TYPE_LEVEL_HIGH 0>;
        mediatek,topckgen = <&topckgen>;
        power-domains = <&spm MT8195_POWER_DOMAIN_AUDIO>;
        clocks = <&clk26m>,
                 <&audsys CLK_AUD_AFE>,
                 <&infracfg_ao CLK_INFRA_AO_AUDIO>,
                 <&infracfg_ao CLK_INFRA_AO_AUDIO_26M_B>;
        clock-names = "clk26m",
                      "aud_afe",
                      "infra_ao_audio",
                      "infra_ao_audio_26m_b";
    };

...
```

## Documentation/devicetree/bindings/sound/nvidia,tegra210-adx.yaml
```yaml
# SPDX-License-Identifier: (GPL-2.0-only OR BSD-2-Clause)
%YAML 1.2
---
$id: http://devicetree.org/schemas/sound/nvidia,tegra210-adx.yaml#
$schema: http://devicetree.org/meta-schemas/core.yaml#

title: Tegra210 ADX Device Tree Bindings

description: |
  The Audio Demultiplexer (ADX) block takes an input stream with   up to
  16 channels and demultiplexes it into four output streams of up to 16
  channels each. A byte RAM helps to form output frames by any combination
  of bytes from the input frame. Its design is identical to that of byte
  RAM in the AMX except that the data flow direction is reversed.

maintainers:
  - Jon Hunter <jonathanh@nvidia.com>
  - Mohan Kumar <mkumard@nvidia.com>
  - Sameer Pujar <spujar@nvidia.com>

properties:
  $nodename:
    pattern: "^adx@[0-9a-f]*$"

  compatible:
    oneOf:
      - const: nvidia,tegra210-adx
      - items:
          - enum:
              - nvidia,tegra194-adx
              - nvidia,tegra186-adx
          - const: nvidia,tegra210-adx

  reg:
    maxItems: 1

  sound-name-prefix:
    pattern: "^ADX[1-9]$"
    $ref: /schemas/types.yaml#/definitions/string
    description:
      used as prefix for sink/source names of the component. Must be a
      unique string among multiple instances of the same component.
      The name can be "ADX1" or "ADX2" ... "ADXx", where x depends on
      the maximum available instances on a Tegra SoC.

  ports:
    $ref: /schemas/graph.yaml#/properties/ports
    description: |
      ADX has one input and four output. Accordingly ACIF (Audio Client
      Interface) RX and TX port nodes are defined to represent ADX inputs
      and output respectively. These are connected to corresponding ports
      on AHUB.

    patternProperties:
      '^port@[0-9]':
        $ref: audio-graph-port.yaml#
        unevaluatedProperties: false

required:
  - compatible
  - reg

additionalProperties: false

examples:
  - |

    adx@702d3800 {
        compatible = "nvidia,tegra210-adx";
        reg = <0x702d3800 0x100>;
        sound-name-prefix = "ADX1";
    };

...
```
