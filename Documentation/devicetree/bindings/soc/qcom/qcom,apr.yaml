## Documentation/devicetree/bindings/soc/qcom/qcom,tcsr-ipq4019.yaml
```yaml
# SPDX-License-Identifier: (GPL-2.0 OR BSD-2-Clause)
%YAML 1.2
---
$id: "http://devicetree.org/schemas/soc/qcom/qcom,tcsr-ipq4019.yaml#"
$schema: "http://devicetree.org/meta-schemas/core.yaml#"

title: Qualcomm Top Control and Status Registers binding for IPQ4019

maintainers:
  - Ansuel Smith <ansuelsmth@gmail.com>

description: |
  This binding describes the Qualcomm Top Control and Status Registers, used
  for accessing configuration and mux settings for a variety of peripherals
  for ipq4019.

properties:
  compatible:
    items:
      - const: qcom,tcsr-ipq4019
      - const: syscon

  reg:
    maxItems: 1

  qcom,usb-hsphy-mode-select:
    description: Select usb hsphy mode for ipq4019
    enum:
      - 'host'
      - 'device'

  qcom,ess-interface-select:
    description: Select ess interface mode for ipq4019
    enum:
      - 'psgmii'
      - 'rgmii5'
      - 'rmii0'
      - 'rmii1'
      - 'rmii0_rmii1'
      - 'rgmii4'

  qcom,wifi-glb-cfg-enable-axid:
    description: Enable AXI master bus Axid translating
                  to confirm all txn submitted by order for ipq4019
    type: boolean

  qcom,wifi-glb-cfg-socslv-mode:
    description: Select wifi socslv mode for ipq4019
                  snoc use SNOC socslv_wxi_bvalid.
                  local use locally generate socslv_wxi_bvalid for performance.
    enum:
      - 'snoc'
      - 'local'

  qcom,wifi_noc_memtype_m0_m2:
    description: Configure special wifi memory type needed for
                  some IPQ40xx devicesfor ipq4019
    type: boolean

required:
  - compatible
  - reg

additionalProperties: false

examples:
  - |
    tcsr@194b000 {
      compatible = "qcom,tcsr-ipq4019", "syscon";
      reg = <0x194b000 0x100>;
      qcom,usb-hsphy-mode-select = "host";
    };

    tcsr@1949000 {
      compatible = "qcom,tcsr-ipq4019", "syscon";
      reg = <0x1949000 0x100>;
      qcom,wifi-glb-cfg-enable-axid;
      qcom,wifi-glb-cfg-socslv-mode = "local";
    };

    ess_tcsr@1953000 {
      compatible = "qcom,tcsr-ipq4019", "syscon";
      reg = <0x1953000 0x1000>;
      qcom,ess-interface-select = "psgmii";
    };

    tcsr@1957000 {
      compatible = "qcom,tcsr-ipq4019", "syscon";
      reg = <0x1957000 0x100>;
      qcom,wifi_noc_memtype_m0_m2;
    };

...
```

## Documentation/devicetree/bindings/soc/qcom/qcom,tcsr-ipq8064.yaml
```yaml
# SPDX-License-Identifier: (GPL-2.0 OR BSD-2-Clause)
%YAML 1.2
---
$id: "http://devicetree.org/schemas/soc/qcom/qcom,tcsr-ipq8064.yaml#"
$schema: "http://devicetree.org/meta-schemas/core.yaml#"

title: Qualcomm Top Control and Status Registers binding for IPQ8064

maintainers:
  - Ansuel Smith <ansuelsmth@gmail.com>

description: |
  This binding describes the Qualcomm Top Control and Status Registers, used
  for accessing configuration and mux settings for a variety of peripherals
  for ipq8064.

properties:
  compatible:
    items:
      - const: qcom,tcsr-ipq8064
      - const: syscon

  reg:
    maxItems: 1

  qcom,usb-ctrl-select:
    description: Select usb3 ctrl type for ipq8064
    enum:
      - 'p0'
      - 'p1'
      - 'dual'

required:
  - compatible
  - reg

additionalProperties: false

examples:
  - |
    tcsr: syscon@1a400000 {
      compatible = "qcom,tcsr-ipq8064", "syscon";
      reg = <0x1a400000 0x100>;
      qcom,usb-ctrl-select = "dual";
    };

...
```

## Documentation/devicetree/bindings/soc/rockchip/grf.yaml
```yaml
# SPDX-License-Identifier: GPL-2.0
%YAML 1.2
---
$id: http://devicetree.org/schemas/soc/rockchip/grf.yaml#
$schema: http://devicetree.org/meta-schemas/core.yaml#

title: Rockchip General Register Files

maintainers:
  - Heiko Stuebner <heiko@sntech.de>

properties:
  compatible:
    - items:
        - enum:
            - rockchip,px30-grf
            - rockchip,px30-pmugrf
            - rockchip,px30-usb2phy-grf
            - rockchip,rk3036-grf
            - rockchip,rk3066-grf
            - rockchip,rk3188-grf
            - rockchip,rk3228-grf
            - rockchip,rk3288-grf
            - rockchip,rk3288-sgrf
            - rockchip,rk3308-core-grf
            - rockchip,rk3308-detect-grf
            - rockchip,rk3308-grf
            - rockchip,rk3328-grf
            - rockchip,rk3328-usb2phy-grf
            - rockchip,rk3368-grf
            - rockchip,rk3368-pmugrf
            - rockchip,rk3399-grf
            - rockchip,rk3399-pmugrf
            - rockchip,rk3568-grf
            - rockchip,rk3568-pmugrf
            - rockchip,rv1108-grf
            - rockchip,rv1108-usbgrf
        - const: syscon
        - const: simple-mfd

  reg:
    maxItems: 1

required:
  - compatible
  - reg

additionalProperties: false

examples:
  - |
    pmugrf: syscon@ff320000 {
       compatible = "rockchip,rk3399-pmugrf", "syscon", "simple-mfd";
       reg = <0xff320000 0x1000>;
    };

    grf: syscon@ff770000 {
       compatible = "rockchip,rk3399-grf", "syscon", "simple-mfd";
       reg = <0xff770000 0x10000>;
    };
```

## Documentation/devicetree/bindings/soc/rockchip/io-domain.yaml
```yaml
# SPDX-License-Identifier: GPL-2.0
%YAML 1.2
---
$id: http://devicetree.org/schemas/soc/rockchip/io-domain.yaml#
$schema: http://devicetree.org/meta-schemas/core.yaml#

title: Rockchip SRAM for IO Voltage Domains

maintainers:
  - Heiko Stuebner <heiko@sntech.de>

properties:
  compatible:
    oneOf:
      - items:
          - enum:
            - rockchip,px30-io-voltage-domain
            - rockchip,px30-pmu-io-voltage-domain
            - rockchip,rk3188-io-voltage-domain
            - rockchip,rk3228-io-voltage-domain
            - rockchip,rk3288-io-voltage-domain
            - rockchip,rk3328-io-voltage-domain
            - rockchip,rk3368-io-voltage-domain
            - rockchip,rk3368-pmu-io-voltage-domain
            - rockchip,rk3399-io-voltage-domain
            - rockchip,rk3399-pmu-io-voltage-domain
            - rockchip,rv1108-io-voltage-domain
            - rockchip,rv1108-pmu-io-voltage-domain


examples:
  - |
    io-domains {
        compatible = "rockchip,rk3288-io-voltage-domain";

	audio-supply = <&vcc18_codec>;
	bb-supply = <&vcc33_io>;
	dvp-supply = <&vcc_18>;
	flash0-supply = <&vcc18_flashio>;
	gpio1830-supply = <&vcc33_io>;
	gpio30-supply = <&vcc33_pmuio>;
	lcdc-supply = <&vcc33_lcd>;
	sdcard-supply = <&vccio_sd>;
	wifi-supply = <&vcc18_wl>;
    };
```

## Documentation/devicetree/bindings/soc/rockchip/rockchip,power-controller.yaml
```yaml
# SPDX-License-Identifier: GPL-2.0-only OR BSD-2-Clause
# %YAML 1.2
---
$id: http://devicetree.org/soc/rockchip/rockchip,power-controller.yaml#
$schema: http://devicetree.org/meta-schemas/core.yaml#

title: Rcokchip Generic PM domains

maintainers:
  - Rob Herring <robh+dt@kernel.org>
  - Heiko Stuebner <heiko@sntech.de>

description: |
  Rockchip processors include support for multiple power domains which can be
  powered up/down by software based on different application scenes to save power.

  IP cores belonging to a power domain should contain a 'power-domains'
  property that is a phandle for SCPSYS node representing the domain.

properties:
  $nodename:
    const: power-controller

  compatible:
    enum:
      - rockchip,px30-power-controller
      - rockchip,rk3036-power-controller
      - rockchip,rk3066-power-controller
      - rockchip,rk3128-power-controller
      - rockchip,rk3188-power-controller
      - rockchip,rk3228-power-controller
      - rockchip,rk3288-power-controller
      - rockchip,rk3328-power-controller
      - rockchip,rk3366-power-controller
      - rockchip,rk3368-power-controller
      - rockchip,rk3399-power-controller
      - rockchip,rk3568-power-controller

  '#power-domain-cells':
    const: 1

  '#address-cells':
    const: 1

  '#size-cells':
    const: 0

patternProperties:
  "^power-domain@[0-9a-f]+$":
    type: object
    description: |
      Represents the power domains within the power controller node as documented
      in Documentation/devicetree/bindings/power/power-domain.yaml.

    properties:

      '#power-domain-cells':
        description:
          Must be 0 for nodes representing a single PM domain and 1 for nodes
          providing multiple PM domains.

      '#address-cells':
        const: 1

      '#size-cells':
        const: 0

      reg:
        description: |
          Power domain index. Valid values are defined in:
              "include/dt-bindings/power/px30-power.h" - for PX30 type power domain.
              "include/dt-bindings/power/rk3036-power.h" - for RK3036 type power domain.
              "include/dt-bindings/power/rk3066-power.h" - for RK3066 type power domain.
              "include/dt-bindings/power/rk3128-power.h" - for RK3128 type power domain.
              "include/dt-bindings/power/rk3188-power.h" - for RK3188 type power domain.
              "include/dt-bindings/power/rk3228-power.h" - for RK3228 type power domain.
              "include/dt-bindings/power/rk3288-power.h" - for RK3288 type power domain.
              "include/dt-bindings/power/rk3328-power.h" - for RK3328 type power domain.
              "include/dt-bindings/power/rk3366-power.h" - for RK3366 type power domain.
              "include/dt-bindings/power/rk3368-power.h" - for RK3368 type power domain.
              "include/dt-bindings/power/rk3399-power.h" - for RK3399 type power domain.
              "include/dt-bindings/power/rk3568-power.h" - for RK3568 type power domain.
        maxItems: 1

      clocks:
        description: |
          A number of phandles to clocks that need to be enabled during domain
          power-up sequencing.

      clock-names:
        description: |
          List of names of clocks, in order to match the power-up sequencing
          for each power domain we need to group the clocks by name. BASIC
          clocks need to be enabled before enabling the corresponding power
          domain.

      pm_qos:
        description: |
          A number of phandles for qos registers that need to be save and restor during domain
          power-up sequencing.

    additionalProperties: false

required:
  - compatible

additionalProperties: false

examples:
  - |
    pmu: power-management@fdd90000 {
        compatible = "rockchip,rk3568-pmu", "syscon", "simple-mfd";
        reg = <0xfdd90000 0x1000>;

        power: power-controller {
            compatible = "rockchip,rk3568-power-controller";
            #power-domain-cells = <1>;
            #address-cells = <1>;
            #size-cells = <0>;
            status = "okay";

            /* These power domains are grouped by VD_NPU */
            pd_npu@RK3568_PD_NPU {
                reg = <RK3568_PD_NPU>;
                clocks = <&cru ACLK_NPU_PRE>,
                         <&cru HCLK_NPU_PRE>,
                         <&cru PCLK_NPU_PRE>;
                pm_qos = <&qos_npu>;
            };
            /* These power domains are grouped by VD_GPU */
            pd_gpu@RK3568_PD_GPU {
                reg = <RK3568_PD_GPU>;
                clocks = <&cru ACLK_GPU_PRE>,
                         <&cru PCLK_GPU_PRE>;
                pm_qos = <&qos_gpu>;
            };
            /* These power domains are grouped by VD_LOGIC */
            pd_vi@RK3568_PD_VI {
                reg = <RK3568_PD_VI>;
                clocks = <&cru HCLK_VI>,
                         <&cru PCLK_VI>;
                pm_qos = <&qos_isp>,
                         <&qos_vicap0>,
                         <&qos_vicap1>;
            };
            pd_vo@RK3568_PD_VO {
                reg = <RK3568_PD_VO>;
                clocks = <&cru HCLK_VO>,
                         <&cru PCLK_VO>,
                         <&cru ACLK_VOP_PRE>;
                pm_qos = <&qos_hdcp>,
                         <&qos_vop_m0>,
                         <&qos_vop_m1>;
            };
            pd_rga@RK3568_PD_RGA {
                reg = <RK3568_PD_RGA>;
                clocks = <&cru HCLK_RGA_PRE>,
                         <&cru PCLK_RGA_PRE>;
                pm_qos = <&qos_ebc>,
                         <&qos_iep>,
                         <&qos_jpeg_dec>,
                         <&qos_jpeg_enc>,
                         <&qos_rga_rd>,
                         <&qos_rga_wr>;
            };
            pd_vpu@RK3568_PD_VPU {
                reg = <RK3568_PD_VPU>;
                clocks = <&cru HCLK_VPU_PRE>;
                pm_qos = <&qos_vpu>;
            };
            pd_rkvdec@RK3568_PD_RKVDEC {
                clocks = <&cru HCLK_RKVDEC_PRE>;
                reg = <RK3568_PD_RKVDEC>;
                pm_qos = <&qos_rkvdec>;
            };
            pd_rkvenc@RK3568_PD_RKVENC {
                reg = <RK3568_PD_RKVENC>;
                clocks = <&cru HCLK_RKVENC_PRE>;
                pm_qos = <&qos_rkvenc_rd_m0>,
                <&qos_rkvenc_rd_m1>,
                <&qos_rkvenc_wr_m0>;
            };
            pd_pipe@RK3568_PD_PIPE {
                reg = <RK3568_PD_PIPE>;
                clocks = <&cru PCLK_PIPE>;
                pm_qos = <&qos_pcie2x1>,
                         <&qos_pcie3x1>,
                         <&qos_pcie3x2>,
                         <&qos_sata0>,
                         <&qos_sata1>,
                         <&qos_sata2>,
                         <&qos_usb3_0>,
                         <&qos_usb3_1>;
            };
        };
    };
```

## Documentation/devicetree/bindings/sound/allwinner,sun50i-h6-dmic.yaml
```yaml
# SPDX-License-Identifier: (GPL-2.0+ OR BSD-2-Clause)
%YAML 1.2
---
$id: http://devicetree.org/schemas/sound/allwinner,sun50i-h6-dmic.yaml#
$schema: http://devicetree.org/meta-schemas/core.yaml#

title: Allwinner H6 DMIC Device Tree Bindings

maintainers:
  - Ban Tao <fengzheng923@gmail.com>

properties:
  "#sound-dai-cells":
    const: 0

  compatible:
    const: allwinner,sun50i-h6-dmic

  reg:
    maxItems: 1

  clocks:
    items:
      - description: Bus Clock
      - description: Module Clock

  clock-names:
    items:
      - const: bus
      - const: mod

  dmas:
    items:
      - description: RX DMA Channel

  dma-names:
    items:
      - const: rx

  resets:
    maxItems: 1

required:
  - "#sound-dai-cells"
  - compatible
  - reg
  - clocks
  - clock-names
  - dmas
  - dma-names
  - resets

additionalProperties: false

examples:
  - |
    dmic: dmic@5095000 {
      #sound-dai-cells = <0>;
      compatible = "allwinner,sun50i-h6-dmic";
      reg = <0x05095000 0x400>;
      clocks = <&ccu 101>, <&ccu 100>;
      clock-names = "bus", "mod";
      dmas = <&dma 7>;
      dma-names = "rx";
      resets = <&ccu 42>;
    };

...
```
