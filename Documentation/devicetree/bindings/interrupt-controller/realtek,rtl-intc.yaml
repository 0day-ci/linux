## Documentation/devicetree/bindings/interrupt-controller/realtek,rtl-intc.yaml
```yaml
# SPDX-License-Identifier: (GPL-2.0-only OR BSD-2-Clause)
%YAML 1.2
---
$id: http://devicetree.org/schemas/interrupt-controller/realtek,rtl-intc.yaml#
$schema: http://devicetree.org/meta-schemas/core.yaml#

title: Realtek RTL SoC interrupt controller devicetree bindings

description:
  Interrupt router for Realtek MIPS SoCs, allowing each SoC interrupt to be
  routed to one parent interrupt, or left disconnected.

maintainers:
  - Birger Koblitz <mail@birger-koblitz.de>
  - Bert Vermeulen <bert@biot.com>
  - John Crispin <john@phrozen.org>

properties:
  compatible:
    oneOf:
      - items:
          - enum:
              - realtek,rtl8380-intc
          - const: realtek,rtl-intc
      - const: realtek,rtl-intc
        deprecated: true

  "#interrupt-cells": true

  reg:
    maxItems: 1

  interrupts:
    minItems: 1
    maxItems: 15
    description:
      List of parent interrupts, in the order that they are connected to this
      interrupt router's outputs.

  interrupt-controller: true

required:
  - compatible
  - reg
  - "#interrupt-cells"
  - interrupt-controller

allOf:
  - if:
      properties:
        compatible:
          const: realtek,rtl-intc
    then:
      properties:
        "#interrupt-cells":
          const: 1

        "#address-cells":
          const: 0

        interrupt-map: true
      required:
        - "#address-cells"
        - interrupt-map
    else:
      properties:
        "#interrupt-cells":
          description:
            Two cells to specify which line to connect to, and which output it should
            be routed to. Both cells use a zero-based index.
          const: 2
      required:
        - interrupts

additionalProperties: false

examples:
  - |
    intc: interrupt-controller@3000 {
      compatible = "realtek,rtl8380-intc", "realtek,rtl-intc";
      #interrupt-cells = <2>;
      interrupt-controller;
      reg = <0x3000 0x18>;

      interrupt-parent = <&cpuintc>;
      interrupts = <2>, <3>, <4>, <5>, <6>;
    };

    irq-consumer@0 {
      reg = <0 4>;
      interrupt-parent = <&intc>;
      interrupts =
        <19 3>, /* IRQ 19, routed to output 3 (cpuintc 5) */
        <18 4>; /* IRQ 18, routed to output 4 (cpuintc 6) */
    };
```

## Documentation/devicetree/bindings/interrupt-controller/riscv,aclint-swi.yaml
```yaml
# SPDX-License-Identifier: (GPL-2.0-only OR BSD-2-Clause)
%YAML 1.2
---
$id: http://devicetree.org/schemas/interrupt-controller/riscv,aclint-swi.yaml#
$schema: http://devicetree.org/meta-schemas/core.yaml#

title: RISC-V ACLINT Software Interrupt Devices

maintainers:
  - Anup Patel <anup.patel@wdc.com>

description:
  RISC-V SOCs include an implementation of the M-level software interrupt
  (MSWI) device and the S-level software interrupt (SSWI) device defined
  in the RISC-V Advanced Core Local Interruptor (ACLINT) specification.

  The ACLINT MSWI and SSWI devices are documented in the RISC-V ACLINT
  specification located at
  https://github.com/riscv/riscv-aclint/blob/main/riscv-aclint.adoc.

  The ACLINT MSWI and SSWI devices directly connect to the M-level and
  S-level software interrupt lines of various HARTs (or CPUs) respectively
  so the RISC-V per-HART (or per-CPU) local interrupt controller is the
  parent interrupt controller for the ACLINT MSWI and SSWI devices.

allOf:
  - $ref: /schemas/interrupt-controller.yaml#

properties:
  compatible:
    oneOf:
      - items:
        - enum:
          - riscv,aclint-mswi

      - items:
        - enum:
          - riscv,aclint-sswi

    description:
      For ACLINT MSWI devices, it should be "riscv,aclint-mswi" OR
      "<vendor>,<chip>-aclint-mswi".
      For ACLINT SSWI devices, it should be "riscv,aclint-sswi" OR
      "<vendor>,<chip>-aclint-sswi".

  reg:
    maxItems: 1

  "#interrupt-cells":
    const: 0

  interrupts-extended:
    minItems: 1
    maxItems: 4095

  interrupt-controller: true

additionalProperties: false

required:
  - compatible
  - reg
  - interrupts-extended
  - interrupt-controller
  - "#interrupt-cells"

examples:
  - |
    // Example 1 (RISC-V MSWI device used by Linux RISC-V NoMMU kernel):

    interrupt-controller@2000000 {
      compatible = "riscv,aclint-mswi";
      interrupts-extended = <&cpu1intc 3>,
                            <&cpu2intc 3>,
                            <&cpu3intc 3>,
                            <&cpu4intc 3>;
      reg = <0x2000000 0x4000>;
      interrupt-controller;
      #interrupt-cells = <0>;
    };

  - |
    // Example 2 (RISC-V SSWI device used by Linux RISC-V MMU kernel):

    interrupt-controller@2100000 {
      compatible = "riscv,aclint-sswi";
      interrupts-extended = <&cpu1intc 1>,
                            <&cpu2intc 1>,
                            <&cpu3intc 1>,
                            <&cpu4intc 1>;
      reg = <0x2100000 0x4000>;
      interrupt-controller;
      #interrupt-cells = <0>;
    };
...
```

## Documentation/devicetree/bindings/interrupt-controller/sstar,ssd20xd-gpi.yaml
```yaml
# SPDX-License-Identifier: (GPL-2.0-only OR BSD-2-Clause)
%YAML 1.2
---
$id: http://devicetree.org/schemas/interrupt-controller/sstar,ssd20xd-gpi.yaml#
$schema: http://devicetree.org/meta-schemas/core.yaml#

title: SigmaStar GPIO Interrupt Controller

maintainers:
  - Daniel Palmer <daniel@thingy.jp>

description: |+
  Newer SigmaStar SoCs from the SSD201/SSD202D have an extra
  interrupt controller that is just for handling interrupts
  on GPIOs and then routing a single interrupt to the peripheral
  interrupt controller instead of only having a few interrupt
  capable GPIOs that are routed directly to the peripheral
  interrupt controller like older SoCs.

properties:
  compatible:
    const: sstar,ssd20xd-gpi

  interrupt-controller: true

  "#interrupt-cells":
    const: 2

  reg:
    maxItems: 1

  interrupts:
    maxItems: 1

required:
  - compatible
  - reg
  - interrupts

additionalProperties: false

examples:
  - |
    #include <dt-bindings/interrupt-controller/irq.h>
    #include <dt-bindings/interrupt-controller/arm-gic.h>
    interrupt-controller@207a00 {
      compatible = "sstar,ssd20xd-gpi";
      reg = <0x207a00 0x200>;
      #interrupt-cells = <2>;
      interrupt-controller;
      interrupts-extended = <&intc_irq GIC_SPI 56 IRQ_TYPE_LEVEL_HIGH>;
    };
...
```

## Documentation/devicetree/bindings/interrupt-controller/sunplus,sp7021-intc.yaml
```yaml
# SPDX-License-Identifier: (GPL-2.0-only OR BSD-2-Clause)
# Copyright (C) Sunplus Co., Ltd. 2021
%YAML 1.2
---
$id: http://devicetree.org/schemas/interrupt-controller/sunplus,sp7021-intc.yaml#
$schema: http://devicetree.org/meta-schemas/core.yaml#

title: Sunplus SP7021 SoC Interrupt Controller Device Tree Bindings

maintainers:
  - Qin Jian <qinjian@cqplus1.com>

properties:
  compatible:
    items:
      - const: sunplus,sp7021-intc

  interrupt-controller: true

  "#interrupt-cells":
    const: 2

  reg:
    maxItems: 1

  interrupts:
    description:
      Interrupts references to primary interrupt controller

  ext0-mask:
    description:
      cpu affinity of EXT_INT0.
    $ref: "/schemas/types.yaml#/definitions/uint32"
    minimum: 1
    maximum: 16

  ext1-mask:
    description:
      cpu affinity of EXT_INT1.
    $ref: "/schemas/types.yaml#/definitions/uint32"
    minimum: 1
    maximum: 16

required:
  - compatible
  - interrupt-controller
  - "#interrupt-cells"
  - reg
  - interrupts

additionalProperties: false

examples:
  - |
    #include <dt-bindings/interrupt-controller/arm-gic.h>

    intc: interrupt-controller@9c000780 {
        compatible = "sunplus,sp7021-intc";
        interrupt-controller;
        #interrupt-cells = <2>;
        reg = <0x9c000780 0x80>, <0x9c000a80 0x80>;
        interrupt-parent = <&gic>;
        interrupts = <GIC_SPI 5 IRQ_TYPE_LEVEL_HIGH>, /* EXT_INT0 */
                    <GIC_SPI 6 IRQ_TYPE_LEVEL_HIGH>; /* EXT_INT1 */
        ext0-mask = <0xf>; /* core0-3 */
        ext1-mask = <0xe>; /* core1-3 */
    };

...
```

## Documentation/devicetree/bindings/iommu/qcom,iommu-v0.yaml
```yaml
# SPDX-License-Identifier: (GPL-2.0-only OR BSD-2-Clause)
%YAML 1.2
---

$id: "http://devicetree.org/schemas/iommu/qcom,iommu-v0.yaml#"
$schema: "http://devicetree.org/meta-schemas/core.yaml#"

title: Qualcomm IOMMU for APQ8064

maintainers:
  - Will Deacon <will@kernel.org>

description: >
  The MSM IOMMU is an implementation compatible with the ARM VMSA short
  descriptor page tables. It provides address translation for bus masters
  outside of the CPU, each connected to the IOMMU through a port called micro-TLB.

properties:
  compatible:
    const: qcom,apq8064-iommu

  clocks:
    items:
      - description: interface clock for register accesses
      - description: functional clock for bus accesses

  clock-names:
    oneOf:
      - items:
          - const: smmu_pclk
          - const: smmu_clk
      - items:
          - const: smmu_pclk
          - const: iommu_clk
  reg:
    maxItems: 1

  interrupts:
    description: >
      Specifiers for the MMU fault interrupts. For instances that
      support secure mode two interrupts must be specified, for non-secure and
      secure mode, in that order. For instances that don't support secure mode a
      single interrupt must be specified.

  "#iommu-cells":
    const: 1

  qcom,ncb:
    $ref: /schemas/types.yaml#/definitions/uint32
    description: The total number of context banks in the IOMMU.

# Each bus master connected to an IOMMU must reference the IOMMU
# in its device node with the following property:
#   A reference to the IOMMU in multiple cells. The first cell is a
#   phandle to the IOMMU and the second cell is the stream id.
#   A single master device can be connected to more than one iommu
#   and multiple contexts in each of the iommu. So multiple entries
#   are required to list all the iommus and the stream ids that the
#   master is connected to.

required:
  - clocks
  - clock-names
  - reg
  - interrupts
  - qcom,ncb

additionalProperties: false

examples:
  - |
    #include <dt-bindings/clock/qcom,mmcc-msm8960.h>

    mdp_port0: iommu@7500000 {
            compatible = "qcom,apq8064-iommu";
            #iommu-cells = <1>;
            clock-names =
                "smmu_pclk",
                "smmu_clk";
            clocks =
                <&clk SMMU_AHB_CLK>,
                <&clk MDP_AXI_CLK>;
            reg = <0x07500000 0x100000>;
            interrupts =
                <0 63 0>,
                <0 64 0>;
            qcom,ncb = <2>;
    };

    /* mdp: mdp@5100000 {
            compatible = "qcom,mdp4";
            ...

            iommus = <&mdp_port0 0
                      &mdp_port0 2>;
    };*/
```

## Documentation/devicetree/bindings/iommu/rockchip,iommu.yaml
```yaml
# SPDX-License-Identifier: (GPL-2.0-only OR BSD-2-Clause)
%YAML 1.2
---
$id: http://devicetree.org/schemas/iommu/rockchip,iommu.yaml#
$schema: http://devicetree.org/meta-schemas/core.yaml#

title: Rockchip IOMMU

maintainers:
  - Simon Xue <xxm@rock-chips.com>

description: |+
  A Rockchip DRM iommu translates io virtual addresses to physical addresses for
  its master device. Each slave device is bound to a single master device, and
  shares its clocks, power domain and irq.

  For information on assigning IOMMU controller to its peripheral devices,
  see generic IOMMU bindings.

properties:
  compatible:
    enum:
      - rockchip,iommu
      - rockchip,iommu-v2

  reg:
    maxItems: 1

  interrupts:
    maxItems: 1

  interrupt-names:
    maxItems: 1

  clocks:
    items:
      - description: Core clock
      - description: Interface clock

  clock-names:
    items:
      - const: aclk
      - const: iface

  "#iommu-cells":
    const: 0

  rockchip,disable-mmu-reset:
    $ref: /schemas/types.yaml#/definitions/flag
    description: |
      Don't use the mmu reset operation.
      Some mmu instances may produce unexpected results
      when the reset operation is used.

required:
  - compatible
  - reg
  - interrupts
  - clocks
  - clock-names
  - "#iommu-cells"

additionalProperties: false

examples:
  - |
    #include <dt-bindings/clock/rk3399-cru.h>
    #include <dt-bindings/interrupt-controller/arm-gic.h>

    vopl_mmu: iommu@ff940300 {
      compatible = "rockchip,iommu";
      reg = <0xff940300 0x100>;
      interrupts = <GIC_SPI 16 IRQ_TYPE_LEVEL_HIGH>;
      interrupt-names = "vopl_mmu";
      clocks = <&cru ACLK_VOP1>, <&cru HCLK_VOP1>;
      clock-names = "aclk", "iface";
      #iommu-cells = <0>;
    };
```

## Documentation/devicetree/bindings/iommu/samsung,sysmmu-v8.txt
```
Example (Exynos850, IOMMU for DPU usage):

	#include <dt-bindings/soc/samsung,sysmmu-v8.h>

	/* IOMMU group info */
	iommu_group_dpu: iommu_group_dpu {
		compatible = "samsung,sysmmu-group";
	};

	sysmmu_dpu: sysmmu@130c0000 {
		compatible = "samsung,sysmmu-v8";
		reg = <0x130c0000 0x9000>;
		interrupts = <GIC_SPI 122 IRQ_TYPE_LEVEL_HIGH>,
			     <GIC_SPI 123 IRQ_TYPE_LEVEL_HIGH>;
		qos = <15>;

		clocks = <&cmu_dpu CLK_GOUT_DPU_SMMU_CLK>;
		clock-names = "gate";

		sysmmu,secure-irq;
		sysmmu,secure_base = <0x130d0000>;
		sysmmu,default_tlb = <TLB_CFG(BL1, PREFETCH_PREDICTION)>;
		sysmmu,tlb_property =
			<1 TLB_CFG(BL1, PREFETCH_PREDICTION) (DIR_READ | (1 << 16)) SYSMMU_ID_MASK(0x2, 0xF)>,
			<2 TLB_CFG(BL1, PREFETCH_PREDICTION) (DIR_READ | (1 << 16)) SYSMMU_ID_MASK(0x4, 0xF)>,
			<3 TLB_CFG(BL1, PREFETCH_PREDICTION) (DIR_READ | (1 << 16)) SYSMMU_ID_MASK(0x6, 0xF)>,
			<4 TLB_CFG(BL1, PREFETCH_PREDICTION) (DIR_READ | (1 << 16)) SYSMMU_ID_MASK(0x8, 0xF)>;
		port-name = "DPU";
		#iommu-cells = <0>;
		//power-domains = <&pd_dpu>;
	};
```

## Documentation/devicetree/bindings/ipmi/aspeed-ssif-bmc.txt
```
# Aspeed SSIF (SMBus system interface) IPMI BMC interface

The Aspeed AST2500 are commonly used as BMCs (Baseboard Management Controllers)
and the SSIF slave interface can be used to perform in-band IPMI communication
with their host.

Required properties:

- compatible : should be
       "aspeed,ast2500-ssif-bmc"
- reg: I2C address the registers

Example:

       ssif-bmc@10 {
               compatible = "aspeed,ast2500-ssif-bmc";
               reg = <0x10>;
       };
```

## Documentation/devicetree/bindings/ipmi/hpegxp-kcs-bmc-cfg.txt
```
* HPE GXP KCS IPMI DRIVER

Required properties:
- compatible : Must contain "hpe,gxp-kcs-bmc-cfg", "simple-mfd", "syscon".
- reg : Specifies base physical address and size of the configuration registers.

Example:

	kcs_conf: kcs_conf@80fc0430 {
			compatible = "hpe,gxp-kcs-bmc-cfg", "simple-mfd", "syscon";
			reg = <0x80fc0430 0x100>;
	};
```

## Documentation/devicetree/bindings/ipmi/hpegxp-kcs-bmc.txt
```
* HPE GXP KCS IPMI DRIVER

Required properties:
- compatible : Must contain "hpe,gxp-kcs-bmc".
- interrupts : The interrupt number.
- reg : Specifies base physical address and size of the control registers.
- kcs_chan : The KCS channel number in the controller.
- status: The status signal from the controller.
- kcs-bmc-cfg = Phandle to the KCS Configuration registers.

Example:

	kcs_reg: kcs_reg@80fd0400 {
		compatible = "hpe,gxp-kcs-bmc";
		reg = <0x80fd0400 0x8>;
		interrupts = <6>;
		interrupt-parent = <&vic1>;
		kcs_chan = <1>;
		status = "okay";
		kcs-bmc-cfg = <&kcs_conf>;
	};
```
