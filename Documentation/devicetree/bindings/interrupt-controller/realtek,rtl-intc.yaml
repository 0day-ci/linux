## Documentation/devicetree/bindings/media/i2c/isil,isl79987.yaml
```yaml
# SPDX-License-Identifier: (GPL-2.0-only OR BSD-2-Clause)
%YAML 1.2
---
$id: http://devicetree.org/schemas/media/i2c/isil,isl79987.yaml#
$schema: http://devicetree.org/meta-schemas/core.yaml#

title: Intersil ISL79987 Analog to MIPI CSI-2 decoder

maintainers:
  - Michael Tretter <m.tretter@pengutronix.de>
  - Marek Vasut <marex@denx.de>

description:
  The Intersil ISL79987 is an analog to MIPI CSI-2 decoder which is capable of
  receiving up to four analog stream and multiplexing them into up to four MIPI
  CSI-2 virtual channels, using one MIPI clock lane and 1/2 data lanes.

properties:
  compatible:
    enum:
      - isil,isl79987

  reg:
    maxItems: 1

  reset-gpios:
    maxItems: 1
    description:
      A GPIO spec for the RSTB pin (active high)

  pd-gpios:
    maxItems: 1
    description:
      A GPIO spec for the Power Down pin (active high)

  ports:
    type: object
    description:
      A node containing input and output port nodes with endpoint definitions
      as documented in
      Documentation/devicetree/bindings/media/video-interfaces.txt
    properties:
      '#address-cells':
        const: 1
      '#size-cells':
        const: 0
      port@0:
        type: object
        description: Output port

    patternProperties:
      "^port@[1-4]$":
        type: object
        description: Input ports

    required:
      - port@0

additionalProperties: false

required:
  - compatible
  - reg
  - ports

examples:
  - |
    #include <dt-bindings/gpio/gpio.h>

    i2c {
      #address-cells = <1>;
      #size-cells = <0>;

      isl7998x_mipi@44 {
        compatible = "isil,isl79987";
        reg = <0x44>;
        pd-gpios = <&gpio3 27 GPIO_ACTIVE_HIGH>;
        reset-gpios = <&gpio3 28 GPIO_ACTIVE_HIGH>;

        ports {
          #address-cells = <1>;
          #size-cells = <0>;

          port@0 {
            reg = <0>;
            isl79987_out: endpoint {
              remote-endpoint = <&mipi_csi2_in>;
              clock-lanes = <0>;
              data-lanes = <1 2>;
            };
          };

          port@1 {
            reg = <1>;
            endpoint {
              remote-endpoint = <&camera_0>;
            };
          };

          port@2 {
            reg = <2>;
            endpoint {
              remote-endpoint = <&camera_1>;
            };
          };
        };
      };
    };
```

## Documentation/devicetree/bindings/media/i2c/mt9p031.txt
```
* Aptina 1/2.5-Inch 5Mp CMOS Digital Image Sensor

The Aptina MT9P031 is a 1/2.5-inch CMOS active pixel digital image sensor with
an active array size of 2592H x 1944V. It is programmable through a simple
two-wire serial interface.

Required Properties:
- compatible: value should be either one among the following
	(a) "aptina,mt9p031" for mt9p031 sensor
	(b) "aptina,mt9p031m" for mt9p031m sensor

- clocks: Reference to the sensor input clock

- vdd-supply: VDD supply regulator
- vdd_io-supply: VDD_IO supply regulator
- vaa-supply: VAA supply regulator

- input-clock-frequency: Input clock frequency.

- pixel-clock-frequency: Pixel clock frequency.

Optional Properties:
- reset-gpios: Chip reset GPIO

Optional endpoint properties:
- pclk-sample: For information see ../video-interfaces.txt. The value is set to
  0 if it isn't specified.

For further reading on port node refer to
Documentation/devicetree/bindings/media/video-interfaces.txt.

Example:

	i2c0@1c22000 {
		...
		...
		mt9p031@5d {
			compatible = "aptina,mt9p031";
			reg = <0x5d>;
			reset-gpios = <&gpio3 30 0>;

			clocks = <&sensor_clk>;

			vdd-supply = <&reg_vdd>;
			vdd_io-supply = <&reg_vdd_io>;
			vaa-supply = <&reg_vaa>;

			port {
				mt9p031_1: endpoint {
					input-clock-frequency = <6000000>;
					pixel-clock-frequency = <96000000>;
					pclk-sample = <1>;
				};
			};
		};
		...
	};
```

## Documentation/devicetree/bindings/media/i2c/onnn,ar0521.yaml
```yaml
# SPDX-License-Identifier: (GPL-2.0-only OR BSD-2-Clause)
%YAML 1.2
---
$id: http://devicetree.org/schemas/media/i2c/onnn,ar0521.yaml#
$schema: http://devicetree.org/meta-schemas/core.yaml#

title: ON Semiconductor AR0521 MIPI CSI-2 sensor

maintainers:
  - Krzysztof Halasa <khalasa@piap.pl>

description: |-
  The AR0521 is a raw CMOS image sensor with MIPI CSI-2 and
  I2C-compatible control interface.

properties:
  compatible:
    const: on-semi,ar0521

  reg:
    description: I2C bus address of the sensor device
    maxItems: 1

  clocks:
    description: reference to the xclk clock
    maxItems: 1

  clock-names:
    const: xclk

  reset-gpios:
    description: active low reset GPIO
    maxItems: 1

  port:
    type: object
    description: |
      Output video port: 1, 2 or 4 lanes. See ../video-interfaces.txt.

required:
  - compatible
  - reg
  - clocks
  - clock-names
  - port

additionalProperties: false

examples:
  - |
    #include <dt-bindings/gpio/gpio.h>
    #include <dt-bindings/clock/imx6qdl-clock.h>

    i2c {
            #address-cells = <1>;
            #size-cells = <0>;

            ar0521: camera-sensor@36 {
                    compatible = "onnn,ar0521";
                    reg = <0x36>;
                    pinctrl-names = "default";
                    pinctrl-0 = <&pinctrl_mipi_camera>;

                    clocks = <&clks IMX6QDL_CLK_CKO>;
                    clock-names = "xclk";

                    reset-gpios = <&gpio1 7 GPIO_ACTIVE_LOW>;

                    port {
                           mipi_camera_to_mipi_csi2: endpoint {
                                    remote-endpoint = <&mipi_csi2_in>;
                                    data-lanes = <1 2 3 4>;
                            };
                    };
            };
    };
```

## Documentation/devicetree/bindings/media/i2c/ov5670.yaml
```yaml
# SPDX-License-Identifier: (GPL-2.0-only OR BSD-2-Clause)
%YAML 1.2
---
$id: http://devicetree.org/schemas/media/i2c/ov5670.yaml#
$schema: http://devicetree.org/meta-schemas/core.yaml#

title: Omnivision OV5670 5 Megapixels raw image sensor

maintainers:
  - Jacopo Mondi <jacopo@jmondi.org>

description: |-
  The OV5670 is a 5 Megapixels raw image sensor which provides images in 10-bits
  RAW BGGR Bayer format on a 2 data lanes MIPI CSI-2 serial interface and is
  controlled through an I2C compatible control bus.

properties:
  compatible:
    const: ovti,ov5670

  reg:
    maxItems: 1

  clock-frequency:
    description: Frequency of the xclk clock.

  pwdn-gpios:
    description: Reference to the GPIO connected to the PWDNB pin. Active low.

  reset-gpios:
    description:
      Reference to the GPIO connected to the XSHUTDOWN pin. Active low.

  avdd-supply:
    description: Analog circuit power. Typically 2.8V.

  dvdd-supply:
    description: Digital circuit power. Typically 1.2V.

  dovdd-supply:
    description: Digital I/O circuit power. Typically 2.8V or 1.8V.

  port:
    $ref: /schemas/graph.yaml#/$defs/port-base
    additionalProperties: false

    properties:
      endpoint:
        $ref: /schemas/media/video-interfaces.yaml#
        unevaluatedProperties: false

        properties:
          data-lanes:
            description: The sensor supports 1 or 2 data lanes operations.
            minItems: 1
            maxItems: 2
            items:
              maximum: 2

          clock-noncontinuous: true

required:
  - compatible
  - reg
  - clock-frequency
  - port

additionalProperties: false

examples:
  - |
    i2c0 {
        #address-cells = <1>;
        #size-cells = <0>;

        ov5670: sensor@36 {
            compatible = "ovti,ov5670";
            reg = <0x36>;

            clock-frequency=<19200000>;

            port {
                endpoint {
                    remote-endpoint = <&csi_ep>;
                    data-lanes = <1 2>;
                    clock-noncontinuous;
                };
            };
        };
    };

...
```
