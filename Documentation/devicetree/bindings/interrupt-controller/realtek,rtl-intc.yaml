## Documentation/devicetree/bindings/leds/backlight/dp-aux-backlight.yaml
```yaml
# SPDX-License-Identifier: (GPL-2.0-only OR BSD-2-Clause)
%YAML 1.2
---
$id: http://devicetree.org/schemas/leds/backlight/dp-aux-backlight.yaml#
$schema: http://devicetree.org/meta-schemas/core.yaml#

title: DisplayPort aux backlight driver bindings

maintainers:
  - Rajeev Nandan <rajeevny@codeaurora.org>

description:
  Backlight driver to control the brightness over DisplayPort aux channel.

allOf:
  - $ref: common.yaml#

properties:
  compatible:
    const: dp-aux-backlight

  ddc-i2c-bus:
    $ref: /schemas/types.yaml#/definitions/phandle
    description:
      A phandle to the system I2C controller connected to the DDC bus used
      for the DisplayPort AUX channel.

  enable-gpios:
    maxItems: 1
    description: GPIO specifier for backlight enable pin.

  max-brightness: true

required:
  - compatible
  - ddc-i2c-bus

additionalProperties: false

examples:
  - |
    backlight {
        compatible = "dp-aux-backlight";
        ddc-i2c-bus = <&sn65dsi86_bridge>;
        enable-gpios = <&tlmm 12 GPIO_ACTIVE_HIGH>;
        max-brightness = <2047>;
    };

...
```

## Documentation/devicetree/bindings/leds/backlight/ti,lp8550.yaml
```yaml
# SPDX-License-Identifier: (GPL-2.0-only OR BSD-2-Clause)
%YAML 1.2
---
$id: http://devicetree.org/schemas/leds/backlight/ti,lp8550.yaml#
$schema: http://devicetree.org/meta-schemas/core.yaml#

title: Texas Instruments LP855x family devicetree bindings

maintainers:
  - Milo Kim <milo.kim@ti.com>
  - Rob Herring <robh+dt@kernel.org>

properties:
  compatible:
    enum:
      - ti,lp8550
      - ti,lp8551
      - ti,lp8552
      - ti,lp8553
      - ti,lp8555
      - ti,lp8556
      - ti,lp8557

  reg:
    maxItems: 1

  dev-ctrl:
    $ref: /schemas/types.yaml#/definitions/uint8
    description: Value of DEVICE CONTROL register. It depends on the device.

  bl-name:
    $ref: /schemas/types.yaml#/definitions/string
    description: Backlight device name

  init-brt:
    $ref: /schemas/types.yaml#/definitions/uint8
    description: Initial value of backlight brightness

  pwm-period:
    $ref: /schemas/types.yaml#/definitions/uint32
    description: PWM period value. Set only PWM input mode used

  pwm-names:
    maxItems: 1

  pwms:
    maxItems: 1

  power-supply:
    description: Regulator which controls the 3V rail

  enable-supply:
    description: Regulator which controls the EN/VDDIO input

patternProperties:
  '^rom_[0-9a-f]{2}h$':
    type: object
    properties:
      rom-addr:
        $ref: /schemas/types.yaml#/definitions/uint8
        description: Register address of ROM area to be updated

      rom-val:
        $ref: /schemas/types.yaml#/definitions/uint8
        description: Register value to be updated

    additionalProperties: false

    required:
      - rom-addr
      - rom-val

additionalProperties: false

required:
  - compatible
  - reg
  - dev-ctrl

examples:
  # LP8555
  - |
    i2c {
      #address-cells = <1>;
      #size-cells = <0>;

      backlight@2c {
        compatible = "ti,lp8555";
        reg = <0x2c>;

        dev-ctrl = /bits/ 8 <0x00>;
        pwm-period = <10000>;

        /* 4V OV, 4 output LED0 string enabled */
        rom_14h {
          rom-addr = /bits/ 8 <0x14>;
          rom-val = /bits/ 8 <0xcf>;
        };

        /* Heavy smoothing, 24ms ramp time step */
        rom_15h {
          rom-addr = /bits/ 8 <0x15>;
          rom-val = /bits/ 8 <0xc7>;
        };

        /* 4 output LED1 string enabled */
        rom_19h {
          rom-addr = /bits/ 8 <0x19>;
          rom-val = /bits/ 8 <0x0f>;
        };
      };
    };

  # LP8556
  - |
    i2c {
      #address-cells = <1>;
      #size-cells = <0>;

      backlight@2c {
        compatible = "ti,lp8556";
        reg = <0x2c>;

        bl-name = "lcd-bl";
        dev-ctrl = /bits/ 8 <0x85>;
        init-brt = /bits/ 8 <0x10>;
      };
    };

  # LP8557
  - |
    i2c {
      #address-cells = <1>;
      #size-cells = <0>;

      backlight@2c {
        compatible = "ti,lp8557";
        reg = <0x2c>;
        enable-supply = <&backlight_vddio>;
        power-supply = <&backlight_vdd>;

        dev-ctrl = /bits/ 8 <0x41>;
        init-brt = /bits/ 8 <0x0a>;

        /* 4V OV, 4 output LED string enabled */
        rom_14h {
          rom-addr = /bits/ 8 <0x14>;
          rom-val = /bits/ 8 <0xcf>;
        };
      };
    };
```

## Documentation/devicetree/bindings/leds/leds-ktd20xx.yaml
```yaml
# SPDX-License-Identifier: (GPL-2.0-only OR BSD-2-Clause)
%YAML 1.2
---
$id: http://devicetree.org/schemas/leds/leds-ktd20xx.yaml#
$schema: http://devicetree.org/meta-schemas/core.yaml#

title: LED driver for KTD20xx RGB LED from Kinetic.

maintainers:
  - Florian Eckert <fe@dev.tdt.de>

description: |
  The KTD20XX is multi-channel, I2C LED driver. Into can control up to 12
  LEDs per device. The RGB value can be set for each LED. Due to hardware
  limitations, the full RGB range cannot be used. Only 7 colors and the
  color black can be set (black means off).
  R G B
  0 0 0 = Black (off)
  0 0 1 = Blue
  0 1 0 = Green
  0 1 1 = Cyan
  1 0 0 = Red
  1 0 1 = Magenta
  1 1 0 = Yellow
  1 1 1 = White

properties:
  compatible:
    enum:
      - kinetic,ktd20xx

  reg:
    maxItems: 1
    description:
      I2C slave address
      ktd2061/58/59/60 0x68 0x69 0x6A 0x6B

  '#address-cells':
    const: 1

  '#size-cells':
    const: 0

  'kinetic,led-current':
    $ref: /schemas/types.yaml#/definitions/uint8
    description:
      This value is a current setting for all LEDs connected to this device.
      If this value is not set then the default value off 0x28 (5mA) is set.
      This means all LEDs get 5mA. The max value is 24mA. We have the following
      mapping in 125uA steps. We can set a maximum of 24mA.
      0000 0000 (0x00) = 0uA
      0000 0001 (0x01) = 125uA
      .... ....
      0010 1000 (0x28) = 5mA
      .... ....
      1100 0000 (0xC0) = 24mA
      1100 0001 (0xC1) = 24mA
      .... ....
      1111 1111 (0xFF) = 24mA
    minimum: 0
    maximum: 255

patternProperties:
  '^multi-led@[0-9a-f]$':
    type: object
    allOf:
      - $ref: leds-class-multicolor.yaml#
    description:
      This node represents one of the Multicolor LED. No subnodes need to
      be added for subchannels since this controller only supports 1bit
      RGB values. We could display seven different colors and the color
      black which means off.

    properties:
      reg:
        minimum: 0
        maximum: 11
        description:
          This property identifies wired connection of the LED to this device.
          0x00  LEDA1
          0x01  LEDA2
          0x02  LEDA3
          0x03  LEDA4
          0x04  LEDB1
          0x05  LEDB2
          0x06  LEDB3
          0x07  LEDB4
          0x08  LEDC1
          0x09  LEDC2
          0x0A  LEDC3
          0x0B  LEDC4

required:
  - compatible
  - reg

additionalProperties: false

examples:
  - |
   #include <dt-bindings/leds/common.h>

   i2c {
       #address-cells = <1>;
       #size-cells = <0>;

       led-controller@14 {
           compatible = "kinetic,ktd20xx";
           reg = <0x68>;
           #address-cells = <1>;
           #size-cells = <0>;
           kinetic,led-current = <0x28>; // Current for all LEDs is 5mA

           multi-led@0 {
               reg = <0x0>;
               color = <LED_COLOR_ID_MULTI>;
               function = LED_FUNCTION_CHARGING;
               linux,default-trigger = "default-on";
          };

          multi-led@2 {
            reg = <0x2>;
            color = <LED_COLOR_ID_MULTI>;
            function = LED_FUNCTION_STANDBY;
            linux,default-trigger = "default-on";
         };
       };
    };

...
```

## Documentation/devicetree/bindings/leds/leds-multi-gpio.yaml
```yaml
# SPDX-License-Identifier: GPL-2.0
%YAML 1.2
---
$id: http://devicetree.org/schemas/leds/leds-multi-gpio.yaml#
$schema: http://devicetree.org/meta-schemas/core.yaml#

title: Multiple GPIOs LED driver

maintainers:
  - Hermes Zhang <chenhuiz@axis.com>

description:
  This will support some LED made of multiple GPIOs and the brightness of the
  LED could map to different states of the GPIOs.

properties:
  compatible:
    const: multi-gpio-led

  led-gpios:
    description: Array of one or more GPIOs pins used to control the LED.
    minItems: 1
    maxItems: 8  # Should be enough

  led-states:
    description: |
      The array list the supported states here which will map to brightness
      from 0 to maximum. Each item in the array will present all the GPIOs
      value by bit.
    $ref: /schemas/types.yaml#/definitions/uint8-array
    minItems: 1
    maxItems: 256 # Should be enough

required:
  - compatible
  - led-gpios
  - led-states

additionalProperties: false

examples:
  - |
    gpios-led {
      compatible = "multi-gpio-led";

      led-gpios = <&gpio0 23 0x1>,
                  <&gpio0 24 0x1>;
      led-states = /bits/ 8 <0x00 0x01 0x02 0x03>;
    };
...
```

## Documentation/devicetree/bindings/leds/leds-pwm-multicolor.yaml
```yaml
# SPDX-License-Identifier: (GPL-2.0-only OR BSD-2-Clause)
%YAML 1.2
---
$id: http://devicetree.org/schemas/leds/leds-pwm-multicolor.yaml#
$schema: http://devicetree.org/meta-schemas/core.yaml#

title: Multi-color LEDs connected to PWM

maintainers:
  - Sven Schwermer <sven.schwermer@disruptive-technologies.com>

description: |
  This driver combines several monochrome PWM LEDs into one multi-color
  LED using the multicolor LED class.

properties:
  compatible: pwm-leds-multicolor

patternProperties:
  '^multi-led@[0-9a-f]$':
    type: object
    allOf:
      - $ref: leds-class-multicolor.yaml#

    patternProperties:
      "^led-[0-9a-z]+$":
        type: object
        properties:
          pwms:
            maxItems: 1

          pwm-names: true

          color:
            $ref: common.yaml#/properties/color

required:
  - compatible
  - pwms
  - color

additionalProperties: false

examples:
  - |
    #include <dt-bindings/leds/common.h>

    rgb-led {
        compatible = "pwm-leds-multicolor";

        multi-led@0 {
          color = <LED_COLOR_ID_RGB>;
          function = LED_FUNCTION_INDICATOR;
          max-brightness = <65535>;

          led-red {
              pwms = <&pwm1 0 1000000>;
              color = <LED_COLOR_ID_RED>;
          };

          led-green {
              pwms = <&pwm2 0 1000000>;
              color = <LED_COLOR_ID_GREEN>;
          };

          led-blue {
              pwms = <&pwm3 0 1000000>;
              color = <LED_COLOR_ID_BLUE>;
          };
        };
    };

...
```
