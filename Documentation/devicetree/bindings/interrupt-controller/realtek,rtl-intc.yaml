## Documentation/devicetree/bindings/leds/realtek,rtl8231-leds.yaml
```yaml
# SPDX-License-Identifier: GPL-2.0-only OR BSD-2-Clause
%YAML 1.2
---
$id: http://devicetree.org/schemas/leds/realtek,rtl8231-leds.yaml#
$schema: http://devicetree.org/meta-schemas/core.yaml#

title: Realtek RTL8231 LED scan matrix.

maintainers:
  - Sander Vanheule <sander@svanheule.net>

description: |
  The RTL8231 has support for driving a number of LED matrices, by scanning
  over the LEDs pins, alternatingly lighting different columns and/or rows.

  In single color scan mode, 88 LEDs are supported. These are grouped into
  three output matrices:
    - Group A of 6×6 single color LEDs. Rows and columns are driven by GPIO
      pins 0-11.
               L0[n]    L1[n]    L2[n]    L0[n+6]  L1[n+6]  L2[n+6]
                |        |        |        |        |        |
       P0/P6  --<--------<--------<--------<--------<--------< (3)
                |        |        |        |        |        |
       P1/P7  --<--------<--------<--------<--------<--------< (4)
                |        |        |        |        |        |
       P2/P8  --<--------<--------<--------<--------<--------< (5)
                |        |        |        |        |        |
       P3/P9  --<--------<--------<--------<--------<--------< (6)
                |        |        |        |        |        |
       P4/P10 --<--------<--------<--------<--------<--------< (7)
                |        |        |        |        |        |
       P5/P11 --<--------<--------<--------<--------<--------< (8)
               (0)      (1)      (2)      (9)     (10)     (11)
    - Group B of 6×6 single color LEDs. Rows and columns are driven by GPIO
      pins 12-23.
               L0[n]    L1[n]    L2[n]    L0[n+6]  L1[n+6]  L2[n+6]
                |        |        |        |        |        |
      P12/P18 --<--------<--------<--------<--------<--------< (15)
                |        |        |        |        |        |
      P13/P19 --<--------<--------<--------<--------<--------< (16)
                |        |        |        |        |        |
      P14/P20 --<--------<--------<--------<--------<--------< (17)
                |        |        |        |        |        |
      P15/P21 --<--------<--------<--------<--------<--------< (18)
                |        |        |        |        |        |
      P16/P22 --<--------<--------<--------<--------<--------< (19)
                |        |        |        |        |        |
      P17/P23 --<--------<--------<--------<--------<--------< (20)
              (12)     (13)     (14)    (21)      (22)     (23)
    - Group C of 8 pairs of anti-parallel (or bi-color) LEDs. LED selection is
      provided by GPIO pins 24-27 and 29-32, polarity selection by GPIO 28.
               P24     P25  ...  P30     P31
                |       |         |       |
      LED POL --X-------X---/\/---X-------X (28)
              (24)    (25)  ... (31)    (32)

  In bi-color scan mode, 72 LEDs are supported. These are grouped into four
  output matrices:
    - Group A of 12 pairs of anti-parallel LEDs. LED selection is provided
      by GPIO pins 0-11, polarity selection by GPIO 12.
    - Group B of 6 pairs of anti-parallel LEDs. LED selection is provided
      by GPIO pins 23-28, polarity selection by GPIO 21.
    - Group C of 6 pairs of anti-parallel LEDs. LED selection is provided
      by GPIO pins 29-34, polarity selection by GPIO 22.
    - Group of 4×6 single color LEDs. Rows are driven by GPIO pins 15-20,
      columns by GPIO pins 13-14 and 21-22 (shared with groups B and C).
          P[n]     P[n+6]   P[n+12]  P[n+18]
            |        |        |        |
       +0 --<--------<--------<--------< (15)
            |        |        |        |
       +1 --<--------<--------<--------< (16)
            |        |        |        |
       +2 --<--------<--------<--------< (17)
            |        |        |        |
       +3 --<--------<--------<--------< (18)
            |        |        |        |
       +4 --<--------<--------<--------< (19)
            |        |        |        |
       +6 --<--------<--------<--------< (20)
          (13)     (14)     (21)     (22)

  This node must always be a child of a 'realtek,rtl8231' node.

properties:
  $nodename:
    const: leds

  compatible:
    const: realtek,rtl8231-leds

  "#address-cells":
    const: 2

  "#size-cells":
    const: 0

  realtek,led-scan-mode:
    $ref: /schemas/types.yaml#/definitions/string
    description: |
      Specify the scanning mode the chip should run in. See general description
      for how the scanning matrices are wired up.
    enum: ["single-color", "bi-color"]

patternProperties:
  "^led@[0-9]+,[0-2]$":
    description: |
      LEDs are addressed by their port index and led index. Ports 0-23 always
      support three LEDs. Additionally, but only when used in single color scan
      mode, ports 24-31 support two LEDs.
    type: object

    properties:
      reg:
        maxItems: 1

    allOf:
      - $ref: ../leds/common.yaml#

    required:
      - reg

required:
  - compatible
  - "#address-cells"
  - "#size-cells"
  - realtek,led-scan-mode

additionalProperties: false

examples:
  - |
    #include <dt-bindings/leds/common.h>
    leds {
        compatible = "realtek,rtl8231-leds";
        #address-cells = <2>;
        #size-cells = <0>;

        realtek,led-scan-mode = "single-color";

        led@0,0 {
            reg = <0 0>;
            color = <LED_COLOR_ID_GREEN>;
            function = LED_FUNCTION_LAN;
            function-enumerator = <0>;
        };

        led@0,1 {
            reg = <0 1>;
            color = <LED_COLOR_ID_AMBER>;
            function = LED_FUNCTION_LAN;
            function-enumerator = <0>;
        };

        led@0,2 {
            reg = <0 2>;
            color = <LED_COLOR_ID_GREEN>;
            function = LED_FUNCTION_STATUS;
        };
    };
```

## Documentation/devicetree/bindings/mailbox/mtk,adsp-mbox.yaml
```yaml
# SPDX-License-Identifier: (GPL-2.0-only OR BSD-2-Clause)
%YAML 1.2
---
$id: http://devicetree.org/schemas/mailbox/mtk,adsp-mbox.yaml#
$schema: http://devicetree.org/meta-schemas/core.yaml#

title: Mediatek ADSP mailbox

maintainers:
  - Allen-KH Cheng <Allen-KH.Cheng@mediatek.com>

description: |
  The MTK ADSP mailbox Inter-Processor Communication (IPC) enables the SoC
  to ommunicate with ADSP by passing messages through two mailbox channels.
  The MTK ADSP mailbox IPC also provides the ability for one processor to
  signal the other processor using interrupts.

  mbox0 is handling ipc reply
  mbox1 is handling ipc request

properties:
  compatible:
    items:
      - const: mediatek,mt8195-adsp-mbox

  "#mbox-cells":
    const: 1

  reg:
    description: 
      Physical address base for dsp mbox base registers.
    maxItems: 2
    minItems: 2

  reg-names:
    items:
      - const: reg_mbox0 
      - const: reg_mbox1

  interrupts:
    description: 
      adsp mbox interrupt
    maxItems: 2
    minItems: 2

  interrupt-names:
    items:
      - const: irq_mbox0 
      - const: irq_mbox1

required:
  - compatible
  - "#mbox-cells"
  - reg
  - reg-names
  - interrupts
  - interrupt-names

additionalProperties: false

examples:
  - |
    #include <dt-bindings/interrupt-controller/arm-gic.h>
    #include <dt-bindings/interrupt-controller/irq.h>

    adsp_mailbox:adsp_mailbox@10816000 {
        compatible = "mediatek,mt8195-adsp-mbox";
        #mbox-cells = <1>;
        reg = <0x10816000 0x1000>,
              <0x10817000 0x1000>;
        reg-names = "reg_mbox0", "reg_mbox1";
        interrupts = <GIC_SPI 702 IRQ_TYPE_LEVEL_HIGH 0>,
                     <GIC_SPI 703 IRQ_TYPE_LEVEL_HIGH 0>;
        interrupt-names = "irq_mbox0", "irq_mbox1";
    };
```

## Documentation/devicetree/bindings/mailbox/ti,message-manager.yaml
```yaml
# SPDX-License-Identifier: (GPL-2.0-only OR BSD-2-Clause)
%YAML 1.2
---
$id: http://devicetree.org/schemas/mailbox/ti,message-manager.yaml#
$schema: http://devicetree.org/meta-schemas/core.yaml#

title: Texas Instruments' Message Manager Driver

maintainers:
  - Nishanth Menon <nm@ti.com>

description: |
  The Texas Instruments' Message Manager is a mailbox controller that has
  configurable queues selectable at SoC(System on Chip) integration. The Message
  manager is broken up into queues in different address regions that are called
  "proxies" - each instance is unidirectional and is instantiated at SoC
  integration level to indicate receive or transmit path.

properties:
  $nodename:
    pattern: "^mailbox@[0-9a-f]+$"

  compatible:
    const: ti,k2g-message-manager

  "#mbox-cells":
    const: 2
    description:
      Contains the queue ID and proxy ID in that order referring to the
      transfer path.

  reg-names:
    items:
      - const: queue_proxy_region
      - const: queue_state_debug_region

  reg:
    minItems: 2

  interrupt-names:
    items:
      - const: rx_005
      - const: rx_057
    description:
      Contains interrupt names matching the Rx transfer path for a given SoC.
      Receive interrupts shall be of the format "rx_<QID>".

  interrupts:
    minItems: 2
    description:
      Contains the interrupt information for the Rx interrupt paths for message
      manager corresponding to the interrupt-names.

required:
  - compatible
  - reg-names
  - reg
  - interrupt-names
  - interrupts
  - "#mbox-cells"

additionalProperties: false

examples:
  - |
    #include <dt-bindings/interrupt-controller/arm-gic.h>
    msgmgr: mailbox@2a00000 {
          compatible = "ti,k2g-message-manager";
          #mbox-cells = <2>;
          reg-names = "queue_proxy_region", "queue_state_debug_region";
          reg = <0x02a00000 0x400000>, <0x028c3400 0x400>;
          interrupt-names = "rx_005", "rx_057";
          interrupts = <GIC_SPI 324 IRQ_TYPE_LEVEL_HIGH>,
                       <GIC_SPI 327 IRQ_TYPE_LEVEL_HIGH>;
    };
```

## Documentation/devicetree/bindings/mailbox/xlnx,zynqmp-ipi-mailbox.yaml
```yaml
# SPDX-License-Identifier: (GPL-2.0 OR BSD-2-Clause)
%YAML 1.2
---
$id: "http://devicetree.org/schemas/mailbox/xlnx,zynqmp-ipi-mailbox.yaml#"
$schema: "http://devicetree.org/meta-schemas/core.yaml#"

title: Xilinx IPI Mailbox controller bindings

description:
  The Xilinx IPI(Inter Processor Interrupt) mailbox controller is to manage
  messaging between two Xilinx Zynq UltraScale+ MPSoC IPI agents. Each IPI
  agent owns registers used for notification and buffers for message.

maintainers:
  - Shubhrajyoti Datta <shubhrajyoti.datta@xilinx.com>

properties:
  compatible:
    const: xlnx,zynqmp-ipi-mailbox

  reg:
    maxItems: 4

  interrupts:
    maxItems: 1

  "#mbox-cells":
    const: 1

  xlnx,ipi-id:
    description: Xilinx IPI agent id
    $ref: /schemas/types.yaml#/definitions/uint32

required:
  - compatible
  - xlnx,ipi-id
  - interrupts

additionalProperties: false

examples:
  - |
     zynqmp_ipi {
          compatible = "xlnx,zynqmp-ipi-mailbox";
          interrupt-parent = <&gic>;
          interrupts = <0 29 4>;
          xlnx,ipi-id = <0>;
     };

          /* Client node APU<->RPU0 IPI mailbox controller */
          ipi_mailbox_rpu0: mailbox@ff990400 {
               reg = <0xff990400 0x20>,
                     <0xff990420 0x20>,
                     <0xff990080 0x20>,
                     <0xff9900a0 0x20>;
               reg-names = "local_request_region",
                        "local_response_region",
                        "remote_request_region",
                        "remote_response_region";
               #mbox-cells = <1>;
               xlnx,ipi-id = <1>;
          };
...
```

## Documentation/devicetree/bindings/media/amlogic,meson-irblaster.yaml
```yaml
# SPDX-License-Identifier: (GPL-2.0-only OR BSD-2-Clause)

%YAML 1.2
---
$id: "http://devicetree.org/schemas/media/amlogic,meson-irblaster.yaml#"
$schema: "http://devicetree.org/meta-schemas/core.yaml#"

title: Amlogic Meson IR blaster

maintainers:
  - Viktor Prutyanov <viktor.prutyanov@phystech.edu>

description: |
  Some Amlogic SoCs such as A311D and T950D4 have IR transmitter
  (blaster) controller onboard. It is capable of sending IR signals
  with arbitrary carrier frequency and duty cycle.

properties:
  compatible:
    oneOf:
      - const: amlogic,meson-irblaster
      - items:
          - const: amlogic,meson-g12a-irblaster
          - const: amlogic,meson-irblaster

  reg:
    maxItems: 1

  interrupts:
    maxItems: 1

  clocks:
    maxItems: 2

  clock-names:
    items:
      - const: sysclk
      - const: xtal

  mod-clock:
    maxItems: 1

required:
  - compatible
  - reg
  - interrupts

additionalProperties: false

examples:
  - |
    #include <dt-bindings/interrupt-controller/irq.h>
    #include <dt-bindings/clock/g12a-clkc.h>

    irblaster@ff80014c {
      compatible = "amlogic,meson-g12a-irblaster", "amlogic,meson-irblaster";
      reg = <0xff80014c 0x10>;
      interrupts = <0 198 IRQ_TYPE_EDGE_RISING>;
      clocks = <&clkc CLKID_CLK81>, <&xtal>;
      clock-names = "sysclk", "xtal";
      mod-clock = "xtal";
    };
```

## Documentation/devicetree/bindings/media/i2c/hynix,hi846.yaml
```yaml
# SPDX-License-Identifier: (GPL-2.0-only OR BSD-2-Clause)
%YAML 1.2
---
$id: http://devicetree.org/schemas/media/i2c/hynix,hi846.yaml#
$schema: http://devicetree.org/meta-schemas/core.yaml#

title: SK Hynix Hi-846 1/4" 8M Pixel MIPI CSI-2 sensor

maintainers:
  - Martin Kepplinger <martin.kepplinger@puri.sm>

description: |-
  The Hi-846 is a raw image sensor with an MIPI CSI-2 image data
  interface and CCI (I2C compatible) control bus. The output format
  is 10bit Bayer.

properties:
  compatible:
    const: hynix,hi846

  reg:
    description: I2C device address.
    maxItems: 1

  clocks:
    description: Reference to the mclk clock.
    maxItems: 1

  clock-names:
    const: mclk

  rst-gpios:
    description: Reference to the GPIO connected to the reset pin. Active low.
    maxItems: 1

  vdd-supply:
    description: Definition of the regulator used as 1.8V digital power supply.

  port:
    $ref: /schemas/graph.yaml#/properties/port
    additionalProperties: false

    properties:
      endpoint:
        $ref: /schemas/media/video-interfaces.yaml#
        unevaluatedProperties: false

        properties:
          data-lanes:
            - oneOf:
              - items:
                - const: 1
                - const: 2
                - const: 3
                - const: 4
              - items:
                - const: 1
                - const: 2

        required:
          - data-lanes

required:
  - compatible
  - reg
  - clocks
  - clock-names
  - rst-gpios
  - vdd-supply
  - port

additionalProperties: false

examples:
  - |
    #include <dt-bindings/gpio/gpio.h>

    i2c {
        #address-cells = <1>;
        #size-cells = <0>;

        hi846: camera@20 {
            compatible = "hynix,hi846";
            reg = <0x20>;
            clocks = <&clk>;
            clock-names = "mclk";
            vdd-supply = <&reg_camera_pwr_en>; /* 1.8v */
            rst-gpios = <&gpio1 25 GPIO_ACTIVE_LOW>;

            port {
                camera_out: endpoint {
                    remote-endpoint = <&csi1_ep1>;
                    data-lanes = <1 2>;
                };
            };
        };
    };

...
```
