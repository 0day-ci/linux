## Documentation/devicetree/bindings/i2c/i2c-mt65xx.yaml
```yaml
# SPDX-License-Identifier: (GPL-2.0 OR BSD-2-Clause)
%YAML 1.2
---
$id: "http://devicetree.org/schemas/i2c/i2c-mt65xx.yaml#"
$schema: "http://devicetree.org/meta-schemas/core.yaml#"

title: MediaTek I2C Controller

maintainers:
  - Qii Wang <qii.wang@mediatek.com>
  - Matthias Brugger <matthias.bgg@gmail.com>

allOf:
  - $ref: /schemas/i2c/i2c-controller.yaml#

properties:
  $nodename:
    pattern: "^i2c@[0-9a-f]+$"

  compatible:
    oneOf:
      - enum:
          - mediatek,mt2712-i2c
          - mediatek,mt6577-i2c
          - mediatek,mt6589-i2c
          - mediatek,mt7622-i2c
          - mediatek,mt8173-i2c
          - mediatek,mt8183-i2c
          - mediatek,mt8192-i2c
      - items:
          - enum:
              - mediatek,mt2701-i2c
              - mediatek,mt6797-i2c
              - mediatek,mt7623-i2c
          - const: mediatek,mt6577-i2c
      - items:
          - enum:
              - mediatek,mt7629-i2c
              - mediatek,mt8516-i2c
          - const: mediatek,mt2712-i2c

  clocks:
    minItems: 2
    maxItems: 4
    items:
      - description: Controller clock
      - description: DMA clock
      - description: ARB clock for multi-master when a bus has more than
          one i2c controllers
      - description: PMIC clock. Only when mediatek,have-pmic is set.

  clock-names:
    minItems: 2
    maxItems: 4
    items:
      - const: main
      - const: dma
      - const: arb
      - const: pmic

  mediatek,have-pmic:
    $ref: /schemas/types.yaml#/definitions/flag
    description: Platform can control I2C from the PMIC

  mediatek,use-push-pull:
    $ref: /schemas/types.yaml#/definitions/flag
    description: IO config use push-pull mode.

required:
  - compatible
  - reg
  - interrupts
  - clocks
  - clock-names
  - clock-div

unevaluatedProperties: false

examples:
  - |
    #include <dt-bindings/interrupt-controller/irq.h>
    #include <dt-bindings/interrupt-controller/arm-gic.h>
    i2c0: i2c@1100d000 {
            compatible = "mediatek,mt6577-i2c";
            reg = <0x1100d000 0x70>,
                  <0x11000300 0x80>;
            interrupts = <GIC_SPI 44 IRQ_TYPE_LEVEL_LOW>;
            clock-frequency = <400000>;
            mediatek,have-pmic;
            clock-div = <16>;
            clocks = <&i2c0_ck>, <&ap_dma_ck>;
            clock-names = "main", "dma";
    };
```

## Documentation/devicetree/bindings/i2c/i2c-sunplus.yaml
```yaml
# SPDX-License-Identifier: (GPL-2.0 OR BSD-2-Clause)
# Copyright (C) Sunplus Co., Ltd.
%YAML 1.2
---
$id: http://devicetree.org/schemas/i2c/i2c-sunplus.yaml#
$schema: http://devicetree.org/meta-schemas/core.yaml#

title: Sunplus I2C controller

allOf:
  - $ref: /schemas/i2c/i2c-controller.yaml#

maintainers:
  - Li-hao Kuo <lhjeff911@gmail.com>

properties:
  compatible:
    enum:
      - sunplus,sp7021-i2cm
      - sunplus,q645-i2cm

  reg:
    items:
      - description: I2C registers
      - description: I2C DMA registers
      - description: I2C DMA power registers

  reg-names:
    items:
      - const: i2cm
      - const: i2cmdma
      - const: i2cdmapower

  interrupts:
    maxItems: 1

  clocks:
    maxItems: 1

  resets:
    maxItems: 1

required:
  - compatible
  - reg
  - reg-names
  - interrupts
  - clocks
  - resets
  - pinctrl-names
  - pinctrl-0

unevaluatedProperties: false

examples:
  - |
    #include <dt-bindings/clock/sp-sp7021.h>
    #include <dt-bindings/reset/sp-sp7021.h>
    #include <dt-bindings/interrupt-controller/irq.h>
    i2c@9C004600 {
        compatible = "sunplus,sp7021-i2cm";
			reg = <0x9c004600 0x80>, <0x9c004680 0x80>, <0x9c000000 0x80>;
			reg-names = "i2cm", "i2cmdma", "i2cdmapower";
        interrupt-parent = <&intc>;
        interrupts = <174 IRQ_TYPE_LEVEL_HIGH>;
        clocks = <&clkc I2CM0>;
        resets = <&rstc RST_I2CM0>;
        clock-frequency = <100000>;
        pinctrl-names = "default";
        pinctrl-0 = <&i2cm0_pins>;
    };
...
```

## Documentation/devicetree/bindings/i2c/nxp,pca9541.txt
```
* NXP PCA9541 I2C bus master selector

Required Properties:

  - compatible: Must be "nxp,pca9541"

  - reg: The I2C address of the device.

Optional Properties:

 - release-delay-us: the number of microseconds to delay before
   releasing the bus after a transaction.  If unspecified the default
   is zero (the bus is released immediately).  Non-zero values can
   reduce arbitration overhead for back-to-back transactions, at the
   cost of delaying the other master's access to the bus.

  The following required properties are defined externally:

  - I2C arbitration bus node. See i2c-arb.txt in this directory.


Example:

	i2c-arbitrator@74 {
		compatible = "nxp,pca9541";
		reg = <0x74>;
		release-delay-us = <20000>;

		i2c-arb {
			#address-cells = <1>;
			#size-cells = <0>;

			eeprom@54 {
				compatible = "atmel,24c08";
				reg = <0x54>;
			};
		};
	};
```

## Documentation/devicetree/bindings/i2c/ti,omap4-i2c.yaml
```yaml
# SPDX-License-Identifier: (GPL-2.0-only OR BSD-2-Clause)
%YAML 1.2
---
$id: http://devicetree.org/schemas/i2c/ti,omap4-i2c.yaml#
$schema: http://devicetree.org/meta-schemas/core.yaml#

title: Bindings for I2C controllers on TI's OMAP and K3 SoCs

maintainers:
  - Vignesh Raghavendra <vigneshr@ti.com>

allOf:
  - $ref: /schemas/i2c/i2c-controller.yaml#

properties:
  compatible:
    oneOf:
      - const: ti,omap2420-i2c
      - const: ti,omap2430-i2c
      - const: ti,omap3-i2c
      - const: ti,omap4-i2c
      - items:
          - enum:
              - ti,am4372-i2c
              - ti,am64-i2c
              - ti,am654-i2c
              - ti,j721e-i2c
          - const: ti,omap4-i2c

  ti,hwmods:
    description:
      Must be "i2c<n>", n being the instance number (1-based)
    $ref: /schemas/types.yaml#/definitions/string
    items:
      - pattern: "^i2c([1-9])$"

  dmas:
    minItems: 1
    maxItems: 2

  dma-names:
    items:
      - const: tx
      - const: rx

  reg:
    maxItems: 1

  interrupts:
    maxItems: 1

  clocks:
    maxItems: 1

  clock-names:
    const: fck

  clock-frequency: true

required:
  - compatible
  - reg
  - interrupts

unevaluatedProperties: false

examples:
  - |
     main_i2c0: i2c@2000000 {
             compatible = "ti,j721e-i2c", "ti,omap4-i2c";
             reg = <0x00 0x2000000 0x00 0x100>;
             interrupts = <GIC_SPI 200 IRQ_TYPE_LEVEL_HIGH>;
             #address-cells = <1>;
             #size-cells = <0>;
       };
```

## Documentation/devicetree/bindings/iio/accel/nxp,fxls8962af.yaml
```yaml
# SPDX-License-Identifier: (GPL-2.0-only OR BSD-2-Clause)
%YAML 1.2
---
$id: http://devicetree.org/schemas/iio/accel/nxp,fxls8962af.yaml#
$schema: http://devicetree.org/meta-schemas/core.yaml#

title: NXP FXLS8962AF/FXLS8964AF Accelerometer driver

maintainers:
  - Sean Nyekjaer <sean@geanix.com>

description: |
  NXP FXLS8962AF/FXLS8964AF Accelerometer driver that supports
  SPI and I2C interface.
    https://www.nxp.com/docs/en/data-sheet/FXLS8962AF.pdf
    https://www.nxp.com/docs/en/data-sheet/FXLS8964AF.pdf

properties:
  compatible:
    oneOf:
      - items:
          - const: nxp,fxls8962af
          - const: nxp,fxls8964af
      - enum:
          - nxp,fxls8962af
          - nxp,fxls8964af
  reg:
    maxItems: 1

  vdd-supply:
    description: phandle to the regulator that provides power to the accelerometer

  spi-max-frequency: true

  interrupts:
    maxItems: 1

required:
  - compatible
  - reg
  - interrupts

additionalProperties: false

examples:
  - |
    i2c0 {
        /* Example for a I2C device node */
        accelerometer@2a {
            compatible = "nxp,fxls8962af";
            reg = <0x62>;
            interrupt-parent = <&gpio0>;
            interrupts = <0 IRQ_TYPE_LEVEL_HIGH>;
        };
    };
  - |
    spi0 {
        /* Example for a SPI device node */
        accelerometer@0 {
            compatible = "nxp,fxls8962af";
            reg = <0>;
            spi-max-frequency = <4000000>;
            interrupt-parent = <&gpio0>;
            interrupts = <0 IRQ_TYPE_LEVEL_HIGH>;
        };
    };
```

## Documentation/devicetree/bindings/iio/accel/sca3300.yaml
```yaml
# SPDX-License-Identifier: (GPL-2.0-only)
%YAML 1.2
---
$id: http://devicetree.org/schemas/iio/accel/sca3300.yaml#
$schema: http://devicetree.org/meta-schemas/core.yaml#

title: Murata SCA3300 Accelerometer

description: |
  3-axis industrial accelerometer with digital SPI interface
  https://www.murata.com/en-global/products/sensor/accel/sca3300

maintainers:
  - Tomas Melin <tomas.melin@vaisala.com>

properties:
  compatible:
    enum:
      - murata,sca3300

  reg:
    maxItems: 1
    description: SPI chip select number according to the general SPI bindings

  spi-max-frequency:
    maximum: 8000000

  murata,opmode:
    description: Accelerometer operation mode as described in datasheet (MODE)
    $ref: /schemas/types.yaml#/definitions/uint32

required:
  - compatible
  - reg
  - murata,opmode

additionalProperties: false

examples:
  - |
    spi {
        #address-cells = <1>;
        #size-cells = <0>;
        sca3300@0 {
            compatible = "murata,sca3300";
            reg = <0x0>;
            spi-max-frequency = <4000000>;
            murata,opmode = <4>;
        };
    };
...
```
