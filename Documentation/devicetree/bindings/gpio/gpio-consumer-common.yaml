## Documentation/devicetree/bindings/gpio/gpio-consumer-common.yaml
```yaml
# SPDX-License-Identifier: GPL-2.0-only OR BSD-2-Clause
%YAML 1.2
---
$id: http://devicetree.org/schemas/gpio/gpio-consumer-common.yaml#
$schema: http://devicetree.org/meta-schemas/core.yaml#

title: Common GPIO lines

maintainers:
  - Bartosz Golaszewski <brgl@bgdev.pl>
  - Linus Walleij <linus.walleij@linaro.org>

# do not select this schema for GPIO hogs
select:
  properties:
    gpio-hog: false

properties:
  enable-gpios:
    $ref: /schemas/types.yaml#/definitions/phandle-array

  reset-gpios:
    $ref: /schemas/types.yaml#/definitions/phandle-array

  powerdown-gpios:
    $ref: /schemas/types.yaml#/definitions/phandle-array

  pwdn-gpios:
    $ref: /schemas/types.yaml#/definitions/phandle-array
    description: Use powerdown-gpios
    deprecated: true

  wakeup-gpios:
    $ref: /schemas/types.yaml#/definitions/phandle-array

additionalProperties: true
```

## Documentation/devicetree/bindings/gpio/gpio-mux-input.yaml
```yaml
# SPDX-License-Identifier: (GPL-2.0-only OR BSD-2-Clause)
%YAML 1.2
---
$id: http://devicetree.org/schemas/gpio/gpio-mux-input.yaml#
$schema: http://devicetree.org/meta-schemas/core.yaml#

title: GPIO input multiplexer

maintainers:
  - Mauri Sandberg <sandberg@mailfence.com>

description: |
  A generic GPIO based input multiplexer

  This driver uses mux-controller to drive the multiplexer.

  For consumer use see gpio.txt.

properties:
  compatible:
    enum:
      - gpio-mux-input

  gpio-controller: true

  '#gpio-cells':
    const: 2

  pin-gpios:
    description: |
      The GPIO pin used the output from the multiplexer

required:
  - compatible
  - gpio-controller
  - "#gpio-cells"
  - pin-gpios

additionalProperties: false

examples:
  - |
    #include <dt-bindings/gpio/gpio.h>
    gpio2: key-mux1 {
        compatible = "gpio-mux-input";
        mux-controls = <&mux>;

        gpio-controller;
        #gpio-cells = <2>;

        // GPIOs used by this node, mux output pin
        pin-gpios = <&gpio 12 GPIO_ACTIVE_HIGH>;	/* 1y */
    };

...
```

## Documentation/devicetree/bindings/gpio/hpe,gxp-gpio.txt
```
*HPE GXP GPIO INTERFACE

Required properties:
- compatible: Must be "hpe,gxp-gpio".
- #gpio-cells: The number of cells to describe a GPIO, this should be 2.
- csm: Phandle to the GXP PCI CSM Controller.
- vuch0_handle:	Phandle to the Virtual USB Hub Controller (VUHC).

Example of gpio-controller nodes for a MPC8347 SoC:

	gpio: gpio {
		compatible = "hpe,gxp-gpio";
		#gpio-cells = <2>;
		csm_handle = <&csm>;
		vuhc0_handle = <&vuhc0>;
	};
```

## Documentation/devicetree/bindings/gpio/nuvoton,sgpio.yaml
```yaml
# SPDX-License-Identifier: (GPL-2.0-only OR BSD-2-Clause)
%YAML 1.2
---
$id: http://devicetree.org/schemas/gpio/nuvoton,sgpio.yaml#
$schema: http://devicetree.org/meta-schemas/core.yaml#

title: Nuvoton SGPIO controller

maintainers:
  - Jim LIU <JJLIU0@nuvoton.com>

description:
  This SGPIO controller is for NUVOTON NPCM7xx and NPCM8xx SoC,
  NPCM7xx/NPCM8xx have two sgpio module each module can support up
  to 64 output pins,and up to 64 input pin.
  GPIO pins can be programmed to support the following options
  - Support interrupt option for each input port and various interrupt
    sensitivity option (level-high, level-low, edge-high, edge-low)
  - Directly connected to APB bus and its shift clock is from APB bus clock
    divided by a programmable value.
  - ngpios is number of nin_gpios GPIO lines and nout_gpios GPIO lines.

properties:
  compatible:
    enum:
      - nuvoton,npcm750-sgpio
      - nuvoton,npcm845-sgpio

  reg:
    maxItems: 1

  gpio-controller: true

  '#gpio-cells':
    const: 2

  interrupts:
    maxItems: 1

  clocks:
    maxItems: 1

  nin_gpios: true

  nout_gpios: true

  bus-frequency: true

required:
  - compatible
  - reg
  - gpio-controller
  - '#gpio-cells'
  - interrupts
  - nin_gpios
  - nout_gpios
  - clocks
  - bus-frequency

additionalProperties: false

examples:
  - |
    #include <dt-bindings/clock/nuvoton,npcm7xx-clock.h>
    #include <dt-bindings/interrupt-controller/arm-gic.h>
    sgpio1: sgpio@101000 {
        compatible = "nuvoton,npcm750-sgpio";
        gpio-controller;
        #gpio-cells = <2>;
        interrupts = <GIC_SPI 19 IRQ_TYPE_LEVEL_HIGH>;
        reg = <0x101000 0x200>;
        clocks = <&clk NPCM7XX_CLK_APB3>;
        pinctrl-names = "default";
        pinctrl-0 = <&iox1_pins>;
        nin_gpios = <64>;
        nout_gpios = <64>;
        bus-frequency = <16000000>;
    };
```

## Documentation/devicetree/bindings/gpio/pensando,elba-spics.yaml
```yaml
# SPDX-License-Identifier: (GPL-2.0-only OR BSD-2-Clause)
%YAML 1.2
---
$id: http://devicetree.org/schemas/gpio/pensando,elba-spics.yaml#
$schema: http://devicetree.org/meta-schemas/core.yaml#

title: Pensando Elba SPI Chip Select Driver

description: |
  The Pensando Elba SoC provides four SPI bus chip selects.

maintainers:
  - Brad Larson <brad@pensando.io>

properties:
  $nodename:
    pattern: "^spics@[0-9a-f]+$"
  
  compatible:
    const: pensando,elba-spics

  reg:
    maxItems: 1

  gpio-controller: true

  "#gpio-cells":
    const: 2

required:
  - compatible
  - reg
  - gpio-controller
  - "#gpio-cells"

additionalProperties: false

examples:
  - |
    soc {
        #address-cells = <2>;
        #size-cells = <2>;

        spics: spics@307c2468 {
            compatible = "pensando,elba-spics";
            reg = <0x0 0x307c2468 0x0 0x4>;
            gpio-controller;
            #gpio-cells = <2>;
        };
    };
```

## Documentation/devicetree/bindings/gpio/ti,palmas-gpio.yaml
```yaml
# SPDX-License-Identifier: GPL-2.0-only
%YAML 1.2
---
$id: http://devicetree.org/schemas/gpio/ti,palmas-gpio.yaml#
$schema: http://devicetree.org/meta-schemas/core.yaml#

title: Texas Instruments Palmas family of Power-Management ICs (GPIO)

maintainers:
  - Linus Walleij <linus.walleij@linaro.org>

properties:
  compatible:
    enum:
      - ti,palmas-gpio
      - ti,tps80036-gpio
      - ti,tps65913-gpio
      - ti,tps65914-gpio

  # from gpio.yaml
  gpio-controller: true
  "#gpio-cells": true

allOf:
  - $ref: gpio.yaml

additionalProperties: false

required:
  - compatible
  - gpio-controller
  - "#gpio-cells"

examples:
  - |
    i2c {
      #address-cells = <1>;
      #size-cells = <0>;

      pmic@58 {
        compatible = "ti,tps65913", "ti,palmas";
        reg = <0x58>;

        #interrupt-cells = <2>;
        interrupt-controller;

        palmas_gpio {
          compatible = "ti,palmas-gpio";
          gpio-controller;
          #gpio-cells = <2>;
        };
      };
    };
```

## Documentation/devicetree/bindings/gpu/aspeed,gfx.yaml
```yaml
# SPDX-License-Identifier: GPL-2.0-only
%YAML 1.2
---
$id: http://devicetree.org/schemas/gpu/aspeed,gfx.yaml#
$schema: http://devicetree.org/meta-schemas/core.yaml#

title: ASPEED GFX display device

maintainers:
  - Joel Stanley <joel@jms.id.au>

properties:
  compatible:
    items:
      - enum:
          - aspeed,ast2400-gfx
          - aspeed,ast2500-gfx
          - aspeed,ast2600-gfx
      - const: syscon

  reg:
    minItems: 1

  interrupts:
    maxItems: 1

  clocks:
    maxItems: 1

  resets:
    maxItems: 1

  memory-region: true

  syscon: true

  reg-io-width: true

required:
  - reg
  - compatible
  - interrupts
  - clocks
  - resets
  - memory-region
  - syscon

additionalProperties: false

examples:
  - |
   #include <dt-bindings/clock/aspeed-clock.h>
   gfx: display@1e6e6000 {
       compatible = "aspeed,ast2500-gfx", "syscon";
       reg = <0x1e6e6000 0x1000>;
       reg-io-width = <4>;
       clocks = <&syscon ASPEED_CLK_GATE_D1CLK>;
       resets = <&syscon ASPEED_RESET_CRT1>;
       interrupts = <0x19>;
       syscon = <&syscon>;
       memory-region = <&gfx_memory>;
   };

   gfx_memory: framebuffer {
       size = <0x01000000>;
       alignment = <0x01000000>;
       compatible = "shared-dma-pool";
       reusable;
   };
```

## Documentation/devicetree/bindings/hte/hte-consumer.yaml
```yaml
# SPDX-License-Identifier: GPL-2.0
%YAML 1.2
---
$id: http://devicetree.org/schemas/hte/hte-consumer.yaml#
$schema: http://devicetree.org/meta-schemas/core.yaml#

title: HTE Consumer Device Tree Bindings

maintainers:
  - Dipen Patel <dipenp@nvidia.com>

description: |
  HTE properties should be named "hardware-timestamps". The exact meaning of
  each hardware-timestamps property must be documented in the device tree
  binding for each device. An optional property "hardware-timestamp-names" may
  contain a list of strings to label each of the HTE devices listed in the
  "hardware-timestamps" property.

properties:
  hardware-timestamps:
    $ref: /schemas/types.yaml#/definitions/phandle-array
    description:
      The list of HTE provider phandle. The provider must document the number
      of cell that must be passed in this property along with phandle.

  hardware-timestamp-names:
    $ref: /schemas/types.yaml#/definitions/string-array
    description:
      An optional string property.

required:
  - hardware-timestamps

dependencies:
  hardware-timestamp-names: [ hardware-timestamps ]

additionalProperties: true

examples:
  - |
    hte_irq_consumer {
              hardware-timestamps = <&tegra_hte_lic 0x19>;
              hardware-timestamp-names = "hte-irq";
    };
```

## Documentation/devicetree/bindings/hte/hte.yaml
```yaml
# SPDX-License-Identifier: GPL-2.0
%YAML 1.2
---
$id: http://devicetree.org/schemas/hte/hte.yaml#
$schema: http://devicetree.org/meta-schemas/core.yaml#

title: HTE providers

maintainers:
  - Dipen Patel <dipenp@nvidia.com>

properties:
  $nodename:
    pattern: "^hte(@.*|-[0-9a-f])*$"

  "#hte-cells":
    description:
      Number of cells in a HTE specifier.

required:
  - "#hte-cells"

additionalProperties: true

examples:
  - |
    tegra_hte_aon: hte@c1e0000 {
              compatible = "nvidia,tegra194-gte-aon";
              reg = <0xc1e0000 0x10000>;
              interrupts = <0 13 0x4>;
              int-threshold = <1>;
              slices = <3>;
              #hte-cells = <1>;
    };
```

## Documentation/devicetree/bindings/hte/nvidia,tegra194-hte.yaml
```yaml
# SPDX-License-Identifier: GPL-2.0
%YAML 1.2
---
$id: http://devicetree.org/schemas/hte/nvidia,tegra194-hte.yaml#
$schema: http://devicetree.org/meta-schemas/core.yaml#

title: Tegra194 on chip generic hardware timestamping engine (HTE)

maintainers:
  - Dipen Patel <dipenp@nvidia.com>

description: |
  Tegra194 SoC has multiple generic hardware timestamping engines which can
  monitor subset of GPIO and on chip IRQ lines for the state change, upon
  detection it will record timestamp (taken from system counter) in its
  internal hardware FIFO. It has bitmap array arranged in 32bit slices where
  each bit represent signal/line to enable or disable for the hardware
  timestamping.

properties:
  compatible:
    enum:
      - nvidia,tegra194-gte-aon
      - nvidia,tegra194-gte-lic

  reg:
    maxItems: 1

  interrupts:
    maxItems: 1

  int-threshold:
    description:
      HTE device generates its interrupt based on this u32 FIFO threshold
      value. The recommended value is 1.
    minimum: 1
    maximum: 256

  slices:
    description:
      HTE lines are arranged in 32 bit slice where each bit represents different
      line/signal that it can enable/configure for the timestamp. It is u32
      property and depends on the HTE instance in the chip.
    enum: [3, 11]

  '#hardware-timestamps-cells':
    const: 1

required:
  - compatible
  - reg
  - interrupts
  - slices
  - "#hardware-timestamps-cells"

additionalProperties: false

examples:
  - |
    tegra_hte_aon: hardware-timestamps@c1e0000 {
              compatible = "nvidia,tegra194-gte-aon";
              reg = <0xc1e0000 0x10000>;
              interrupts = <0 13 0x4>;
              int-threshold = <1>;
              slices = <3>;
              #hardware-timestamps-cells = <1>;
    };

  - |
    tegra_hte_lic: hardware-timestamps@3aa0000 {
              compatible = "nvidia,tegra194-gte-lic";
              reg = <0x3aa0000 0x10000>;
              interrupts = <0 11 0x4>;
              int-threshold = <1>;
              slices = <11>;
              #hardware-timestamps-cells = <1>;
    };

...
```

## Documentation/devicetree/bindings/hwmon/adi,adm1275.yaml
```yaml
# SPDX-License-Identifier: (GPL-2.0 OR BSD-2-Clause)
%YAML 1.2
---

$id: http://devicetree.org/schemas/hwmon/adi,adm1275.yaml#
$schema: http://devicetree.org/meta-schemas/core.yaml#

title: Analog Devices ADM1075/ADM127x/ADM129x digital power monitors

maintainers:
  - Krzysztof Kozlowski <krzk@kernel.org>

description: |
  The ADM1293 and ADM1294 are high accuracy integrated digital power monitors
  that offer digital current, voltage, and power monitoring using an on-chip,
  12-bit analog-to-digital converter (ADC), communicated through a PMBus
  compliant I2C interface.

  Datasheets:
    https://www.analog.com/en/products/adm1294.html

properties:
  compatible:
    enum:
      - adi,adm1075
      - adi,adm1272
      - adi,adm1275
      - adi,adm1276
      - adi,adm1278
      - adi,adm1293
      - adi,adm1294

  reg:
    maxItems: 1

  shunt-resistor-micro-ohms:
    description:
      Shunt resistor value in micro-Ohm.

  adi,volt-curr-sample-average:
    description: |
      Number of samples to be used to report voltage and current values.
      If the configured value is not a power of 2, sample averaging number
      will be configured with smaller and closest power of 2.

    $ref: /schemas/types.yaml#/definitions/uint32
    minimum: 1
    maximum: 128
    default: 1

  adi,power-sample-average:
    description: |
      Number of samples to be used to report power values.
      If the configured value is not a power of 2, sample averaging number
      will be configured with smaller and closest power of 2.

    $ref: /schemas/types.yaml#/definitions/uint32
    minimum: 1
    maximum: 128
    default: 1

if:
  not:
    properties:
      compatible:
        contains:
          enum:
          - adi,adm1272
          - adi,adm1278
          - adi,adm1293
          - adi,adm1294
then:
  properties:
    adi,power-sample-average:
      description: This property is not allowed.

required:
  - compatible
  - reg

additionalProperties: false

examples:
  - |
    i2c {
        #address-cells = <1>;
        #size-cells = <0>;

        power-sensor@10 {
            compatible = "adi,adm1272";
            reg = <0x10>;
            shunt-resistor-micro-ohms = <500>;
            adi,volt-curr-sample-average = <128>;
            adi,power-sample-average = <128>;
        };
    };
```

## Documentation/devicetree/bindings/hwmon/ampere,ac01-hwmon.yaml
```yaml
# SPDX-License-Identifier: (GPL-2.0-only OR BSD-2-Clause)
%YAML 1.2
---
$id: http://devicetree.org/schemas/hwmon/ampere,ac01-hwmon.yaml#
$schema: http://devicetree.org/meta-schemas/core.yaml#

title: Hardware monitoring driver for the Ampere Altra SMPro

maintainers:
  - Quan Nguyen <quan@os.amperecomputing.com>

description: |
  This module is part of the Ampere Altra SMPro multi-function device. For more
  details see ../mfd/ampere,smpro.yaml.

properties:
  compatible:
    enum:
      - ampere,ac01-hwmon

  reg:
    maxItems: 1

required:
  - compatible

additionalProperties: false
```
