## Documentation/devicetree/bindings/hwmon/gpio-fan.yaml
```yaml
# SPDX-License-Identifier: (GPL-2.0-only OR BSD-2-Clause)
%YAML 1.2
---
$id: http://devicetree.org/schemas/hwmon/gpio-fan.yaml#
$schema: http://devicetree.org/meta-schemas/core.yaml#

title: Bindings for fan connected to GPIO lines

maintainers:
  - OPEN FIRMWARE AND FLATTENED DEVICE TREE BINDINGS <devicetree@vger.kernel.org>

properties:
  compatible:
    const: gpio-fan

  gpios:
    $ref: /schemas/types.yaml#/definitions/phandle-array
    description: Specifies the pins that map to bits in the control value,
      ordered MSB-->LSB.

  gpio-fan,speed-map:
    $ref: /schemas/types.yaml#/definitions/uint32-matrix
    description: A mapping of possible fan RPM speeds and the
      control value that should be set to achieve them. This array
      must have the RPM values in ascending order.

  alarm-gpios:
    $ref: /schemas/types.yaml#/definitions/phandle-array
    description: This pin going active indicates something is wrong with
      the fan, and a udev event will be fired.

  "#cooling-cells":
    const: 2
    description: If used as a cooling device, must be <2>
      Also see Documentation/devicetree/bindings/thermal/thermal-cooling-devices.yaml
      min and max states are derived from the speed-map of the fan.

anyOf:
  - required:
      - gpios
  - required:
      - alarm-gpios

additionalProperties: False

examples:
  - |
    #include <dt-bindings/interrupt-controller/irq.h>
    #include <dt-bindings/clock/cortina,gemini-clock.h>
    #include <dt-bindings/reset/cortina,gemini-reset.h>
    #include <dt-bindings/gpio/gpio.h>
    gpio1: gpio@4d000000 {
      compatible = "cortina,gemini-gpio", "faraday,ftgpio010";
      reg = <0x4d000000 0x100>;
      interrupts = <22 IRQ_TYPE_LEVEL_HIGH>;
      resets = <&syscon GEMINI_RESET_GPIO0>;
      clocks = <&syscon GEMINI_CLK_APB>;
      gpio-controller;
      #gpio-cells = <2>;
      interrupt-controller;
      #interrupt-cells = <2>;
    };
    gpio_fan {
      compatible = "gpio-fan";
        gpios = <&gpio1 8 GPIO_ACTIVE_HIGH>;
        gpio-fan,speed-map = <0    0>,
                             <3000 1>,
                             <6000 2>;
        alarm-gpios = <&gpio1 15 GPIO_ACTIVE_HIGH>;
    };
  - |
    #include <dt-bindings/interrupt-controller/irq.h>
    #include <dt-bindings/clock/cortina,gemini-clock.h>
    #include <dt-bindings/reset/cortina,gemini-reset.h>
    #include <dt-bindings/gpio/gpio.h>
    gpio2: gpio@4d000000 {
      compatible = "cortina,gemini-gpio", "faraday,ftgpio010";
      reg = <0x4d000000 0x100>;
      interrupts = <22 IRQ_TYPE_LEVEL_HIGH>;
      resets = <&syscon GEMINI_RESET_GPIO0>;
      clocks = <&syscon GEMINI_CLK_APB>;
      gpio-controller;
      #gpio-cells = <2>;
      interrupt-controller;
      #interrupt-cells = <2>;
    };
    gpio_fan_cool: gpio_fan {
      compatible = "gpio-fan";
      gpios = <&gpio2 8 GPIO_ACTIVE_HIGH
               &gpio2 1 GPIO_ACTIVE_HIGH>;
      gpio-fan,speed-map = <0    0
                           3000 1
                           6000 2>;
      alarm-gpios = <&gpio2 15 GPIO_ACTIVE_HIGH>;
      #cooling-cells = <2>; /* min followed by max */
    };
```

## Documentation/devicetree/bindings/hwmon/maxim,max6639.yaml
```yaml
# SPDX-License-Identifier: (GPL-2.0 OR BSD-2-Clause)
%YAML 1.2
---

$id: http://devicetree.org/schemas/hwmon/maxim,max6639.yaml#
$schema: http://devicetree.org/meta-schemas/core.yaml#

title: Maxim max6639

maintainers:
  - Roland Stigge <stigge@antcom.de>

description: |
  The MAX6639 is a 2-channel temperature monitor with dual, automatic, PWM
  fan-speed controller.  It monitors its own temperature and one external
  diode-connected transistor or the temperatures of two external diode-connected
  transistors, typically available in CPUs, FPGAs, or GPUs.

  Datasheets:
    https://datasheets.maximintegrated.com/en/ds/MAX6639-MAX6639F.pdf

properties:
  compatible:
    enum:
      - maxim,max6639

  reg:
    maxItems: 1

  polarity:
    $ref: /schemas/types.yaml#/definitions/uint32
    enum: [0, 1]
    description:
      PWM output is low at 100% duty cycle when this bit is set to zero. PWM
      output is high at 100% duty cycle when this bit is set to 1.
      Fans PWM polarity is set to high (1) by default.

  pulses-per-revolution:
    $ref: /schemas/types.yaml#/definitions/uint32
    enum: [1, 2, 3, 4]
    description:
      Value specifying the number of pulses per revolution of the controlled
      FAN.

  rpm-range:
    $ref: /schemas/types.yaml#/definitions/uint32
    enum: [2000, 4000, 8000, 16000]
    description:
      Scales the tachometer counter by setting the maximum (full-scale) value
      of the RPM range.

required:
  - compatible
  - reg

additionalProperties: false

examples:
  - |
    i2c {
      #address-cells = <1>;
      #size-cells = <0>;

      max6639@10 {
        compatible = "maxim,max6639";
        reg = <0x10>;
        polarity = <1>;
        pulses-per-revolution = <2>;
        rpm-range = <4000>;
      };
    };
```

## Documentation/devicetree/bindings/hwmon/nuvoton,nct7802.yaml
```yaml
# SPDX-License-Identifier: (GPL-2.0 OR BSD-2-Clause)
%YAML 1.2
---

$id: http://devicetree.org/schemas/hwmon/nuvoton,nct7802.yaml#
$schema: http://devicetree.org/meta-schemas/core.yaml#

title: Nuvoton NCT7802Y Hardware Monitoring IC

maintainers:
  - Guenter Roeck <linux@roeck-us.net>

description: |
  The NCT7802Y is a hardware monitor IC which supports one on-die and up to
  5 remote temperature sensors with SMBus interface.

  Datasheets:
    https://www.nuvoton.com/export/resource-files/Nuvoton_NCT7802Y_Datasheet_V12.pdf

properties:
  compatible:
    enum:
      - nuvoton,nct7802

  reg:
    maxItems: 1

  "#address-cells":
    const: 1

  "#size-cells":
    const: 0

  channel@0:
    type: object
    description: Local Temperature Sensor ("LTD")
    properties:
      reg:
        const: 0
    required:
      - reg

  channel@1:
    type: object
    description: Remote Temperature Sensor or Voltage Sensor ("RTD1")
    properties:
      reg:
        const: 1
      sensor-type:
        items:
          - enum:
              - temperature
              - voltage
      temperature-mode:
        items:
          - enum:
              - thermistor
              - thermal-diode
    required:
      - reg
      - sensor-type

  channel@2:
    type: object
    description: Remote Temperature Sensor or Voltage Sensor ("RTD2")
    properties:
      reg:
        const: 2
      sensor-type:
        items:
          - enum:
              - temperature
              - voltage
      temperature-mode:
        items:
          - enum:
              - thermistor
              - thermal-diode
    required:
      - reg
      - sensor-type

  channel@3:
    type: object
    description: Remote Temperature Sensor or Voltage Sensor ("RTD3")
    properties:
      reg:
        const: 3
      sensor-type:
        items:
          - enum:
              - temperature
              - voltage
    required:
      - reg
      - sensor-type

required:
  - compatible
  - reg

additionalProperties: false

examples:
  - |
    i2c {
        #address-cells = <1>;
        #size-cells = <0>;

        nct7802@28 {
            compatible = "nuvoton,nct7802";
            reg = <0x28>;

            #address-cells = <1>;
            #size-cells = <0>;

            channel@0 { /* LTD */
              reg = <0>;
              status = "okay";
            };

            channel@1 { /* RTD1 */
              reg = <1>;
              status = "okay";
              sensor-type = "temperature";
              temperature-mode = "thermistor";
            };

            channel@2 { /* RTD2 */
              reg = <2>;
              status = "okay";
              sensor-type = "temperature";
              temperature-mode = "thermal-diode";
            };

            channel@3 { /* RTD3 */
              reg = <3>;
              status = "okay";
              sensor-type = "voltage";
            };
        };
    };
```

## Documentation/devicetree/bindings/hwmon/sensirion,sht4x.yaml
```yaml
# SPDX-License-Identifier: GPL-2.0-only OR BSD-2-Clause
%YAML 1.2
---
$id: http://devicetree.org/schemas/hwmon/sensirion,sht4x.yaml#
$schema: http://devicetree.org/meta-schemas/core.yaml#

title: Sensirion SHT4x Humidity and Temperature Sensor IC

maintainers:
  - Navin Sankar Velliangiri navin@linumiz.com

description: |
  The SHT4x is a high-accuracy digital humidity and temperature sensor
  designed especially for battery-driven high-volume consumer
  electronics applications.  For further information refere to
  Documentation/hwmon/sht4x.rst

  This binding document describes the binding for the hardware monitor
  portion of the driver.

properties:
  compatible:
    enum:
      - sensirion,sht4x

  reg:
    const: 0x44
    description:
      The I2c base address of the SHT4x.  0x44 for all chip versions
      except for SHT41-BD1B, where it is 0x45.

required:
  - compatible
  - reg

additionalProperties: false

examples:
  - |
    i2c {
      #address-cells = <1>;
      #size-cells = <0>;
      clock-frequency = <400000>;

      sht4x@44 {
        compatible = "sensirion,sht4x";
        reg = <0x44>;
      };
    };
...
```

## Documentation/devicetree/bindings/hwmon/tmp421.yaml
```yaml
# SPDX-License-Identifier: (GPL-2.0 OR BSD-2-Clause)
%YAML 1.2
---
$id: http://devicetree.org/schemas/hwmon/tmp421.yaml#
$schema: http://devicetree.org/meta-schemas/core.yaml#

title: TMP42x/TMP44x temperature sensor

maintainers:
  - Guenter Roeck <linux@roeck-us.net>

description: |
  ±1°C Remote and Local temperature sensor
  https://www.ti.com/lit/ds/symlink/tmp422.pdf

properties:
  compatible:
    enum:
      - ti,tmp421
      - ti,tmp422
      - ti,tmp423
      - ti,tmp441
      - ti,tmp442
  reg:
    maxItems: 1

  '#address-cells':
    const: 1

  '#size-cells':
    const: 0

required:
  - compatible
  - reg

additionalProperties: false

patternProperties:
  "^input@([0-4])$":
    type: object
    description: |
      Represents channels of the device and their specific configuration.

    properties:
      reg:
        description: |
          The channel number. 0 is local channel, 1-4 are remote channels
        items:
          minimum: 0
          maximum: 4

      label:
        description: |
          A descriptive name for this channel, like "ambient" or "psu".

      n-factor:
        description: |
          The value (two's complement) to be programmed in the channel specific N correction register.
          For remote channels only.
        items:
          minimum: 0
          maximum: 1

    required:
      - reg

    additionalProperties: false

examples:
  - |
    i2c {
      #address-cells = <1>;
      #size-cells = <0>;

      sensor@4c {
        compatible = "ti,tmp422";
        reg = <0x4c>;
      };
    };
  - |
    i2c {
      #address-cells = <1>;
      #size-cells = <0>;

      sensor@4c {
        compatible = "ti,tmp422";
        reg = <0x4c>;
        #address-cells = <1>;
        #size-cells = <0>;

        input@0 {
          reg = <0x0>;
          n-factor = <0x1>;
          label = "local";
        };

        input@1 {
          reg = <0x1>;
          n-factor = <0x0>;
          label = "somelabel";
        };

        input@2 {
          reg = <0x2>;
          status = "disabled";
        };
      };
    };
```

## Documentation/devicetree/bindings/i2c/aspeed,new-i2c.yaml
```yaml
# SPDX-License-Identifier: (GPL-2.0-only OR BSD-2-Clause)
%YAML 1.2
---
$id: http://devicetree.org/schemas/i2c/aspeed,new-i2c.yaml#
$schema: http://devicetree.org/meta-schemas/core.yaml#

title: ASPEED I2C on the AST26XX SoCs Device Tree Bindings

description: |
  ASPEED I2C controller support the new register set since AST26XX
  The i2c-global-regs device is used to enable new register set

maintainers:
  - Ryan Chen <ryan_chen@aspeedtech.com>

allOf:
  - $ref: /schemas/i2c/i2c-controller.yaml#

properties:
  compatible:
    oneOf:
      - items:
          - enum:
              - aspeed,ast2600-i2c-bus
      - items:
          - enum:
              - aspeed,ast2600-i2c-global
          - const: syscon

  reg:
    minItems: 1
    maxItems: 2
    items:
      - description: address offset and range of bus
      - description: address offset and range of bus buffer

  interrupts:
    maxItems: 1

  clocks:
    maxItems: 1
    description:
      root clock of bus, should reference the APB
      clock in the second cell

  resets:
    maxItems: 1

  bus-frequency:
    minimum: 100
    maximum: 5000000
    default: 100000
    description: frequency of the bus clock in Hz defaults to 100 kHz when not
      specified

  multi-master:
    type: boolean
    description:
      states that there is another master active on this bus

  buff-mode:
    type: boolean
    description:
      buffer mode data transfer

  byte-mode:
    type: boolean
    description:
      byte mode tata transfer

  smbus-alert:
    type: boolean
    description:
      smbus alert protocol

required:
  - reg
  - compatible
  - clocks
  - resets

unevaluatedProperties: false

examples:
  - |
    #include <dt-bindings/interrupt-controller/arm-gic.h>
    #include <dt-bindings/interrupt-controller/aspeed-scu-ic.h>
    #include <dt-bindings/clock/ast2600-clock.h>

    i2c_gr: i2c-global-regs@0 {
      compatible = "aspeed,ast2600-i2c-global", "syscon";
      reg = <0x0 0x20>;
      clocks = <&syscon ASPEED_CLK_APB2>;
      resets = <&syscon ASPEED_RESET_I2C>;
    };

    i2c0: i2c-bus@80 {
      compatible = "aspeed,ast2600-i2c-bus";
      #address-cells = <1>;
      #size-cells = <0>;
      #interrupt-cells = <1>;
      reg = <0x80 0x80>, <0xC00 0x20>;
      clocks = <&syscon ASPEED_CLK_APB2>;
      resets = <&syscon ASPEED_RESET_I2C>;
      interrupts = <GIC_SPI 110 IRQ_TYPE_LEVEL_HIGH>;
      bus-frequency = <100000>;
    };
```

## Documentation/devicetree/bindings/i2c/hpe,gxp-i2c.txt
```
* HPE GXP I2C Interface

Required Properties:

  - compatible: Must be "hpe,gxp-i2c"
  - reg: The I2C address of the device.
  - interrupts: The interrupt number.
  - interrupt-parent: Interrupt controller to which the I2C bus is reporting
  - i2cg-handle: I2C Global interrupt status register handler

Example:

	i2c0: i2c@c0002000 {
		compatible = "hpe,gxp-i2c";
		reg = <0xc0002000 0x70>;
		interrupts = <9>;
		interrupt-parent = <&vic0>;
		i2cg-handle = <&i2cg>;
	};
```
