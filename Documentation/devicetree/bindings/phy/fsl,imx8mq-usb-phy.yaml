## Documentation/devicetree/bindings/phy/phy-stm32-usbphyc.yaml
```yaml
# SPDX-License-Identifier: GPL-2.0-only OR BSD-2-Clause
%YAML 1.2
---
$id: http://devicetree.org/schemas/phy/phy-stm32-usbphyc.yaml#
$schema: http://devicetree.org/meta-schemas/core.yaml#

title: STMicroelectronics STM32 USB HS PHY controller binding

description:

  The STM32 USBPHYC block contains a dual port High Speed UTMI+ PHY and a UTMI
  switch. It controls PHY configuration and status, and the UTMI+ switch that
  selects either OTG or HOST controller for the second PHY port. It also sets
  PLL configuration.

  USBPHYC
  |_ PLL
  |
  |_ PHY port#1 _________________ HOST controller
  |                   __                 |
  |                  / 1|________________|
  |_ PHY port#2 ----|   |________________
  |                  \_0|                |
  |_ UTMI switch_______|          OTG controller

maintainers:
  - Amelie Delaunay <amelie.delaunay@st.com>

properties:
  compatible:
    const: st,stm32mp1-usbphyc

  reg:
    maxItems: 1

  clocks:
    maxItems: 1

  resets:
    maxItems: 1

  "#address-cells":
    const: 1

  "#size-cells":
    const: 0

  vdda1v1-supply:
    description: regulator providing 1V1 power supply to the PLL block

  vdda1v8-supply:
    description: regulator providing 1V8 power supply to the PLL block

  '#clock-cells':
    description: number of clock cells for ck_usbo_48m consumer
    const: 0

#Required child nodes:

patternProperties:
  "^usb-phy@[0|1]$":
    type: object
    description:
      Each port the controller provides must be represented as a sub-node.

    properties:
      reg:
        description: phy port index.
        maxItems: 1

      phy-supply:
        description: regulator providing 3V3 power supply to the PHY.

      "#phy-cells":
        enum: [ 0x0, 0x1 ]

      connector:
        type: object
        allOf:
          - $ref: ../connector/usb-connector.yaml
        properties:
          vbus-supply: true

      st,phy-tuning:
        $ref: /schemas/types.yaml#/definitions/phandle
        description:
          It can be necessary to adjust the PHY settings to compensate parasitics, which can be due
          to USB connector/receptacle, routing, ESD protection component,... Here is the list of
          all optional parameters to tune the interface of the PHY (HS for High-Speed, FS for Full-
          Speed, LS for Low-Speed)
            * st,current-boost, <1> current boosting of 1mA
                                <2> current boosting of 2mA
            * st,no-lsfs-fb-cap, disables the LS/FS feedback capacitor
            * st,hs-slew-ctrl, slows the HS driver slew rate by 10%
            * st,hs-dc-level, <0> = decreases the HS driver DC level by 5 to 7mV
                              <1> = increases the HS driver DC level by 5 to 7mV
                              <2> = increases the HS driver DC level by 10 to 14mV
            * st,fs-rftime-tuning, enables the FS rise/fall tuning option
            * st,hs-rftime-reduction, enables the HS rise/fall reduction feature
            * st,hs-current-trim, controls HS driver current trimming for choke
                                  <0> = 18.87 mA target current / nominal + 0%
                                  <1> = 19.165 mA target current / nominal + 1.56%
                                  <2> = 19.46 mA target current / nominal + 3.12%
                                  <3> = 19.755 mA target current / nominal + 4.68%
                                  <4> = 20.05 mA target current / nominal + 6.24%
                                  <5> = 20.345 mA target current / nominal + 7.8%
                                  <6> = 20.64 mA target current / nominal + 9.36%
                                  <7> = 20.935 mA target current / nominal + 10.92%
                                  <8> = 21.23 mA target current / nominal + 12.48%
                                  <9> = 21.525 mA target current / nominal + 14.04%
                                  <10> = 21.82 mA target current / nominal + 15.6%
                                  <11> = 22.115 mA target current / nominal + 17.16%
                                  <12> = 22.458 mA target current / nominal + 19.01%
                                  <13> = 22.755 mA target current / nominal + 20.58%
                                  <14> = 23.052 mA target current / nominal + 22.16%
                                  <15> = 23.348 mA target current / nominal + 23.73%
            * st,hs-impedance-trim, controls HS driver impedance tuning for choke
                                    <0> = no impedance offset
                                    <1> = reduces the impedance by 2 ohms
                                    <2> = reduces the impedance by 4 ohms
                                    <3> = reduces the impedance by 6 ohms
            * st,squelch-level, adjusts the squelch DC threshold value
                                <0> = no shift in threshold
                                <1> = threshold shift by +7 mV
                                <2> = threshold shift by -5 mV
                                <3> = threshold shift by +14 mV
            * st,hs-rx-gain-eq, enables the HS Rx gain equalizer
            * st,hs-rx-offset, adjusts the HS Rx offset
                               <0> = no offset
                               <1> = offset of +5 mV
                               <2> = offset of +10 mV
                               <3> = offset of -5 mV
            * st,no-hs-ftime-ctrl, disables the HS fall time control of single ended signals
                                   during pre-emphasis
            * st,no-lsfs-sc, disables the short circuit protection in LS/FS driver
            * st,hs-tx-staggering, enables the basic staggering in HS Tx mode

    allOf:
      - if:
          properties:
            reg:
              const: 0
        then:
          properties:
            "#phy-cells":
              const: 0
        else:
          properties:
            "#phy-cells":
              const: 1
              description:
                The value is used to select UTMI switch output.
                0 for OTG controller and 1 for Host controller.

    required:
      - reg
      - phy-supply
      - "#phy-cells"

    additionalProperties: false

required:
  - compatible
  - reg
  - clocks
  - "#address-cells"
  - "#size-cells"
  - vdda1v1-supply
  - vdda1v8-supply
  - usb-phy@0
  - usb-phy@1

additionalProperties: false

examples:
  - |
    #include <dt-bindings/clock/stm32mp1-clks.h>
    #include <dt-bindings/reset/stm32mp1-resets.h>

    usb_phy_tuning: usb-phy-tuning {
        st,hs-dc-level = <2>;
        st,fs-rftime-tuning;
        st,hs-rftime-reduction;
        st,hs-current-trim = <15>;
        st,hs-impedance-trim = <1>;
        st,squelch-level = <3>;
        st,hs-rx-offset = <2>;
        st,no-lsfs-sc;
    };

    usbphyc: usbphyc@5a006000 {
        compatible = "st,stm32mp1-usbphyc";
        reg = <0x5a006000 0x1000>;
        clocks = <&rcc USBPHY_K>;
        resets = <&rcc USBPHY_R>;
        vdda1v1-supply = <&reg11>;
        vdda1v8-supply = <&reg18>;
        #address-cells = <1>;
        #size-cells = <0>;
        #clock-cells = <0>;

        usbphyc_port0: usb-phy@0 {
            reg = <0>;
            phy-supply = <&vdd_usb>;
            #phy-cells = <0>;
            st,phy-tuning = <&usb_phy_tuning>;
            connector {
                compatible = "usb-a-connector";
                vbus-supply = <&vbus_sw>;
            };
        };

        usbphyc_port1: usb-phy@1 {
            reg = <1>;
            phy-supply = <&vdd_usb>;
            #phy-cells = <1>;
            st,phy-tuning = <&usb_phy_tuning>;
        };
    };
...
```

## Documentation/devicetree/bindings/phy/phy.yaml
```yaml
# SPDX-License-Identifier: (GPL-2.0 OR BSD-2-Clause)
%YAML 1.2
---
$id: http://devicetree.org/schemas/phy/phy.yaml#
$schema: http://devicetree.org/meta-schemas/core.yaml#

title: Common PHY Provider Generic Binding

description:
  This is the generic binding for common PHYs providers.

maintainers:
  - Kishon Vijay Abraham I <kishon@ti.com>
  - Vinod Koul <vkoul@kernel.org>

select:
  required:
    - '#phy-cells'

properties:
  '#phy-cells':
    $ref: '/schemas/types.yaml#/definitions/uint32'
    description:
      Number of cells in a PHY specifier. The meaning of all those cells is
      defined by the binding for the PHY node. The PHY provider can use the
      values in cells to find the appropriate PHY.
    maximum: 16

  phy-supply:
    description:
      Phandle to a regulator that provides power to the PHY. This regulator
      will be managed during the PHY power on/off sequence.

  tx-amplitude-microvolt:
    description:
      Transmit amplitude voltages in microvolts, peak-to-peak. If this property
      contains multiple values for various PHY modes, the
      'tx-amplitude-microvolt-names' property must be provided and contain
      corresponding mode names.

  tx-amplitude-microvolt-names:
    description: |
      Names of the modes corresponding to voltages in the
      'tx-amplitude-microvolt' property. Required only if multiple voltages
      are provided.

      If a value of 'default' is provided, the system should use it for any PHY
      mode that is otherwise not defined here. If 'default' is not provided, the
      system should use manufacturer default value.

required:
  - '#phy-cells'

dependencies:
  tx-amplitude-microvolt-names: [ tx-amplitude-microvolt ]

additionalProperties: true

examples:
  - |
    phy_regulator: regulator {
      compatible = "regulator-fixed";
      regulator-name = "phy-regulator";
    };

    phy: phy {
      #phy-cells = <1>;
      phy-supply = <&phy_regulator>;
      tx-amplitude-microvolt = <915000>, <1100000>, <1200000>;
      tx-amplitude-microvolt-names = "2500base-x", "usb-hs", "usb-ss";
    };

    ethernet-controller {
      phys = <&phy 0>;
      phy-names = "ethphy";
    };

    usb {
      phys = <&phy 1>, <&phy 2>;
      phy-names = "usb2phy", "usb3phy";
    };
```

## Documentation/devicetree/bindings/phy/qcom,hdmi-phy.yaml
```yaml
# SPDX-License-Identifier: (GPL-2.0-only OR BSD-2-Clause)
%YAML 1.2
---

$id: "http://devicetree.org/schemas/phy/qcom,hdmi-phy.yaml#"
$schema: "http://devicetree.org/meta-schemas/core.yaml#"

title: Qualcomm Adreno/Snapdragon HDMI phy

maintainers:
  - Rob Clark <robdclark@gmail.com>

allOf:
  - if:
      properties:
        compatible:
          contains:
            const: qcom,hdmi-phy-8996
    then:
      properties:
        reg:
          minItems: 6
          maxItems: 6

        reg-names:
          items:
            - const: hdmi_pll
            - const: hdmi_tx_l0
            - const: hdmi_tx_l1
            - const: hdmi_tx_l2
            - const: hdmi_tx_l3
            - const: hdmi_phy

    else:
      properties:
        reg:
          minItems: 2
          maxItems: 2

        reg-names:
          items:
            - const: hdmi_phy
            - const: hdmi_pll
  - if:
      properties:
        compatible:
          contains:
            const: qcom,hdmi-phy-8960
    then:
      properties:
        clock-names:
          const: slave_iface

  - if:
      properties:
        compatible:
          contains:
            const: qcom,hdmi-phy-8996
    then:
      properties:
        clock-names:
          items:
            - const: iface
            - const: ref

properties:
  compatible:
    contains:
      enum:
        - qcom,hdmi-phy-8084
        - qcom,hdmi-phy-8660
        - qcom,hdmi-phy-8960
        - qcom,hdmi-phy-8974
        - qcom,hdmi-phy-8994
        - qcom,hdmi-phy-8996

  reg: true

  reg-names: true

  clocks: true

  clock-names: true

  power-domains:
    maxItems: 1

  core-vdda-supply: true

  vcca-supply: true

  vddio-supply: true

  '#phy-cells':
    const: 0

required:
  - compatible
  - clocks
  - reg
  - reg-names
  - '#phy-cells'

additionalProperties: false

examples:
  - |
    hdmi_phy: phy@4a00400 {
      compatible = "qcom,hdmi-phy-8960";
      reg-names = "hdmi_phy",
                  "hdmi_pll";
      reg = <0x4a00400 0x60>,
            <0x4a00500 0x100>;
      #phy-cells = <0>;
      power-domains = <&mmcc 1>;
      clock-names = "slave_iface";
      clocks = <&clk 21>;
      core-vdda-supply = <&pm8921_hdmi_mvs>;
    };
```

## Documentation/devicetree/bindings/phy/rockchip-mipi-dphy-rx.yaml
```yaml
# SPDX-License-Identifier: (GPL-2.0+ OR MIT)
%YAML 1.2
---
$id: http://devicetree.org/schemas/phy/rockchip-mipi-dphy-rx.yaml#
$schema: http://devicetree.org/meta-schemas/core.yaml#

title: Rockchip SoC MIPI RX0/TX1RX1 D-PHY Device Tree Bindings

maintainers:
  - Helen Koike <helen.koike@collabora.com>
  - Ezequiel Garcia <ezequiel@collabora.com>

description: |
  The Rockchip SoC has a MIPI D-PHY bus with an RX0 entry which connects to
  the ISP1 (Image Signal Processing unit v1.0) for CSI cameras.

properties:
  compatible:
    enum:
      - rockchip,rk3399-mipi-dphy-rx0
      - rockchip,rk3399-mipi-dphy-tx1rx1

  reg:
    maxItems: 1

  clocks:
    minItems: 3
    items:
      - description: MIPI D-PHY ref clock
      - description: MIPI D-PHY RX0/TX1RX1 cfg clock
      - description: Video in/out general register file clock
      - description: MIPI D-PHY DSI clock

  clock-names:
    minItems: 3
    items:
      - const: dphy-ref
      - const: dphy-cfg
      - const: grf
      - const: dsi

  '#phy-cells':
    const: 0

  power-domains:
    description: Video in/out power domain.
    maxItems: 1

  rockchip,grf:
    $ref: /schemas/types.yaml#/definitions/phandle
    description:
      The phandle of the syscon node for the general register file
      (GRF), required for TX1RX1 MIPI D-PHY on RK3399.

required:
  - compatible
  - clocks
  - clock-names
  - '#phy-cells'
  - power-domains

if:
  properties:
    compatible:
      contains:
          const: rockchip,rk3399-mipi-dphy-tx1rx1
then:
  required:
    - reg
    - rockchip,grf

  properties:
    clocks:
      minItems: 4
    clock-names:
      minItems: 4

additionalProperties: false

examples:
  - |

    /*
     * MIPI D-PHY RX0 use registers in "general register files", it
     * should be a child of the GRF.
     *
     * grf: syscon@ff770000 {
     *  compatible = "rockchip,rk3399-grf", "syscon", "simple-mfd";
     *  ...
     * };
     */

    #include <dt-bindings/clock/rk3399-cru.h>
    #include <dt-bindings/power/rk3399-power.h>

    mipi_dphy_rx0: mipi-dphy-rx0 {
        compatible = "rockchip,rk3399-mipi-dphy-rx0";
        clocks = <&cru SCLK_MIPIDPHY_REF>,
                 <&cru SCLK_DPHY_RX0_CFG>,
                 <&cru PCLK_VIO_GRF>;
        clock-names = "dphy-ref", "dphy-cfg", "grf";
        power-domains = <&power RK3399_PD_VIO>;
        #phy-cells = <0>;
    };
```
