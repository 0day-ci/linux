## Documentation/devicetree/bindings/pinctrl/rockchip,pinctrl.yaml
```yaml
# SPDX-License-Identifier: GPL-2.0
%YAML 1.2
---
$id: http://devicetree.org/schemas/pinctrl/rockchip,pinctrl.yaml#
$schema: http://devicetree.org/meta-schemas/core.yaml#

title: Rockchip Pinmux Controller

maintainers:
  - Heiko Stuebner <heiko@sntech.de>

description:
  The Rockchip Pinmux Controller enables the IC to share one PAD
  to several functional blocks. The sharing is done by multiplexing
  the PAD input/output signals. For each PAD there are several muxing
  options with option 0 being the use as a GPIO.

  Please refer to pinctrl-bindings.txt in this directory for details of the
  common pinctrl bindings used by client devices, including the meaning of the
  phrase "pin configuration node".

  The Rockchip pin configuration node is a node of a group of pins which can be
  used for a specific device or function. This node represents both mux and
  config of the pins in that group. The 'pins' selects the function mode(also
  named pin mode) this pin can work on and the 'config' configures various pad
  settings such as pull-up, etc.

  The pins are grouped into up to 9 individual pin banks which need to be
  defined as gpio sub-nodes of the pinmux controller.

properties:
  compatible:
    enum:
      - rockchip,px30-pinctrl
      - rockchip,rk2928-pinctrl
      - rockchip,rk3066a-pinctrl
      - rockchip,rk3066b-pinctrl
      - rockchip,rk3128-pinctrl
      - rockchip,rk3188-pinctrl
      - rockchip,rk3228-pinctrl
      - rockchip,rk3288-pinctrl
      - rockchip,rk3308-pinctrl
      - rockchip,rk3328-pinctrl
      - rockchip,rk3368-pinctrl
      - rockchip,rk3399-pinctrl
      - rockchip,rk3568-pinctrl
      - rockchip,rv1108-pinctrl

  rockchip,grf:
    $ref: /schemas/types.yaml#/definitions/phandle
    description:
      The phandle of the syscon node for the GRF registers.

  rockchip,pmu:
    $ref: /schemas/types.yaml#/definitions/phandle
    description:
      The phandle of the syscon node for the PMU registers,
      as some SoCs carry parts of the iomux controller registers there.
      Required for at least rk3188 and rk3288. On the rk3368 this should
      point to the PMUGRF syscon.

  "#address-cells":
    enum: [1, 2]

  "#size-cells":
    enum: [1, 2]

  ranges: true

patternProperties:
  "gpio[0-8]?@[0-9a-f]+$":
    type: object

    $ref: "/schemas/gpio/rockchip,gpio-bank.yaml#"

    unevaluatedProperties: false

  "pcfg-[a-z0-9-]+$":
    type: object
    properties:
      bias-disable: true

      bias-pull-down: true

      bias-pull-pin-default: true

      bias-pull-up: true

      drive-strength:
        minimum: 0
        maximum: 20

      input-enable: true

      input-schmitt-enable: true

      output-high: true

      output-low: true

    additionalProperties: false

additionalProperties:
  type: object
  additionalProperties:
    type: object
    properties:
      rockchip,pins:
        type: array
        minItems: 1
        items:
          items:
            - minimum: 0
              maximum: 8
            - minimum: 0
              maximum: 31
            - minimum: 0
              maximum: 6
            - maximum: 0xffffffff
        description:
          A 3 integers array represents a group of pins mux and
          config setting. The format is

          rockchip,pins = <PIN_BANK PIN_BANK_IDX MUX &phandle>

          The MUX 0 means gpio and MUX 1 to N mean the specific
          device function. The phandle of a node contains the
          generic pinconfig options to use, as described in
          pinctrl-bindings.txt in this directory.

examples:
  - |
    #include <dt-bindings/interrupt-controller/arm-gic.h>
    #include <dt-bindings/pinctrl/rockchip.h>

    pinctrl: pinctrl {
      compatible = "rockchip,rk3066a-pinctrl";
      rockchip,grf = <&grf>;

      #address-cells = <1>;
      #size-cells = <1>;
      ranges;

      gpio0: gpio@20034000 {
        compatible = "rockchip,gpio-bank";
        reg = <0x20034000 0x100>;
        interrupts = <GIC_SPI 54 IRQ_TYPE_LEVEL_HIGH>;
        clocks = <&clk_gates8 9>;

        gpio-controller;
        #gpio-cells = <2>;

        interrupt-controller;
        #interrupt-cells = <2>;
      };

      pcfg_pull_default: pcfg-pull-default {
        bias-pull-pin-default;
      };

      uart2 {
        uart2_xfer: uart2-xfer {
          rockchip,pins = <1 RK_PB0 1 &pcfg_pull_default>,
                          <1 RK_PB1 1 &pcfg_pull_default>;
        };
      };
    };

    uart2: serial@20064000 {
      compatible = "snps,dw-apb-uart";
      reg = <0x20064000 0x400>;
      interrupts = <GIC_SPI 36 IRQ_TYPE_LEVEL_HIGH>;
      clocks = <&mux_uart2>;
      pinctrl-0 = <&uart2_xfer>;
      pinctrl-names = "default";
      reg-io-width = <1>;
      reg-shift = <2>;
    };
```

## Documentation/devicetree/bindings/pinctrl/socionext,milbeaut-pinctrl.yaml
```yaml
# SPDX-License-Identifier: GPL-2.0-only OR BSD-2-Clause
%YAML 1.2
---
$id: http://devicetree.org/schemas/pinctrl/socionext,milbeaut-pinctrl.yaml#
$schema: http://devicetree.org/meta-schemas/core.yaml#

title: Milbeaut SoCs pin controller

maintainers:
  - Taichi Sugaya <sugaya.taichi@socionext.com>

description: |
  Bindings for memory-mapped pin controller of the Milbeaut SoCs.

properties:
  $nodename:
    pattern: "pinctrl"

  compatible:
    enum:
      - socionext,milbeaut-m10v-pinctrl

  reg:
    maxItems: 1

  reg-names:
    const: "pinctrl"

  gpio-controller: true

  "#gpio-cells":
    const: 2

required:
  - compatible
  - reg
  - reg-names
  - gpio-controller
  - "#gpio-cells"

additionalProperties: false

examples:
  - |
    pinctrl: pinctrl@1d022000 {
        compatible = "socionext,milbeaut-m10v-pinctrl";
        reg = <0x1d022000 0x1000>;
        reg-names = "pinctrl";
        gpio-controller;
        #gpio-cells = <2>;
    };
```

## Documentation/devicetree/bindings/pinctrl/sunplus,sp7021-pinctrl.yaml
```yaml
# SPDX-License-Identifier: (GPL-2.0-only OR BSD-2-Clause)
# Copyright (C) Sunplus Co., Ltd. 2021
%YAML 1.2
---
$id: http://devicetree.org/schemas/pinctrl/sunplus,sp7021-pinctrl.yaml#
$schema: http://devicetree.org/meta-schemas/core.yaml#

title: Sunplus SP7021 Pin Controller Device Tree Bindings

maintainers:
  - Dvorkin Dmitry <dvorkin@tibbo.com>
  - Wells Lu <wells.lu@sunplus.com>

description: |
  The Sunplus SP7021 pin controller is used to control SoC pins. Please
  refer to pinctrl-bindings.txt in this directory for details of the common
  pinctrl bindings used by client devices.

  Refer to https://sunplus-tibbo.atlassian.net/wiki/spaces/doc/pages/
  1443495991/How+to+setup+pins+of+SP7021+in+device-tree+source

  The device node of pin controller of Sunplus SP7021 has following
  properties.

properties:
  compatible:
    const: sunplus,sp7021-pctl

  gpio-controller: true

  '#gpio-cells':
    const: 2

  reg:
    items:
      - description: Base address and length of the MOON2 registers.
      - description: Base address and length of the GPIOXT registers.
      - description: Base address and length of the GPIOXT2 registers.
      - description: Base address and length of the FIRST registers.
      - description: Base address and length of the MOON1 registers.

  clocks:
    maxItems: 1

  resets:
    maxItems: 1

patternProperties:
  '^.*$':
    if:
      type: object
    then:
      description: |
        A pinctrl node should contain at least one subnodes representing the
        pins or function-pins group available on the machine. Each subnode
        will list the pins it needs, and how they should be configured.

        Pinctrl node's client devices use subnodes for desired pin
        configuration. Client device subnodes use below standard properties.

      properties:
        pins:
          description: |
            Define pins which are used by pinctrl node's client device.

            It consists of one or more integers which represents the config
            setting for corresponding pin. Please use macro SPPCTL_IOPAD to
            define the integers for pins.

            The first argument of the macro is pin number, the second is pin
            type, the third is type of GPIO, the last is default output state
            of GPIO.
          $ref: /schemas/types.yaml#/definitions/uint32-array

        function:
          description: |
            Define pin-function which is used by pinctrl node's client device.
            The name should be one of string in the following enumeration.
          $ref: "/schemas/types.yaml#/definitions/string"
          enum: [ SPI_FLASH, SPI_FLASH_4BIT, SPI_NAND, CARD0_EMMC, SD_CARD,
                  UA0, FPGA_IFX, HDMI_TX, LCDIF, USB0_OTG, USB1_OTG ]

        groups:
          description: |
            Define pin-group in a specified pin-function.
            The name should be one of string in the following enumeration.
          $ref: "/schemas/types.yaml#/definitions/string"
          enum: [ SPI_FLASH1, SPI_FLASH2, SPI_FLASH_4BIT1, SPI_FLASH_4BIT2,
                  SPI_NAND, CARD0_EMMC, SD_CARD, UA0, FPGA_IFX, HDMI_TX1,
                  HDMI_TX2, HDMI_TX3, LCDIF, USB0_OTG, USB1_OTG ]

        zero_func:
          description: |
            Disabled pins which are not used by pinctrl node's client device.
          $ref: /schemas/types.yaml#/definitions/uint32-array

      additionalProperties: false

      allOf:
        - if:
            properties:
              function:
                enum:
                  - SPI_FLASH
          then:
            properties:
              groups:
                enum:
                  - SPI_FLASH1
                  - SPI_FLASH2
        - if:
            properties:
              function:
                enum:
                  - SPI_FLASH_4BIT
          then:
            properties:
              groups:
                enum:
                  - SPI_FLASH_4BIT1
                  - SPI_FLASH_4BIT2
        - if:
            properties:
              function:
                enum:
                  - SPI_NAND
          then:
            properties:
              groups:
                enum:
                  - SPI_NAND
        - if:
            properties:
              function:
                enum:
                  - CARD0_EMMC
          then:
            properties:
              groups:
                enum:
                  - CARD0_EMMC
        - if:
            properties:
              function:
                enum:
                  - SD_CARD
          then:
            properties:
              groups:
                enum:
                  - SD_CARD
        - if:
            properties:
              function:
                enum:
                  - UA0
          then:
            properties:
              groups:
                enum:
                  - UA0
        - if:
            properties:
              function:
                enum:
                  - FPGA_IFX
          then:
            properties:
              groups:
                enum:
                  - FPGA_IFX
        - if:
            properties:
              function:
                enum:
                  - HDMI_TX
          then:
            properties:
              groups:
                enum:
                  - HDMI_TX1
                  - HDMI_TX2
                  - HDMI_TX3
        - if:
            properties:
              function:
                enum:
                  - LCDIF
          then:
            properties:
              groups:
                enum:
                  - LCDIF
        - if:
            properties:
              function:
                enum:
                  - USB0_OTG
          then:
            properties:
              groups:
                enum:
                  - USB0_OTG
        - if:
            properties:
              function:
                enum:
                  - USB1_OTG
          then:
            properties:
              groups:
                enum:
                  - USB1_OTG

required:
  - compatible
  - reg
  - "#gpio-cells"
  - gpio-controller
  - clocks
  - resets

additionalProperties: false

examples:
  - |
    #include <dt-bindings/clock/sp-sp7021.h>
    #include <dt-bindings/reset/sp-sp7021.h>
    #include <dt-bindings/pinctrl/sppctl-sp7021.h>

    pctl: pctl@9C000100 {
        compatible = "sunplus,sp7021-pctl";
        reg = <0x9C000100 0x100>, <0x9C000300 0x80>, <0x9C000380 0x80>,
              <0x9C0032e4 0x1C>, <0x9C000080 0x20>;
        gpio-controller;
        #gpio-cells = <2>;
        clocks = <&clkc GPIO>;
        resets = <&rstc RST_GPIO>;

        pins_uart0: pins_uart0 {
            function = "UA0";
            groups = "UA0";
        };

        pins_uart1: pins_uart1 {
            pins = <
                SPPCTL_IOPAD(11,SPPCTL_PCTL_G_PMUX,MUXF_UA1_TX,0)
                SPPCTL_IOPAD(10,SPPCTL_PCTL_G_PMUX,MUXF_UA1_RX,0)
                SPPCTL_IOPAD(7,SPPCTL_PCTL_G_GPIO,0,SPPCTL_PCTL_L_OUT)
            >;
        };

        emmc_mux: emmc_mux {
            function = "CARD0_EMMC";
            groups = "CARD0_EMMC";
        };

        mmc1_mux: mmc1_mux {
            function = "SD_CARD";
            groups = "SD_CARD";
            pins = < SPPCTL_IOPAD(91,SPPCTL_PCTL_G_GPIO,0,0) >;
        };

        hdmi_A_tx1: hdmi_A_tx1_pins {
            function = "HDMI_TX";
            groups = "HDMI_TX1";
        };
        hdmi_A_tx2: hdmi_A_tx2_pins {
            function = "HDMI_TX";
            groups = "HDMI_TX2";
        };
        hdmi_A_tx3: hdmi_A_tx3_pins {
            function = "HDMI_TX";
            groups = "HDMI_TX3";
        };
    };
...
```
