## Documentation/devicetree/bindings/pinctrl/qcom,qcm2290-pinctrl.yaml
```yaml
# SPDX-License-Identifier: (GPL-2.0-only OR BSD-2-Clause)
%YAML 1.2
---
$id: http://devicetree.org/schemas/pinctrl/qcom,qcm2290-pinctrl.yaml#
$schema: http://devicetree.org/meta-schemas/core.yaml#

title: Qualcomm Technologies, Inc. QCM2290 TLMM block

maintainers:
  - Shawn Guo <shawn.guo@linaro.org>

description:
  This binding describes the Top Level Mode Multiplexer block found in the
  QCM2290 platform.

properties:
  compatible:
    const: qcom,qcm2290-tlmm

  reg:
    maxItems: 1

  interrupts:
    description: Specifies the TLMM summary IRQ
    maxItems: 1

  interrupt-controller: true

  '#interrupt-cells':
    description:
      Specifies the PIN numbers and Flags, as defined in defined in
      include/dt-bindings/interrupt-controller/irq.h
    const: 2

  gpio-controller: true

  '#gpio-cells':
    description: Specifying the pin number and flags, as defined in
      include/dt-bindings/gpio/gpio.h
    const: 2

  gpio-ranges:
    maxItems: 1

  wakeup-parent:
    maxItems: 1

#PIN CONFIGURATION NODES
patternProperties:
  '-state$':
    oneOf:
      - $ref: "#/$defs/qcom-qcm2290-tlmm-state"
      - patternProperties:
          ".*":
            $ref: "#/$defs/qcom-qcm2290-tlmm-state"

'$defs':
  qcom-qcm2290-tlmm-state:
    type: object
    description:
      Pinctrl node's client devices use subnodes for desired pin configuration.
      Client device subnodes use below standard properties.
    $ref: "qcom,tlmm-common.yaml#/$defs/qcom-tlmm-state"

    properties:
      pins:
        description:
          List of gpio pins affected by the properties specified in this
          subnode.
        items:
          oneOf:
            - pattern: "^gpio([0-9]|[1-9][0-9]|10[0-9]|11[0-2])$"
            - enum: [ sdc1_rclk, sdc1_clk, sdc1_cmd, sdc1_data,
                      sdc2_clk, sdc2_cmd, sdc2_data ]
        minItems: 1
        maxItems: 36

      function:
        description:
          Specify the alternative function to be configured for the specified
          pins.

        enum: [ qup0, gpio, ddr_bist, phase_flag0, qdss_gpio8, atest_tsens,
                mpm_pwr, m_voc, phase_flag1, qdss_gpio9, atest_tsens2,
                phase_flag2, qdss_gpio10, dac_calib0, atest_usb10, phase_flag3,
                qdss_gpio11, dac_calib1, atest_usb11, qup1, CRI_TRNG0,
                phase_flag4, dac_calib2, atest_usb12, CRI_TRNG1, phase_flag5,
                dac_calib3, atest_usb13, qup2, phase_flag6, dac_calib4,
                atest_usb1, qup3, pbs_out, PLL_BIST, qdss_gpio, tsense_pwm,
                AGERA_PLL, pbs0, qdss_gpio0, pbs1, qdss_gpio1, qup4, tgu_ch0,
                tgu_ch1, qup5, tgu_ch2, phase_flag7, qdss_gpio4, dac_calib5,
                tgu_ch3, phase_flag8, qdss_gpio5, dac_calib6, phase_flag9,
                qdss_gpio6, dac_calib7, phase_flag10, qdss_gpio7, dac_calib8,
                SDC2_TB, CRI_TRNG, pbs2, qdss_gpio2, pwm_0, SDC1_TB, pbs3,
                qdss_gpio3, cam_mclk, pbs4, adsp_ext, pbs5, cci_i2c, prng_rosc,
                pbs6, phase_flag11, dac_calib9, atest_usb20, pbs7, phase_flag12,
                dac_calib10, atest_usb21, CCI_TIMER1, GCC_GP1, pbs8,
                phase_flag13, dac_calib11, atest_usb22, cci_async, CCI_TIMER0,
                pbs9, phase_flag14, dac_calib12, atest_usb23, pbs10,
                phase_flag15, dac_calib13, atest_usb2, vsense_trigger, qdss_cti,
                CCI_TIMER2, pwm_1, phase_flag16, dac_calib14, atest_char,
                phase_flag17, dac_calib15, atest_char0, GP_PDM0, phase_flag18,
                dac_calib16, atest_char1, CCI_TIMER3, GP_PDM1, phase_flag19,
                dac_calib17, atest_char2, GP_PDM2, phase_flag20, dac_calib18,
                atest_char3, phase_flag21, phase_flag22, char_exec, NAV_GPIO,
                phase_flag23, phase_flag24, phase_flag25, pbs14, qdss_gpio14,
                vfr_1, pbs15, qdss_gpio15, PA_INDICATOR, pwm_2, gsm1_tx,
                SSBI_WTR1, pll_bypassnl, pll_reset, phase_flag26, ddr_pxi0,
                gsm0_tx, phase_flag27, GCC_GP2, qdss_gpio12, ddr_pxi1, GCC_GP3,
                qdss_gpio13, dbg_out, uim2_data, pwm_3, uim2_clk, uim2_reset,
                pwm_4, uim2_present, pwm_5, uim1_data, uim1_clk, uim1_reset,
                uim1_present, dac_calib19, mdp_vsync, mdp_vsync_out_0,
                mdp_vsync_out_1, dac_calib20, dac_calib21, pwm_6, atest_bbrx1,
                pbs11, usb_phy, atest_bbrx0, pwm_7, mss_lte, pbs12, pbs13,
                wlan1_adc0, wlan1_adc1, sd_write, JITTER_BIST,
                atest_gpsadc_dtest0_native, atest_gpsadc_dtest1_native,
                phase_flag28, dac_calib22, ddr_pxi2, phase_flag29, dac_calib23,
                phase_flag30, dac_calib24, ddr_pxi3, pwm_8, phase_flag31,
                dac_calib25, pwm_9 ]

      drive-strength:
        enum: [2, 4, 6, 8, 10, 12, 14, 16]
        default: 2
        description:
          Selects the drive strength for the specified pins, in mA.

      bias-pull-down: true

      bias-pull-up: true

      bias-disable: true

      output-high: true

      output-low: true

    required:
      - pins

    additionalProperties: false

required:
  - compatible
  - reg
  - interrupts
  - interrupt-controller
  - '#interrupt-cells'
  - gpio-controller
  - '#gpio-cells'
  - gpio-ranges

additionalProperties: false

examples:
  - |
    #include <dt-bindings/interrupt-controller/arm-gic.h>
    tlmm: pinctrl@500000 {
        compatible = "qcom,qcm2290-tlmm";
        reg = <0x500000 0x300000>;
        interrupts = <GIC_SPI 227 IRQ_TYPE_LEVEL_HIGH>;
        gpio-controller;
        #gpio-cells = <2>;
        interrupt-controller;
        #interrupt-cells = <2>;
        gpio-ranges = <&tlmm 0 0 127>;

        sdc2_on_state: sdc2-on-state {
            clk {
                pins = "sdc2_clk";
                bias-disable;
                drive-strength = <16>;
            };

            cmd {
                pins = "sdc2_cmd";
                bias-pull-up;
                drive-strength = <10>;
            };

            data {
                pins = "sdc2_data";
                bias-pull-up;
                drive-strength = <10>;
            };
        };
    };
```

## Documentation/devicetree/bindings/pinctrl/qcom,sm6115-pinctrl.yaml
```yaml
# SPDX-License-Identifier: (GPL-2.0-only OR BSD-2-Clause)
%YAML 1.2
---
$id: http://devicetree.org/schemas/pinctrl/qcom,sm6115-pinctrl.yaml#
$schema: http://devicetree.org/meta-schemas/core.yaml#

title: Qualcomm Technologies, Inc. SM6115, SM4250 TLMM block

maintainers:
  - Iskren Chernev <iskren.chernev@gmail.com>

description: |
  This binding describes the Top Level Mode Multiplexer block found in the
  SM6115 and SM4250 platforms.

properties:
  compatible:
    enum:
      - qcom,sm4250-tlmm
      - qcom,sm6115-tlmm

  reg:
    minItems: 3
    maxItems: 3

  reg-names:
    items:
      - const: "west"
      - const: "south"
      - const: "east"

  interrupts:
    description: Specifies the TLMM summary IRQ
    maxItems: 1

  interrupt-controller: true

  '#interrupt-cells':
    description:
      Specifies the PIN numbers and Flags, as defined in defined in
      include/dt-bindings/interrupt-controller/irq.h
    const: 2

  gpio-controller: true

  '#gpio-cells':
    description: Specifying the pin number and flags, as defined in
      include/dt-bindings/gpio/gpio.h
    const: 2

  gpio-ranges:
    maxItems: 1

  wakeup-parent:
    maxItems: 1

#PIN CONFIGURATION NODES
patternProperties:
  '^.*$':
    if:
      type: object
    then:
      properties:
        pins:
          description:
            List of gpio pins affected by the properties specified in this
            subnode.
          items:
            oneOf:
              - pattern: "^gpio([0-9]|[1-9][0-9]|1[0-7][0-9])$"
              - enum: [ sdc1_rclk, sdc1_clk, sdc1_cmd, sdc1_data,
                        sdc2_clk, sdc2_cmd, sdc2_data, ufs_reset ]
          minItems: 1
          maxItems: 36

        function:
          description:
            Specify the alternative function to be configured for the specified
            pins.

          enum: [ qup0, gpio, ddr_bist, phase_flag0, qdss_gpio8, atest_tsens,
                  mpm_pwr, m_voc, phase_flag1, qdss_gpio9, atest_tsens2,
                  phase_flag2, qdss_gpio10, dac_calib0, atest_usb10,
                  phase_flag3, qdss_gpio11, dac_calib1, atest_usb11, qup1,
                  cri_trng0, phase_flag4, dac_calib2, atest_usb12, cri_trng1,
                  phase_flag5, dac_calib3, atest_usb13, qup2, phase_flag6,
                  dac_calib4, atest_usb1, qup3, pbs_out, pll_bist, qdss_gpio,
                  tsense_pwm, agera_pll, pbs0, qdss_gpio0, pbs1, qdss_gpio1,
                  qup4, tgu_ch0, tgu_ch1, qup5, tgu_ch2, phase_flag7,
                  qdss_gpio4, dac_calib5, tgu_ch3, phase_flag8, qdss_gpio5,
                  dac_calib6, phase_flag9, qdss_gpio6, dac_calib7,
                  phase_flag10, qdss_gpio7, dac_calib8, sdc2_tb, cri_trng,
                  pbs2, qdss_gpio2, sdc1_tb, pbs3, qdss_gpio3, cam_mclk, pbs4,
                  adsp_ext, pbs5, cci_i2c, prng_rosc, pbs6, phase_flag11,
                  dac_calib9, atest_usb20, pbs7, phase_flag12, dac_calib10,
                  atest_usb21, cci_timer1, gcc_gp1, pbs8, phase_flag13,
                  dac_calib11, atest_usb22, cci_async, cci_timer0, pbs9,
                  phase_flag14, dac_calib12, atest_usb23, pbs10, phase_flag15,
                  dac_calib13, atest_usb2, vsense_trigger, qdss_cti,
                  cci_timer2, phase_flag16, dac_calib14, atest_char,
                  phase_flag17, dac_calib15, atest_char0, gp_pdm0,
                  phase_flag18, dac_calib16, atest_char1, cci_timer3, gp_pdm1,
                  phase_flag19, dac_calib17, atest_char2, gp_pdm2,
                  phase_flag20, dac_calib18, atest_char3, phase_flag21,
                  phase_flag22, nav_gpio, phase_flag23, phase_flag24,
                  phase_flag25, pbs14, qdss_gpio14, vfr_1, pbs15, qdss_gpio15,
                  pa_indicator, gsm1_tx, ssbi_wtr1, pll_bypassnl, pll_reset,
                  phase_flag26, ddr_pxi0, gsm0_tx, phase_flag27, gcc_gp2,
                  qdss_gpio12, ddr_pxi1, gcc_gp3, qdss_gpio13, dbg_out,
                  uim2_data, uim2_clk, uim2_reset, uim2_present, uim1_data,
                  uim1_clk, uim1_reset, uim1_present, dac_calib19, mdp_vsync,
                  mdp_vsync_out_0, mdp_vsync_out_1, dac_calib20, dac_calib21,
                  atest_bbrx1, pbs11, usb_phy, atest_bbrx0, mss_lte, pbs12,
                  pbs13, wlan1_adc0, wlan1_adc1, sd_write, jitter_bist,
                  atest_gpsadc_dtest0_native, atest_gpsadc_dtest1_native,
                  phase_flag28, dac_calib22, ddr_pxi2, phase_flag29,
                  dac_calib23, phase_flag30, dac_calib24, ddr_pxi3,
                  phase_flag31, dac_calib25 ]

        drive-strength:
          enum: [2, 4, 6, 8, 10, 12, 14, 16]
          default: 2
          description:
            Selects the drive strength for the specified pins, in mA.

        bias-pull-down: true

        bias-pull-up: true

        bias-disable: true

        output-high: true

        output-low: true

      required:
        - pins
        - function

      additionalProperties: false

required:
  - compatible
  - reg
  - reg-names
  - interrupts
  - interrupt-controller
  - '#interrupt-cells'
  - gpio-controller
  - '#gpio-cells'
  - gpio-ranges

additionalProperties: false

examples:
  - |
        #include <dt-bindings/interrupt-controller/arm-gic.h>
        pinctrl@500000 {
                compatible = "qcom,sm4250-tlmm";
                reg = <0x500000 0x400000>,
                        <0x900000 0x400000>,
                        <0xd00000 0x400000>;
                reg-names = "west", "south", "east";
                interrupts = <GIC_SPI 227 IRQ_TYPE_LEVEL_HIGH>;
                gpio-controller;
                #gpio-cells = <2>;
                interrupt-controller;
                #interrupt-cells = <2>;
                gpio-ranges = <&tlmm 0 0 121>;
                wakeup-parent = <&intc>;
        };
```

## Documentation/devicetree/bindings/pinctrl/renesas,rzg2l-pinctrl.yaml
```yaml
# SPDX-License-Identifier: (GPL-2.0-only OR BSD-2-Clause)
%YAML 1.2
---
$id: http://devicetree.org/schemas/pinctrl/renesas,rzg2l-pinctrl.yaml#
$schema: http://devicetree.org/meta-schemas/core.yaml#

title: Renesas RZ/G2L combined Pin and GPIO controller

maintainers:
  - Geert Uytterhoeven <geert+renesas@glider.be>

description:
  The Renesas SoCs of the RZ/G2L series feature a combined Pin and GPIO
  controller.
  Pin multiplexing and GPIO configuration is performed on a per-pin basis.
  Each port features up to 8 pins, each of them configurable for GPIO function
  (port mode) or in alternate function mode.
  Up to 8 different alternate function modes exist for each single pin.

properties:
  compatible:
    enum:
      - renesas,r9a07g044-pinctrl # RZ/G2{L,LC}

  reg:
    maxItems: 1

  gpio-controller: true

  '#gpio-cells':
    const: 2
    description:
      The first cell contains the global GPIO port index, constructed using the
      RZG2L_GPIO() helper macro in <dt-bindings/pinctrl/pinctrl-rzg2l.h> and the
      second cell represents consumer flag as mentioned in ../gpio/gpio.txt
      E.g. "RZG2L_GPIO(39, 1)" for P39_1.

  gpio-ranges:
    maxItems: 1

  clocks:
    maxItems: 1

  power-domains:
    maxItems: 1

  resets:
    maxItems: 1

additionalProperties:
  anyOf:
    - type: object
      allOf:
        - $ref: pincfg-node.yaml#
        - $ref: pinmux-node.yaml#

      description:
        Pin controller client devices use pin configuration subnodes (children
        and grandchildren) for desired pin configuration.
        Client device subnodes use below standard properties.

      properties:
        phandle: true
        function: true
        groups: true
        pins: true
        bias-disable: true
        bias-pull-down: true
        bias-pull-up: true
        drive-strength:
          enum: [ 2, 4, 8, 12 ]
        power-source:
          enum: [ 1800, 2500, 3300 ]
        slew-rate: true
        gpio-hog: true
        gpios: true
        input-enable: true
        output-high: true
        output-low: true
        line-name: true

      additionalProperties: false

required:
  - compatible
  - reg
  - gpio-controller
  - '#gpio-cells'
  - gpio-ranges
  - clocks
  - power-domains
  - resets

examples:
  - |
    #include <dt-bindings/pinctrl/pinctrl-rzg2l.h>
    #include <dt-bindings/clock/r9a07g044-cpg.h>

    pinctrl: pinctrl@11030000 {
            compatible = "renesas,r9a07g044l-pinctrl";
            reg = <0x11030000 0x10000>;

            gpio-controller;
            #gpio-cells = <2>;
            gpio-ranges = <&pinctrl 0 0 392>;
            clocks = <&cpg CPG_MOD R9A07G044_CLK_GPIO>;
            resets = <&cpg R9A07G044_CLK_GPIO>;
            power-domains = <&cpg>;

            scif0_pins: scif0 {
                    groups = "scif0_data";
                    function = "scif0";
            };

            sd1-pwr-en-hog {
                    gpio-hog;
                    gpios = <RZG2L_GPIO(39, 2) 0>;
                    output-high;
                    line-name = "sd1_pwr_en";
            };
    };
```
