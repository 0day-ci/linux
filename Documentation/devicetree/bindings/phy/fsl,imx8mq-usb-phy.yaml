## Documentation/devicetree/bindings/pinctrl/nvidia,tegra194-pinmux.yaml
```yaml
# SPDX-License-Identifier: (GPL-2.0+ OR BSD-2-Clause)
%YAML 1.2
---
$id: http://devicetree.org/schemas/pinctrl/nvidia,tegra194-pinmux.yaml#
$schema: http://devicetree.org/meta-schemas/core.yaml#

title: NVIDIA Tegra194 Pinmux Controller

maintainers:
  - Thierry Reding <thierry.reding@gmail.com>
  - Jon Hunter <jonathanh@nvidia.com>

properties:
  compatible:
    const: nvidia,tegra194-pinmux

  reg:
    items:
      - description: APB_MISC_GP_*_PADCTRL registers (pad control)
      - description: PINMUX_AUX_* registers (pinmux)

additionalProperties:
  description: |
    Tegra's pin configuration nodes act as containers for an arbitrary number of subnodes. Each of
    these subnodes represents some desired configuration for a pin, a group, or a list of pins or
    groups. This configuration can include the mux function to select on those pin(s)/group(s), and
    various pin configuration parameters, such as pull-up, tristate, drive strength, etc.

    The name of each subnode is not important; all subnodes should be enumerated and processed
    purely based on their content.

    Each subnode only affects those parameters that are explicitly listed. In other words, a
    subnode that lists a mux function but no pin configuration parameters implies no information
    about any pin configuration parameters. Similarly, a pin subnode that describes a pullup
    parameter implies no information about e.g. the mux function or tristate parameter. For this
    reason, even seemingly boolean values are actually tristates in this binding: unspecified, off,
    or on. Unspecified is represented as an absent property, and off/on are represented as integer
    values 0 and 1.

    See the TRM to determine which properties and values apply to each pin/group. Macro values for
    property values are defined in include/dt-binding/pinctrl/pinctrl-tegra.h.
  type: object
  patternProperties:
    "^[a-z0-9-_]+$":
      properties:
        nvidia,pins:
          description: An array of strings. Each string contains the name of a pin or group. Valid
            values for these names are listed below.

            Note that the pex_l5_clkreq_n_pgg0 and pex_l5_rst_n_pgg1 pins are part of PCIE C5
            power partition. Client devices must enable this partition before accessing the
            configuration for these pins.
          $ref: /schemas/types.yaml#/definitions/string-array
          items:
            enum: [ pex_l5_clkreq_n_pgg0, pex_l5_rst_n_pgg1,
                    # drive groups
                    drive_pex_l5_clkreq_n_pgg0, drive_pex_l5_rst_n_pgg1 ]

        nvidia,function:
          description: A string containing the name of the function to mux to the pin or group.
          $ref: /schemas/types.yaml#/definitions/string
          enum: [ pe5 ]

        nvidia,pull:
          description: Pull-down/up setting to apply to the pin.
          $ref: /schemas/types.yaml#/definitions/uint32
          oneOf:
            - description: none
              const: 0
            - description: down
              const: 1
            - description: up
              const: 2

        nvidia,tristate:
          description: Tristate setting to apply to the pin.
          $ref: /schemas/types.yaml#/definitions/uint32
          oneOf:
            - description: drive
              const: 0
            - description: tristate
              const: 1

        nvidia,enable-input:
          description: Enable the pin's input path.
          $ref: /schemas/types.yaml#/definitions/uint32
          oneOf:
            - description: disable input (i.e. output only)
              const: 0
            - description: enable input
              const: 1

        nvidia,open-drain:
          description: Open-drain configuration for the pin.
          $ref: /schemas/types.yaml#/definitions/uint32
          oneOf:
            - description: disable open-drain
              const: 0
            - description: enable open-drain
              const: 1

        nvidia,lock:
          description: Lock the pin configuration against further changes until reset.
          $ref: /schemas/types.yaml#/definitions/uint32
          oneOf:
            - description: disable pin configuration lock
              const: 0
            - description: enable pin configuration lock
              const: 1

        nvidia,io-hv:
          description: Select high-voltage receivers.
          $ref: /schemas/types.yaml#/definitions/uint32
          oneOf:
            - description: Use normal receivers.
              const: 0
            - description: Use high-voltage receivers.
              const: 1

        nvidia,schmitt:
          description: Enable Schmitt trigger on the input.
          $ref: /schemas/types.yaml#/definitions/uint32
          oneOf:
            - description: disable Schmitt trigger on the input
              const: 0
            - description: enable Schmitt trigger on the input
              const: 1

        nvidia,drive-type:
          description: Drive type to configure for the pin.
          $ref: /schemas/types.yaml#/definitions/uint32
          enum: [ 0, 1, 2, 3 ]

        nvidia,pull-down-strength:
          description: Controls drive strength. 0 is weakest. The range of valid values depends on
            the pingroup. See "CAL_DRVDN" in the Tegra TRM.
          $ref: /schemas/types.yaml#/definitions/uint32

        nvidia,pull-up-strength:
          description: Controls drive strength. 0 is weakest. The range of valid values depends on
            the pingroup. See "CAL_DRVUP" in the Tegra TRM.
          $ref: /schemas/types.yaml#/definitions/uint32

      additionalProperties: false

      required:
        - nvidia,pins

required:
  - compatible
  - reg

examples:
  - |
    #include <dt-bindings/pinctrl/pinctrl-tegra.h>

    pinmux@2430000 {
        compatible = "nvidia,tegra194-pinmux";
        reg = <0x2430000 0x17000>,
              <0xc300000 0x04000>;

        pinctrl-names = "pex_rst";
        pinctrl-0 = <&pex_rst_c5_out_state>;

        pex_rst_c5_out_state: pex_rst_c5_out {
            pex_rst {
                nvidia,pins = "pex_l5_rst_n_pgg1";
                nvidia,schmitt = <TEGRA_PIN_DISABLE>;
                nvidia,enable-input = <TEGRA_PIN_DISABLE>;
                nvidia,io-hv = <TEGRA_PIN_ENABLE>;
                nvidia,tristate = <TEGRA_PIN_DISABLE>;
                nvidia,pull = <TEGRA_PIN_PULL_NONE>;
            };
        };
    };
```

## Documentation/devicetree/bindings/pinctrl/nvidia,tegra20-pinmux.yaml
```yaml
# SPDX-License-Identifier: (GPL-2.0+ OR BSD-2-Clause)
%YAML 1.2
---
$id: http://devicetree.org/schemas/pinctrl/nvidia,tegra20-pinmux.yaml#
$schema: http://devicetree.org/meta-schemas/core.yaml#

title: NVIDIA Tegra20 Pinmux Controller

maintainers:
  - Thierry Reding <thierry.reding@gmail.com>
  - Jon Hunter <jonathanh@nvidia.com>

properties:
  compatible:
    const: nvidia,tegra20-pinmux

  reg:
    items:
      - description: tri-state registers
      - description: mux register
      - description: pull-up/down registers
      - description: pad control registers

additionalProperties:
  type: object
  description: |
    Please refer to pinctrl-bindings.txt in this directory for details of the common pinctrl
    bindings used by client devices, including the meaning of the phrase "pin configuration
    node".

    Tegra's pin configuration nodes act as a container for an arbitrary number of subnodes. Each
    of these subnodes represents some desired configuration for a pin, a group, or a list of
    pins or groups. This configuration can include the mux function to select on those pin(s)/
    group(s), and various pin configuration parameters, such as pull-up, tristate, drive
    strength, etc.

    The name of each subnode is not important; all subnodes should be enumerated and processed
    purely based on their content.

    Each subnode only affects those parameters that are explicitly listed. In other words, a
    subnode that lists a mux function but no pin configuration parameters implies no information
    about any pin configuration parameters.

    Similarly, a pin subnode that describes a pullup parameter implies no information about e.g.
    the mux function or tristate parameter. For this reason, even seemingly boolean values are
    actually tristates in this binding: unspecified, off, or on. Unspecified is represented as
    an absent property, and off/on are represented as integer values 0 and 1.

    Note that many of these properties are only valid for certain specific pins or groups. See
    the Tegra TRM and various pinmux spreadsheets for complete details regarding which groups
    support which functionality. The Linux pinctrl driver may also be a useful reference, since
    it consolidates, disambiguates, and corrects data from all those sources.

  patternProperties:
    "^pinmux(-[a-z0-9-_]+)?$":
      type: object
      properties:
        nvidia,pins:
          $ref: /schemas/types.yaml#/definitions/string-array
          description: An array of strings. Each string contains the name of a pin or group.
            Valid values for these names are listed below.
          items:
            enum: [ ata, atb, atc, atd, ate, cdev1, cdev2, crtp, csus, dap1, dap2, dap3, dap4,
                    ddc, dta, dtb, dtc, dtd, dte, dtf, gma, gmb, gmc, gmd, gme, gpu, gpu7, gpv,
                    hdint, i2cp, irrx, irtx, kbca, kbcb, kbcc, kbcd, kbce, kbcf, lcsn, ld0, ld1,
                    ld2, ld3, ld4, ld5, ld6, ld7, ld8, ld9, ld10, ld11, ld12, ld13, ld14, ld15,
                    ld16, ld17, ldc, ldi, lhp0, lhp1, lhp2, lhs, lm0, lm1, lpp, lpw0, lpw1, lpw2,
                    lsc0, lsc1, lsck, lsda, lsdi, lspi, lvp0, lvp1, lvs, owc, pmc, pta, rm, sdb,
                    sdc, sdd, sdio1, slxa, slxc, slxd, slxk, spdi, spdo, spia, spib, spic, spid,
                    spie, spif, spig, spih, uaa, uab, uac, uad, uca, ucb, uda,
                    # tristate groups
                    ck32, ddrc, pmca, pmcb, pmcc, pmcd, pmce, xm2c, xm2d, ls, lc, ld17_0,
                    ld19_18, ld21_20, ld23_22,
                    # drive groups
                    drive_ao1, drive_ao2, drive_at1, drive_at2, drive_cdev1, drive_cdev2,
                    drive_csus, drive_dap1, drive_dap2, drive_dap3, drive_dap4, drive_dbg,
                    drive_lcd1, drive_lcd2, drive_sdmmc2, drive_sdmmc3, drive_spi, drive_uaa,
                    drive_uab, drive_uart2, drive_uart3, drive_vi1, drive_vi2, drive_xm2a,
                    drive_xm2c, drive_xm2d, drive_xm2clk, drive_sdio1, drive_crt, drive_ddc,
                    drive_gma, drive_gmb, drive_gmc, drive_gmd, drive_gme, drive_owr,
                    drive_uda ]

        nvidia,function:
          $ref: /schemas/types.yaml#/definitions/string
          description: A string containing the name of the function to mux to the pin or group.
            Valid values for function names are listed below. See the Tegra TRM to determine
            which are valid for each pin or group.
          enum: [ ahb_clk, apb_clk, audio_sync, crt, dap1, dap2, dap3, dap4, dap5, displaya,
                  displayb, emc_test0_dll, emc_test1_dll, gmi, gmi_int, hdmi, i2cp, i2c1, i2c2,
                  i2c3, ide, irda, kbc, mio, mipi_hs, nand, osc, owr, pcie, plla_out, pllc_out1,
                  pllm_out1, pllp_out2, pllp_out3, pllp_out4, pwm, pwr_intr, pwr_on, rsvd1,
                  rsvd2, rsvd3, rsvd4, rtck, sdio1, sdio2, sdio3, sdio4, sflash, spdif, spi1,
                  spi2, spi2_alt, spi3, spi4, trace, twc, uarta, uartb, uartc, uartd, uarte,
                  ulpi, vi, vi_sensor_clk, xio ]

        nvidia,pull:
          description: Pull-down/up setting to apply to the pin.
          $ref: /schemas/types.yaml#/definitions/uint32
          oneOf:
            - description: none
              const: 0
            - description: down
              const: 1
            - description: up
              const: 2

        nvidia,tristate:
          description: Tristate setting to apply to the pin.
          $ref: /schemas/types.yaml#/definitions/uint32
          oneOf:
            - description: drive
              const: 0
            - description: tristate
              const: 1

        nvidia,high-speed-mode:
          description: Enable high speed mode the pins.
          $ref: /schemas/types.yaml#/definitions/uint32
          oneOf:
            - description: normal speed mode
              const: 0
            - description: high speed mode
              const: 1

        nvidia,schmitt:
          description: Enable Schmitt trigger on the input.
          $ref: /schemas/types.yaml#/definitions/uint32
          oneOf:
            - description: disable Schmitt trigger on the input
              const: 0
            - description: enable Schmitt trigger on the input
              const: 1

        nvidia,low-power-mode:
          description: Controls the drive power or current. Valid values are from 0 through 3,
            where 0 specifies the least power and 3 specifies the most power. See "Low Power
            Mode" or "LPMD1" and "LPMD0" in the Tegra TRM.
          $ref: /schemas/types.yaml#/definitions/uint32
          enum: [ 0, 1, 2, 3 ]

        nvidia,pull-down-strength:
          description: Controls drive strength. 0 is weakest. The range of valid values depends
            on the pingroup. See "CAL_DRVDN" in the Tegra TRM.
          $ref: /schemas/types.yaml#/definitions/uint32

        nvidia,pull-up-strength:
          description: Controls drive strength. 0 is weakest. The range of valid values depends
            on the pingroup. See "CAL_DRVUP" in the Tegra TRM.
          $ref: /schemas/types.yaml#/definitions/uint32

        nvidia,slew-rate-rising:
          description: Controls rising signal slew rate. 0 is fastest. The range of valid values
            depends on the pingroup. See "DRVDN_SLWR" in the Tegra TRM.
          $ref: /schemas/types.yaml#/definitions/uint32

        nvidia,slew-rate-falling:
          description: Controls falling signal slew rate. 0 is fastest. The range of valid
            values depends on the pingroup. See "DRVUP_SLWF" in the Tegra TRM.
          $ref: /schemas/types.yaml#/definitions/uint32

      additionalProperties: false

      required:
        - nvidia,pins

required:
  - compatible
  - reg

examples:
  - |
    #include <dt-bindings/clock/tegra20-car.h>
    #include <dt-bindings/interrupt-controller/arm-gic.h>

    pinctrl@70000000 {
      compatible = "nvidia,tegra20-pinmux";
      reg = <0x70000014 0x10>, /* Tri-state registers */
            <0x70000080 0x20>, /* Mux registers */
            <0x700000a0 0x14>, /* Pull-up/down registers */
            <0x70000868 0xa8>; /* Pad control registers */

      pinmux {
        atb {
          nvidia,pins = "atb", "gma", "gme";
          nvidia,function = "sdio4";
          nvidia,pull = <0>;
          nvidia,tristate = <0>;
        };
      };
    };

    mmc@c8000600 {
      compatible = "nvidia,tegra20-sdhci";
      reg = <0xc8000600 0x200>;
      interrupts = <GIC_SPI 31 IRQ_TYPE_LEVEL_HIGH>;
      clocks = <&tegra_car TEGRA20_CLK_SDMMC4>;
      clock-names = "sdhci";
      resets = <&tegra_car 15>;
      reset-names = "sdhci";

      pinctrl-names = "default";
      pinctrl-0 = <&sdio4_default>;
    };
```
