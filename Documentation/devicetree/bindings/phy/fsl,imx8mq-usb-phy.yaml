## Documentation/devicetree/bindings/phy/snps,phy-dw-hdmi-e40x.yaml
```yaml
# SPDX-License-Identifier: (GPL-2.0-only OR BSD-2-Clause)
%YAML 1.2
---
$id: http://devicetree.org/schemas/phy/snps,phy-dw-hdmi-e40x.yaml#
$schema: http://devicetree.org/meta-schemas/core.yaml#

title: Synopsys DesignWare HDMI PHYs e405/e406 Device Tree Bindings

maintainers:
  - Jose Abreu <jose.abreu@synopsys.com>
  - Nelson Costa <nelson.costa@synopsys.com>

description: |
  The Synopsys DesignWare HDMI PHYs e405/e406 are HDMI 2.0 PHY Receivers that
  receive video and audio, and send to the HDMI RX Controller.

properties:
  compatible:
    oneOf:
      - const: snps,dw-hdmi-phy-e405
      - const: snps,dw-hdmi-phy-e406

  reg:
    maxItems: 1

  clocks:
    maxItems: 1
    description: |
      phandle to the configuration clock

  clock-names:
    const: cfg

  "#phy-cells":
    const: 0

  port:
    $ref: /schemas/graph.yaml#/properties/port
    description: |
      Output port node, multiple endpoints describing the PHY HDMI inputs data
      connected to the HDMI RX Controller.

required:
  - compatible
  - reg
  - clocks
  - clock-names
  - "#phy-cells"
  - port

additionalProperties: false

examples:
  - |
    parent {
            #address-cells = <1>;
            #size-cells = <0>;

        hdmi_e406_phy: hdmi-phy@fc {
            compatible = "snps,dw-hdmi-phy-e406";
            reg = <0xfc>;

            clocks = <&dw_hdmi_refclk>;
            clock-names = "cfg";

            #phy-cells = <0>;

            port {
                #address-cells = <1>;
                #size-cells = <0>;

                hdmi_e406_phy_0: endpoint@0 {
                    reg = <0>;
                    remote-endpoint = <&hdmi_rx_0>;
                };

                hdmi_e406_phy_1: endpoint@1 {
                    reg = <1>;
                    remote-endpoint = <&hdmi_rx_1>;
                };

                hdmi_e406_phy_2: endpoint@2 {
                    reg = <2>;
                    remote-endpoint = <&hdmi_rx_2>;
                };

                hdmi_e406_phy_3: endpoint@3 {
                    reg = <3>;
                    remote-endpoint = <&hdmi_rx_3>;
                };
            };
        };
    };
```

## Documentation/devicetree/bindings/pinctrl/fsl,imxrt1050.yaml
```yaml
# SPDX-License-Identifier: (GPL-2.0-only OR BSD-2-Clause)
%YAML 1.2
---
$id: http://devicetree.org/schemas/pinctrl/fsl,imxrt-pinctrl.yaml#
$schema: http://devicetree.org/meta-schemas/core.yaml#

title: Freescale IMXRT1050 IOMUX Controller

maintainers:
  - Giulio Benetti <giulio.benetti@benettiengineering.com>
  - Jesse Taube <Mr.Bossman075@gmail.com>

description:
  Please refer to fsl,imx-pinctrl.txt and pinctrl-bindings.txt in this directory
  for common binding part and usage.

properties:
  compatible:
    const: fsl,imxrt1050-iomuxc

  reg:
    maxItems: 1

# Client device subnode's properties
patternProperties:
  'grp$':
    type: object
    description:
      Pinctrl node's client devices use subnodes for desired pin configuration.
      Client device subnodes use below standard properties.

    properties:
      fsl,pins:
        description:
          each entry consists of 6 integers and represents the mux and config
          setting for one pin. The first 5 integers <mux_reg conf_reg input_reg
          mux_val input_val> are specified using a PIN_FUNC_ID macro, which can
          be found in <include/dt-bindings/pinctrl/pins-imxrt1050.h>. The last
          integer CONFIG is the pad setting value like pull-up on this pin. Please
          refer to i.MXRT1050 Reference Manual for detailed CONFIG settings.
        $ref: /schemas/types.yaml#/definitions/uint32-matrix
        items:
          items:
            - description: |
                "mux_reg" indicates the offset of mux register.
            - description: |
                "conf_reg" indicates the offset of pad configuration register.
            - description: |
                "input_reg" indicates the offset of select input register.
            - description: |
                "mux_val" indicates the mux value to be applied.
            - description: |
                "input_val" indicates the select input value to be applied.
            - description: |
                "pad_setting" indicates the pad configuration value to be applied.

    required:
      - fsl,pins

    additionalProperties: false

required:
  - compatible
  - reg

additionalProperties: false

examples:
  - |
    iomuxc: iomuxc@401f8000 {
      compatible = "fsl,imxrt1050-iomuxc";
      reg = <0x401f8000 0x4000>;
      fsl,mux_mask = <0x7>;
      pinctrl-names = "default";
      imxrt1050-evk {
        pinctrl_lpuart1: lpuart1grp {
        fsl,pins = <
          MXRT1050_IOMUXC_GPIO_AD_B0_12_LPUART1_TXD
            0xf1
          MXRT1050_IOMUXC_GPIO_AD_B0_13_LPUART1_RXD
            0xf1
          >;
        };
      };
    };
```

## Documentation/devicetree/bindings/pinctrl/mscc,ocelot-pinctrl.yaml
```yaml
# SPDX-License-Identifier: GPL-2.0-only OR BSD-2-Clause
%YAML 1.2
---
$id: http://devicetree.org/schemas/pinctrl/mscc,ocelot-pinctrl.yaml#
$schema: http://devicetree.org/meta-schemas/core.yaml#

title: Microsemi Ocelot pin controller Device Tree Bindings

maintainers:
  - Alexandre Belloni <alexandre.belloni@bootlin.com>
  - Lars Povlsen <lars.povlsen@microchip.com>

allOf:
  - $ref: "pinctrl.yaml#"

properties:
  compatible:
    enum:
      - microchip,lan966x-pinctrl
      - microchip,sparx5-pinctrl
      - mscc,jaguar2-pinctrl
      - mscc,luton-pinctrl
      - mscc,ocelot-pinctrl
      - mscc,serval-pinctrl
      - mscc,servalt-pinctrl

  reg: true

  gpio-controller: true

  '#gpio-cells':
    const: 2

  gpio-ranges: true

  interrupts:
    maxItems: 1
    description: The GPIO parent interrupt.

  interrupt-controller: true

  "#interrupt-cells":
    const: 2

required:
  - compatible
  - reg
  - gpio-controller
  - '#gpio-cells'
  - gpio-ranges

patternProperties:
  '-pins$':
    type: object
    allOf:
      - $ref: "pinmux-node.yaml"
      - $ref: "pincfg-node.yaml"

    properties:
      function: true
      pins: true
      output-high: true
      output-low: true
      drive-strength: true

    required:
      - function
      - pins

    additionalProperties: false

additionalProperties: false

examples:
  - |
    gpio: pinctrl@71070034 {
        compatible = "mscc,ocelot-pinctrl";
        reg = <0x71070034 0x28>;
        gpio-controller;
        #gpio-cells = <2>;
        gpio-ranges = <&gpio 0 0 22>;

        uart_pins: uart-pins {
            pins = "GPIO_6", "GPIO_7";
            function = "uart";
        };

        uart2_pins: uart2-pins {
            pins = "GPIO_12", "GPIO_13";
            function = "uart2";
        };
    };

...
```

## Documentation/devicetree/bindings/pinctrl/nuvoton,wpcm450-pinctrl.yaml
```yaml
# SPDX-License-Identifier: GPL-2.0-only OR BSD-2-Clause
%YAML 1.2
---
$id: http://devicetree.org/schemas/pinctrl/nuvoton,wpcm450-pinctrl.yaml#
$schema: http://devicetree.org/meta-schemas/core.yaml#

title: Nuvoton WPCM450 pin control and GPIO

maintainers:
  - Jonathan Neuschäfer <j.neuschaefer@gmx.net>

properties:
  compatible:
    const: "nuvoton,wpcm450-pinctrl"

  reg:
    maxItems: 1

  gpio-controller: true

  '#gpio-cells':
    const: 2

  interrupt-controller: true

  "#interrupt-cells":
    const: 2

  interrupts: true

patternProperties:
  # There are two kinds of subnodes:
  # 1. a pinmux node configures pin muxing for a group of pins (e.g. rmii2)
  # 2. a pinctrl node configures properties of a single pin
  "^.*$":
    if:
      type: object
    then:
      allOf:
        - $ref: pincfg-node.yaml#
        - $ref: pinmux-node.yaml#
      properties:
        groups:
          description:
            One or more groups of pins to mux to a certain function
          minItems: 1
          items:
            enum: [ smb3, smb4, smb5, scs1, scs2, scs3, smb0, smb1, smb2, bsp,
                    hsp1, hsp2, r1err, r1md, rmii2, r2err, r2md, kbcc, dvo,
                    clko, smi, uinc, gspi, mben, xcs2, xcs1, sdio, sspi, fi0,
                    fi1, fi2, fi3, fi4, fi5, fi6, fi7, fi8, fi9, fi10, fi11,
                    fi12, fi13, fi14, fi15, pwm0, pwm1, pwm2, pwm3, pwm4, pwm5,
                    pwm6, pwm7, hg0, hg1, hg2, hg3, hg4, hg5, hg6, hg7 ]
        function:
          description:
            The function that a group of pins is muxed to
          enum: [ smb3, smb4, smb5, scs1, scs2, scs3, smb0, smb1, smb2, bsp,
                  hsp1, hsp2, r1err, r1md, rmii2, r2err, r2md, kbcc, dvo0,
                  dvo1, dvo2, dvo3, dvo4, dvo5, dvo6, dvo7, clko, smi, uinc,
                  gspi, mben, xcs2, xcs1, sdio, sspi, fi0, fi1, fi2, fi3, fi4,
                  fi5, fi6, fi7, fi8, fi9, fi10, fi11, fi12, fi13, fi14, fi15,
                  pwm0, pwm1, pwm2, pwm3, pwm4, pwm5, pwm6, pwm7, hg0, hg1,
                  hg2, hg3, hg4, hg5, hg6, hg7 ]

        pins:
          description:
            A list of pins to configure in certain ways, such as enabling
            debouncing
          minItems: 1
          items:
            enum: [ gpio0, gpio1, gpio2, gpio3, gpio4, gpio5, gpio6, gpio7,
                    gpio8, gpio9, gpio10, gpio11, gpio12, gpio13, gpio14,
                    gpio15, gpio16, gpio17, gpio18, gpio19, gpio20, gpio21,
                    gpio22, gpio23, gpio24, gpio25, gpio26, gpio27, gpio28,
                    gpio29, gpio30, gpio31, gpio32, gpio33, gpio34, gpio35,
                    gpio36, gpio37, gpio38, gpio39, gpio40, gpio41, gpio42,
                    gpio43, gpio44, gpio45, gpio46, gpio47, gpio48, gpio49,
                    gpio50, gpio51, gpio52, gpio53, gpio54, gpio55, gpio56,
                    gpio57, gpio58, gpio59, gpio60, gpio61, gpio62, gpio63,
                    gpio64, gpio65, gpio66, gpio67, gpio68, gpio69, gpio70,
                    gpio71, gpio72, gpio73, gpio74, gpio75, gpio76, gpio77,
                    gpio78, gpio79, gpio80, gpio81, gpio82, gpio83, gpio84,
                    gpio85, gpio86, gpio87, gpio88, gpio89, gpio90, gpio91,
                    gpio92, gpio93, gpio94, gpio95, gpio96, gpio97, gpio98,
                    gpio99, gpio100, gpio101, gpio102, gpio103, gpio104,
                    gpio105, gpio106, gpio107, gpio108, gpio109, gpio110,
                    gpio111, gpio112, gpio113, gpio114, gpio115, gpio116,
                    gpio117, gpio118, gpio119, gpio120, gpio121, gpio122,
                    gpio123, gpio124, gpio125, gpio126, gpio127 ]

        input-debounce: true
        phandle: true

      dependencies:
        groups: [ function ]
        function: [ groups ]

      additionalProperties: false

required:
  - compatible
  - reg
  - gpio-controller
  - '#gpio-cells'

additionalProperties: false

examples:
  - |
    #include <dt-bindings/interrupt-controller/irq.h>
    #include <dt-bindings/gpio/gpio.h>
    pinctrl: pinctrl@b8003000 {
      compatible = "nuvoton,wpcm450-pinctrl";
      reg = <0xb8003000 0x1000>;
      gpio-controller;
      #gpio-cells = <2>;
      interrupts = <2 IRQ_TYPE_LEVEL_HIGH
                    3 IRQ_TYPE_LEVEL_HIGH
                    4 IRQ_TYPE_LEVEL_HIGH
                    5 IRQ_TYPE_LEVEL_HIGH>;
      rmii2 {
        groups = "rmii2";
        function = "rmii2";
      };

      pinctrl_uid: uid {
        pins = "gpio14";
        input-debounce = <1>;
      };
    };

    gpio-keys {
      compatible = "gpio-keys";
      pinctrl-names = "default";
      pinctrl-0 = <&pinctrl_uid>;

      uid {
        label = "UID";
        linux,code = <102>;
        gpios = <&pinctrl 14 GPIO_ACTIVE_HIGH>;
      };
    };
```
