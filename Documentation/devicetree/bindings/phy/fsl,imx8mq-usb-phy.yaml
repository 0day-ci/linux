## Documentation/devicetree/bindings/pinctrl/ti,palmas-pinctrl.yaml
```yaml
# SPDX-License-Identifier: GPL-2.0-only
%YAML 1.2
---
$id: http://devicetree.org/schemas/pinctrl/ti,palmas-pinctrl.yaml#
$schema: http://devicetree.org/meta-schemas/core.yaml#

title: Texas Instruments Palmas family of Power-Management ICs (pin control)

maintainers:
  - Linus Walleij <linus.walleij@linaro.org>

description: The pins of Palmas device can be set on different option and provides the
  configuration for Pull UP/DOWN, open drain etc.

properties:
  compatible:
    enum:
      - ti,palmas-pinctrl
      - ti,tps65913-pinctrl
      - ti,tps80036-pinctrl

  ti,palmas-enable-dvfs1:
    $ref: /schemas/types.yaml#/definitions/flag
    description: Enable DVFS1. Configure pins for DVFS1 mode. Selection primary or secondary
      function associated to I2C2_SCL_SCE, I2C2_SDA_SDO pin/pad for DVFS1 interface.

  ti,palmas-enable-dvfs2:
    $ref: /schemas/types.yaml#/definitions/flag
    description: Enable DVFS2. Configure pins for DVFS2 mode. Selection primary or secondary
      function associated to GPADC_START and SYSEN2 pin/pad for DVFS2 interface.

  ti,palmas-override-powerhold:
    $ref: /schemas/types.yaml#/definitions/flag
    description: This is applicable for PMICs for which GPIO7 is configured in POWERHOLD mode
      which has higher priority over DEV_ON bit and keeps the PMIC supplies on even after the
      DEV_ON bit is turned off. This property enables driver to over ride the POWERHOLD value to
      GPIO7 so as to turn off the PMIC in power off scenarios. So for GPIO7 if
      ti,palmas-override-powerhold is set then the GPIO_7 field should never be muxed to anything
      else. It should be set to POWERHOLD by default and only in case of power off scenarios the
      driver will over ride the mux value.

required:
  - compatible

additionalProperties:
  type: object
  description: |
    Please refer to pinctrl-bindings.txt in this directory for details of the common pinctrl
    bindings used by client devices, including the meaning of the phrase "pin configuration node".

    Palmas's pin configuration nodes act as a container for an arbitrary number of subnodes. Each
    of these subnodes represents some desired configuration for a list of pins. This configuration
    can include the mux function to select on those pin(s), and various pin configuration
    parameters, such as pull-up, open drain.

  properties:
    phandle:
      $ref: /schemas/types.yaml#/definitions/uint32

  additionalProperties:
    type: object
    description: |
      The name of each subnode is not important; all subnodes should be enumerated and processed
      purely based on their content.

      Each subnode only affects those parameters that are explicitly listed. In other words, a
      subnode that lists a mux function but no pin configuration parameters implies no information
      about any pin configuration parameters. Similarly, a pin subnode that describes a pullup
      parameter implies no information about e.g. the mux function.

      Note that many of these properties are only valid for certain specific pins. See the Palmas
      device datasheet for complete details regarding which pins support which functionality.

    properties:
      pins:
        $ref: /schemas/types.yaml#/definitions/string-array
        items:
          enum: [ gpio0, gpio1, gpio2, gpio3, gpio4, gpio5, gpio6, gpio7, gpio8, gpio9, gpio10,
                  gpio11, gpio12, gpio13, gpio14, gpio15, vac, powergood, nreswarm, pwrdown,
                  gpadc_start, reset_in, nsleep, enable1, enable2, int ]

      function:
        $ref: /schemas/types.yaml#/definitions/string
        description: Note that the opt0, opt1, opt2 and opt3 functions are special and if any of
          these functions is selected then directly pins register will be written with 0, 1, 2 or 3,
          respectively, if the function is valid for that pin or list of pins.
        enum: [ gpio, led, pwm, regen, sysen, clk32kgaudio, id, vbus_det, chrg_det, vac, vacok,
                powergood, usb_psel, msecure, pwrhold, int, nreswarm, simrsto, simrsti, low_vbat,
                wireless_chrg1, rcm, pwrdown, gpadc_start, reset_in, nsleep, enable, opt0, opt1,
                opt2, opt3 ]

      bias-disable:
        $ref: /schemas/types.yaml#/definitions/flag
        description: disable bias

      bias-pull-up:
        $ref: /schemas/types.yaml#/definitions/flag
        description: pull-up bias

      bias-pull-down:
        $ref: /schemas/types.yaml#/definitions/flag
        description: pull-down bias

      drive-open-drain:
        $ref: /schemas/types.yaml#/definitions/uint32
        description: configure for open drain
        enum: [ 0, 1 ]

    additionalProperties: false

    required:
      - pins

examples:
  - |
    i2c {
      #address-cells = <1>;
      #size-cells = <0>;

      pmic@58 {
        compatible = "ti,tps65913", "ti,palmas";
        reg = <0x58>;

        #interrupt-cells = <2>;
        interrupt-controller;

        pinctrl {
          compatible = "ti,tps65913-pinctrl";
          ti,palmas-enable-dvfs1;
          pinctrl-names = "default";
          pinctrl-0 = <&palmas_pins_state>;

          palmas_pins_state: pinmux {
            gpio0 {
              pins = "gpio0";
              function = "id";
              bias-pull-up;
            };

            vac {
              pins = "vac";
              function = "vacok";
              bias-pull-down;
            };

            gpio5 {
              pins = "gpio5";
              function = "opt0";
              drive-open-drain = <1>;
            };
          };
        };
      };
    };
```
