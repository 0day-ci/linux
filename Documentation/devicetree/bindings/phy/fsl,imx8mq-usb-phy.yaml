## Documentation/devicetree/bindings/phy/fsl,imx8mq-usb-phy.yaml
```yaml
# SPDX-License-Identifier: (GPL-2.0-only OR BSD-2-Clause)
%YAML 1.2
---
$id: http://devicetree.org/schemas/phy/fsl,imx8mq-usb-phy.yaml#
$schema: http://devicetree.org/meta-schemas/core.yaml#

title: Freescale i.MX8MQ USB3 PHY binding

maintainers:
  - Li Jun <jun.li@nxp.com>

properties:
  compatible:
    enum:
      - fsl,imx8mq-usb-phy
      - fsl,imx8mp-usb-phy

  reg:
    minItems: 1
    maxItems: 2

  "#phy-cells":
    const: 0

  clocks:
    maxItems: 1

  clock-names:
    items:
      - const: phy

  vbus-supply:
    description:
      A phandle to the regulator for USB VBUS.

  fsl,permanently-attached:
    type: boolean
    description:
      Indicates if the device atached to a downstream port is
      permanently attached.

  fsl,disable-port-power-control:
    type: boolean
    description:
      Indicates whether the host controller implementation includes port
      power control. Defines Bit 3 in capability register (HCCPARAMS).

  fsl,over-current-active-low:
    type: boolean
    description:
      Over current signal polarity is active low.

  fsl,power-active-low:
    type: boolean
    description:
      Power pad (PWR) polarity is active low.

required:
  - compatible
  - reg
  - "#phy-cells"
  - clocks
  - clock-names

if:
  properties:
    compatible:
      contains:
        enum:
          - fsl,imx8mp-usb-phy

then:
  properties:
    reg:
      minItems: 2
      maxItems: 2
      items:
        - description: PHY register base address
        - description: Glue layer base address

else:
  properties:
    reg:
      maxItems: 1
      items:
        - description: PHY register base address
    fsl,permanently-attached: false
    fsl,disable-port-power-control: false
    fsl,over-current-active-low: false
    fsl,power-active-low: false

additionalProperties: false

examples:
  - |
    #include <dt-bindings/clock/imx8mq-clock.h>
    usb3_phy0: phy@381f0040 {
        compatible = "fsl,imx8mq-usb-phy";
        reg = <0x381f0040 0x40>;
        clocks = <&clk IMX8MQ_CLK_USB1_PHY_ROOT>;
        clock-names = "phy";
        #phy-cells = <0>;
    };
```

## Documentation/devicetree/bindings/phy/fsl,lynx-28g.yaml
```yaml
# SPDX-License-Identifier: (GPL-2.0-only OR BSD-2-Clause)
%YAML 1.2
---
$id: http://devicetree.org/schemas/phy/fsl,lynx-28g.yaml#
$schema: http://devicetree.org/meta-schemas/core.yaml#

title: Freescale Lynx 28G SerDes PHY binding

maintainers:
  - Ioana Ciornei <ioana.ciornei@nxp.com>

properties:
  compatible:
    enum:
      - fsl,lynx-28g

  reg:
    maxItems: 1

  "#phy-cells":
    const: 1

  "#address-cells":
    const: 1

  "#size-cells":
    const: 0

required:
  - compatible
  - reg
  - "#phy-cells"
  - "#address-cells"
  - "#size-cells"

patternProperties:
  '^phy@[0-9a-f]$':
    type: object
    properties:
      reg:
        description:
          Number of the SerDes lane.
        minimum: 0
        maximum: 7

      "#phy-cells":
        const: 0

    additionalProperties: false

additionalProperties: false

examples:
  - |
    soc {
      #address-cells = <2>;
      #size-cells = <2>;
      serdes_1: serdes_phy@1ea0000 {
        compatible = "fsl,lynx-28g";
        reg = <0x0 0x1ea0000 0x0 0x1e30>;
        #address-cells = <1>;
        #size-cells = <0>;
        #phy-cells = <1>;

        serdes1_lane_a: phy@0 {
          reg = <0>;
          #phy-cells = <0>;
        };
        serdes1_lane_b: phy@1 {
          reg = <1>;
          #phy-cells = <0>;
        };
        serdes1_lane_c: phy@2 {
          reg = <2>;
          #phy-cells = <0>;
        };
        serdes1_lane_d: phy@3 {
          reg = <3>;
          #phy-cells = <0>;
        };
        serdes1_lane_e: phy@4 {
          reg = <4>;
          #phy-cells = <0>;
        };
        serdes1_lane_f: phy@5 {
          reg = <5>;
          #phy-cells = <0>;
        };
        serdes1_lane_g: phy@6 {
          reg = <6>;
          #phy-cells = <0>;
        };
        serdes1_lane_h: phy@7 {
          reg = <7>;
          #phy-cells = <0>;
        };
      };
    };
```

## Documentation/devicetree/bindings/phy/hisilicon,phy-hi3660-pcie.yaml
```yaml
# SPDX-License-Identifier: GPL-2.0-only OR BSD-2-Clause
%YAML 1.2
---
$id: http://devicetree.org/schemas/phy/hisilicon,phy-hi3660-pcie.yaml#
$schema: http://devicetree.org/meta-schemas/core.yaml#

title: HiSilicon Kirin960 PCIe PHY

maintainers:
  - Mauro Carvalho Chehab <mchehab+huawei@kernel.org>

description: |+
  Bindings for PCIe PHY on HiSilicon Kirin 960.

properties:
  compatible:
    const: hisilicon,hi960-pcie-phy

  "#phy-cells":
    const: 0

  reg:
    maxItems: 1
    description: PHY Control registers

  reg-names:
    const: phy

  clocks:
    items:
      - description: PCIe PHY clock
      - description: PCIe AUX clock
      - description: PCIe APB PHY clock
      - description: PCIe APB SYS clock
      - description: PCIe ACLK clock

  clock-names:
    items:
      - const: pcie_phy_ref
      - const: pcie_aux
      - const: pcie_apb_phy
      - const: pcie_apb_sys
      - const: pcie_aclk

  reset-gpios:
    description: PCI PERST reset GPIO

required:
  - "#phy-cells"
  - compatible
  - reg
  - reg-names
  - clocks
  - clock-names
  - reset-gpios

additionalProperties: false

examples:
  - |
    #include <dt-bindings/clock/hi3660-clock.h>

    bus {
      #address-cells = <2>;
      #size-cells = <2>;
      pcie_phy: pcie-phy@f3f2000 {
        compatible = "hisilicon,hi960-pcie-phy";
        reg = <0x0 0xf3f20000 0x0 0x40000>;
        reg-names = "phy";
        clocks = <&crg_ctrl HI3660_PCIEPHY_REF>,
                 <&crg_ctrl HI3660_CLK_GATE_PCIEAUX>,
                 <&crg_ctrl HI3660_PCLK_GATE_PCIE_PHY>,
                 <&crg_ctrl HI3660_PCLK_GATE_PCIE_SYS>,
                 <&crg_ctrl HI3660_ACLK_GATE_PCIE>;
        clock-names = "pcie_phy_ref", "pcie_aux",
                 "pcie_apb_phy", "pcie_apb_sys",
                 "pcie_aclk";
        reset-gpios = <&gpio11 1 0 >;
        #phy-cells = <0>;
      };
    };
...
```

## Documentation/devicetree/bindings/phy/hisilicon,phy-hi3670-pcie.yaml
```yaml
# SPDX-License-Identifier: GPL-2.0-only OR BSD-2-Clause
%YAML 1.2
---
$id: http://devicetree.org/schemas/phy/hisilicon,phy-hi3670-pcie.yaml#
$schema: http://devicetree.org/meta-schemas/core.yaml#

title: HiSilicon Kirin970 PCIe PHY

maintainers:
  - Mauro Carvalho Chehab <mchehab+huawei@kernel.org>

description: |+
  Bindings for PCIe PHY on HiSilicon Kirin 970.

properties:
  compatible:
    const: hisilicon,hi970-pcie-phy

  "#phy-cells":
    const: 0

  reg:
    maxItems: 1
    description: PHY Control registers

  reg-names:
    const: phy

  phy-supply:
    description: The PCIe PHY power supply

  clocks:
    items:
      - description: PCIe PHY clock
      - description: PCIe AUX clock
      - description: PCIe APB PHY clock
      - description: PCIe APB SYS clock
      - description: PCIe ACLK clock

  clock-names:
    items:
      - const: pcie_phy_ref
      - const: pcie_aux
      - const: pcie_apb_phy
      - const: pcie_apb_sys
      - const: pcie_aclk

  reset-gpios:
    description: PCI PERST reset GPIOs
    maxItems: 4

  clkreq-gpios:
    description: Clock request GPIOs
    maxItems: 3

  hisilicon,eye-diagram-param:
    $ref: /schemas/types.yaml#/definitions/uint32-array
    description: Eye diagram for phy.

required:
  - "#phy-cells"
  - compatible
  - reg
  - reg-names
  - clocks
  - clock-names
  - reset-gpios
  - clkreq-gpios
  - hisilicon,eye-diagram-param
  - phy-supply

additionalProperties: false

examples:
  - |
    #include <dt-bindings/clock/hi3670-clock.h>

    bus {
      #address-cells = <2>;
      #size-cells = <2>;
      pcie_phy: pcie-phy@fc000000 {
        compatible = "hisilicon,hi970-pcie-phy";
        reg = <0x0 0xfc000000 0x0 0x80000>;
        reg-names = "phy";
        #phy-cells = <0>;
        phy-supply = <&ldo33>;
        clocks = <&crg_ctrl HI3670_CLK_GATE_PCIEPHY_REF>,
                 <&crg_ctrl HI3670_CLK_GATE_PCIEAUX>,
                 <&crg_ctrl HI3670_PCLK_GATE_PCIE_PHY>,
                 <&crg_ctrl HI3670_PCLK_GATE_PCIE_SYS>,
                 <&crg_ctrl HI3670_ACLK_GATE_PCIE>;
        clock-names = "pcie_phy_ref", "pcie_aux",
                      "pcie_apb_phy", "pcie_apb_sys", "pcie_aclk";
        reset-gpios = <&gpio7 0 0 >, <&gpio25 2 0 >,
                      <&gpio3 1 0 >, <&gpio27 4 0 >;
        clkreq-gpios = <&gpio20 6 0 >, <&gpio27 3 0 >, <&gpio17 0 0 >;
        hisilicon,eye-diagram-param = <0xFFFFFFFF 0xFFFFFFFF
                                       0xFFFFFFFF 0xFFFFFFFF 0xFFFFFFFF>;
      };
    };
...
```

## Documentation/devicetree/bindings/phy/phy-rockchip-naneng-combphy.yaml
```yaml
# SPDX-License-Identifier: (GPL-2.0-only OR BSD-2-Clause)
%YAML 1.2
---
$id: http://devicetree.org/schemas/phy/phy-rockchip-naneng-combphy.yaml#
$schema: http://devicetree.org/meta-schemas/core.yaml#

title: Rockchip SoC Naneng Combo Phy Device Tree Bindings

maintainers:
  - Heiko Stuebner <heiko@sntech.de>

properties:
  compatible:
    enum:
      - rockchip,rk3568-naneng-combphy

  reg:
    maxItems: 1

  clocks:
    minItems: 1
    items:
      - description: reference clock
      - description: apb clock
      - description: pipe clock

  clock-names:
    minItems: 1
    items:
      - const: ref
      - const: apb
      - const: pipe

  '#phy-cells':
    const: 1

  resets:
    minItems: 1
    items:
      - description: exclusive apb reset line
      - description: exclusive PHY reset line

  reset-names:
    minItems: 1
    items:
      - const: combphy-apb
      - const: combphy

  rockchip,pipe-grf:
    $ref: /schemas/types.yaml#/definitions/phandle
    description:
      Some additional phy settings are access through GRF regs.

  rockchip,pipe-phy-grf:
    $ref: /schemas/types.yaml#/definitions/phandle
    description:
      Some additional pipe settings are access through GRF regs.

required:
  - compatible
  - reg
  - clocks
  - clock-names
  - '#phy-cells'
  - resets
  - reset-names
  - rockchip,pipe-grf
  - rockchip,pipe-phy-grf

additionalProperties: false

examples:
  - |

    #include <dt-bindings/clock/rk3568-cru.h>

    pipegrf: syscon@fdc50000 {
      compatible = "rockchip,rk3568-pipegrf", "syscon";
      reg = <0xfdc50000 0x1000>;
    };

    pipe_phy_grf0: syscon@fdc70000 {
      compatible = "rockchip,pipe-phy-grf", "syscon";
      reg = <0xfdc70000 0x1000>;
    };

    combphy0_us: phy@fe820000 {
      compatible = "rockchip,rk3568-naneng-combphy";
      reg = <0xfe820000 0x100>;
      #phy-cells = <1>;
      clocks = <&pmucru CLK_PCIEPHY0_REF>, <&cru PCLK_PIPEPHY0>,
        <&cru PCLK_PIPE>;
      clock-names = "ref", "apb", "pipe";
      assigned-clocks = <&pmucru CLK_PCIEPHY0_REF>;
      assigned-clock-rates = <100000000>;
      resets = <&cru SRST_P_PIPEPHY0>, <&cru SRST_PIPEPHY0>;
      reset-names = "combphy-apb", "combphy";
      rockchip,pipe-grf = <&pipegrf>;
      rockchip,pipe-phy-grf = <&pipe_phy_grf0>;
    };
```

## Documentation/devicetree/bindings/phy/phy-rockchip-naneng-multiphy.yaml
```yaml
# SPDX-License-Identifier: (GPL-2.0-only OR BSD-2-Clause)
%YAML 1.2
---
$id: http://devicetree.org/schemas/phy/phy-rockchip-naneng-multiphy.yaml#
$schema: http://devicetree.org/meta-schemas/core.yaml#

title: Rockchip SoC Naneng Multi Phy Device Tree Bindings

maintainers:
  - Heiko Stuebner <heiko@sntech.de>

properties:
  compatible:
    enum:
      - rockchip,rk3566-naneng-multiphy
      - rockchip,rk3568-naneng-multiphy

  rockchip,pipe-grf:
    $ref: /schemas/types.yaml#/definitions/phandle
    description:
      Some additional phy settings are accessed through GRF regs.

  "#address-cells":
    const: 2

  "#size-cells":
    const: 2

required:
  - compatible
  - "#address-cells"
  - "#size-cells"

additionalProperties: false

patternProperties:
  "multi-phy@[0-9a-f]+$":
    type: object

    properties:
      reg:
        maxItems: 1

      clocks:
        items:
          - description: reference clock
          - description: apb clock
          - description: pipe clock

      clock-names:
        items:
          - const: ref
          - const: apb
          - const: pipe

      resets:
        items:
          - description: exclusive PHY reset line

      rockchip,enable-ssc:
        type: boolean
        description:
          The option SSC can be enabled for U3, SATA and PCIE.
          Most commercially available platforms use SSC to reduce EMI.

      rockchip,ext-refclk:
        type: boolean
        description:
          Many PCIe connections, especially backplane connections,
          require a synchronous reference clock between the two link partners.
          To achieve this a common clock source, referred to as REFCLK in
          the PCI Express Card Electromechanical Specification,
          should be used by both ends of the PCIe link.
          In PCIe mode one can choose to use an internal
          or an external reference clock.
          By default the internal clock is selected. The PCIe PHY provides a 100MHz
          differential clock output(optional with SSC) for system applications.
          When selecting this option an externally 100MHz differential
          reference clock needs to be provided to the PCIe PHY.

      rockchip,pipe-phy-grf:
        $ref: /schemas/types.yaml#/definitions/phandle
        description:
          Some additional pipe settings are accessed through GRF regs.

      "#phy-cells":
        const: 1

    required:
      - reg
      - clocks
      - clock-names
      - resets
      - rockchip,pipe-phy-grf
      - "#phy-cells"

    additionalProperties: false

examples:
  - |
    #include <dt-bindings/clock/rk3568-cru.h>

    pipegrf: syscon@fdc50000 {
      compatible = "rockchip,rk3568-pipe-grf", "syscon";
      reg = <0xfdc50000 0x1000>;
    };

    pipe_phy_grf0: syscon@fdc70000 {
      compatible = "rockchip,rk3568-pipe-phy-grf", "syscon";
      reg = <0xfdc70000 0x1000>;
    };

    pipe_phy_grf1: syscon@fdc80000 {
      compatible = "rockchip,rk3568-pipe-phy-grf", "syscon";
      reg = <0xfdc80000 0x1000>;
    };

    pipe_phy_grf2: syscon@fdc90000 {
      compatible = "rockchip,rk3568-pipe-phy-grf", "syscon";
      reg = <0xfdc90000 0x1000>;
    };

    multiphy: multiphy {
      compatible = "rockchip,rk3568-naneng-multiphy";
      rockchip,pipe-grf = <&pipegrf>;
      #address-cells = <2>;
      #size-cells = <2>;

      multiphy0: multi-phy@fe820000 {
        reg = <0x0 0xfe820000 0x0 0x100>;
        clocks = <&pmucru CLK_PCIEPHY0_REF>,
                 <&cru PCLK_PIPEPHY0>,
                 <&cru PCLK_PIPE>;
        clock-names = "ref", "apb", "pipe";
        assigned-clocks = <&pmucru CLK_PCIEPHY0_REF>;
        assigned-clock-rates = <100000000>;
        resets = <&cru SRST_PIPEPHY0>;
        rockchip,pipe-phy-grf = <&pipe_phy_grf0>;
        #phy-cells = <1>;
      };

      multiphy1: multi-phy@fe830000 {
        reg = <0x0 0xfe830000 0x0 0x100>;
        clocks = <&pmucru CLK_PCIEPHY1_REF>,
                 <&cru PCLK_PIPEPHY1>,
                 <&cru PCLK_PIPE>;
        clock-names = "ref", "apb", "pipe";
        assigned-clocks = <&pmucru CLK_PCIEPHY1_REF>;
        assigned-clock-rates = <100000000>;
        resets = <&cru SRST_PIPEPHY1>;
        rockchip,pipe-phy-grf = <&pipe_phy_grf1>;
        #phy-cells = <1>;
      };

      multiphy2: multi-phy@fe840000 {
        reg = <0x0 0xfe840000 0x0 0x100>;
        clocks = <&pmucru CLK_PCIEPHY2_REF>,
                 <&cru PCLK_PIPEPHY2>,
                 <&cru PCLK_PIPE>;
        clock-names = "ref", "apb", "pipe";
        assigned-clocks = <&pmucru CLK_PCIEPHY2_REF>;
        assigned-clock-rates = <100000000>;
        resets = <&cru SRST_PIPEPHY2>;
        rockchip,pipe-phy-grf = <&pipe_phy_grf2>;
        #phy-cells = <1>;
      };
    };
```
