## Documentation/devicetree/bindings/timer/realtek,otto-tc.yaml
```yaml
# SPDX-License-Identifier: GPL-2.0-only OR BSD-2-Clause
%YAML 1.2
---
$id: http://devicetree.org/schemas/timer/realtek,otto-tc.yaml#
$schema: http://devicetree.org/meta-schemas/core.yaml#

title: Realtek Otto platform timer/counter bindings

description:
  "Up-counting 28-bit timer that can operate in oneshot or repeating mode,
  providing an interrupt at roll-over.

  The timer is driven by a divided clock, derived from the bus clock. The clock
  divisor is configurable from 2 to 65535. Divisor values of 0 and 1 disable
  the timer clock. The timer can also be enabled or disabled independently from
  the clock (divisor) selection.

  The number of timers supported by the different SoC families is:
  - RTL8380: 5 timers
  - RTL8390: 5 timers
  - RTL9300: 6 timers
  - RTL9310: 7 timers"

maintainers:
  - Sander Vanheule <sander@svanheule.net>

properties:
  compatible:
    const: realtek,otto-tc

  reg:
    maxItems: 1

  interrupts:
    maxItems: 1

  clocks:
    items:
      - description: Parent clock from peripheral bus

  clock-names:
    items:
      - const: bus

additionalProperties: false

required:
  - compatible
  - reg
  - interrupts
  - clocks
  - clock-names

examples:
  - |
    timer0: timer@3100 {
      compatible = "realtek,otto-tc";
      reg = <0x3100 0x10>;

      interrupts = <29 4>;

      clocks = <&lx_clk>;
      clock-names = "bus";
    };
```

## Documentation/devicetree/bindings/timer/riscv,aclint-mtimer.yaml
```yaml
# SPDX-License-Identifier: (GPL-2.0-only OR BSD-2-Clause)
%YAML 1.2
---
$id: http://devicetree.org/schemas/timer/riscv,aclint-mtimer.yaml#
$schema: http://devicetree.org/meta-schemas/core.yaml#

title: RISC-V ACLINT M-level Timer

maintainers:
  - Anup Patel <anup.patel@wdc.com>

description:
  RISC-V SOCs include an implementation of the M-level timer (MTIMER) defined
  in the RISC-V Advanced Core Local Interruptor (ACLINT) specification. The
  ACLINT MTIMER device is documented in the RISC-V ACLINT specification found
  at https://github.com/riscv/riscv-aclint/blob/main/riscv-aclint.adoc.

  The ACLINT MTIMER device directly connects to the M-level timer interrupt
  lines of various HARTs (or CPUs) so the RISC-V per-HART (or per-CPU) local
  interrupt controller is the parent interrupt controller for the ACLINT
  MTIMER device.

  The clock frequency of ACLINT is specified via "timebase-frequency" DT
  property of "/cpus" DT node. The "timebase-frequency" DT property is
  described in Documentation/devicetree/bindings/riscv/cpus.yaml

properties:
  compatible:
    enum:
      - riscv,aclint-mtimer

    description:
      Should be "riscv,aclint-mtimer" or "<vendor>,<chip>-aclint-mtimer".

  reg:
    description: |
      Specifies base physical address(s) of the MTIME register and MTIMECMPx
      registers. The 1st region is the MTIME register base and size. The 2nd
      region is the MTIMECMPx registers base and size.
    minItems: 2
    maxItems: 2

  interrupts-extended:
    minItems: 1
    maxItems: 4095

  mtimer,no-64bit-mmio:
    type: boolean
    description: If present, the timer does not support 64-bit MMIO accesses
      for both MTIME and MTIMECMP registers.

additionalProperties: false

required:
  - compatible
  - reg
  - interrupts-extended

examples:
  - |
    timer@2000000 {
      compatible = "riscv,aclint-mtimer";
      reg = <0x2000000 0x8>,
            <0x2004000 0x7ff8>;
      interrupts-extended = <&cpu1intc 7>,
                            <&cpu2intc 7>,
                            <&cpu3intc 7>,
                            <&cpu4intc 7>;
    };
...
```

## Documentation/devicetree/bindings/timer/samsung,s5e99xx-mct.yaml
```yaml
# SPDX-License-Identifier: GPL-2.0
%YAML 1.2
---
$id: http://devicetree.org/schemas/timer/samsung,s5e99xx-mct.yaml#
$schema: http://devicetree.org/meta-schemas/core.yaml#

title: Samsung Exynos SoC Multi Core Timer (MCT)

maintainers:
  - Krzysztof Kozlowski <krzk@kernel.org>

description: |+
  The Samsung's Multi Core Timer (MCT) version 2 module includes
  one 64-bit FRC(Free Running Counter) and 12 comparators.
  The FRC serves up-counter and starts running at power-on.
  The 12 comparators use the FRC value to produce interrupts.
  They will produce interrupts when their internal value is matched with the FRC value.
  Theses interrupts can be used as local timer interrupt of each CPU.

properties:
  compatible:
    enum:
      - samsung,s5e99xx-mct

  clocks:
    items:
      - description: OSC clock
      - description: PCLK clock
      - description: RTC clock(optional)
    minItems: 2

  clock-names:
    items:
      - const: fin_pll
      - const: mct
      - const: rtc
    minItems: 2

  reg:
    maxItems: 1

  interrupts:
    description: |
      Interrupts should be put in specific order.
      0: Local Timer Interrupt 0
      1: Local Timer Interrupt 1
      2: Local Timer Interrupt 2
      3: ..
      4: ..
      i: Local Timer Interrupt n
    minItems: 1              #  1 local timer interrupts
    maxItems: 12             # 12 local timer interrupts

  div:
    description: If present, OSC clock freqency will be divided with this value.
      And the divided value will be provided to MCT module.

required:
  - compatible
  - clock-names
  - clocks
  - interrupts
  - reg

additionalProperties: false

examples:
  - |
    // In this example, the IP contains 12 local timers, using separate interrupts,
    // so 12 local timer interrupts have been specified,
    #include <dt-bindings/interrupt-controller/arm-gic.h>

    timer@10050000 {
        compatible = "samsung,s5e99xx-mct";
        reg = <0x10050000 0x800>;
        clocks = <&clock 1>, <&clock 10>;
        clock-names = "fin_pll", "mct";

        interrupts = <GIC_SPI 55 IRQ_TYPE_LEVEL_HIGH>,
                     <GIC_SPI 56 IRQ_TYPE_LEVEL_HIGH>,
                     <GIC_SPI 57 IRQ_TYPE_LEVEL_HIGH>,
                     <GIC_SPI 58 IRQ_TYPE_LEVEL_HIGH>,
                     <GIC_SPI 59 IRQ_TYPE_LEVEL_HIGH>,
                     <GIC_SPI 60 IRQ_TYPE_LEVEL_HIGH>,
                     <GIC_SPI 61 IRQ_TYPE_LEVEL_HIGH>,
                     <GIC_SPI 62 IRQ_TYPE_LEVEL_HIGH>,
                     <GIC_SPI 63 IRQ_TYPE_LEVEL_HIGH>,
                     <GIC_SPI 64 IRQ_TYPE_LEVEL_HIGH>,
                     <GIC_SPI 65 IRQ_TYPE_LEVEL_HIGH>,
                     <GIC_SPI 66 IRQ_TYPE_LEVEL_HIGH>;
    };
```

## Documentation/devicetree/bindings/timer/thead,clint.yaml
```yaml
# SPDX-License-Identifier: (GPL-2.0-only OR BSD-2-Clause)
%YAML 1.2
---
$id: http://devicetree.org/schemas/timer/thead,clint.yaml#
$schema: http://devicetree.org/meta-schemas/core.yaml#

title: SiFive Core Local Interruptor

maintainers:
  - Palmer Dabbelt <palmer@dabbelt.com>
  - Anup Patel <anup.patel@wdc.com>

description:
  T-HEAD (and other RISC-V) SOCs include an implementation of the T-HEAD
  Core Local Interruptor (CLINT) for M-mode timer and M-mode inter-processor
  interrupts. It directly connects to the timer and inter-processor interrupt
  lines of various HARTs (or CPUs) so RISC-V per-HART (or per-CPU) local
  interrupt controller is the parent interrupt controller for CLINT device.
  The clock frequency of the CLINT is specified via "timebase-frequency" DT
  property of "/cpus" DT node. The "timebase-frequency" DT property is
  described in Documentation/devicetree/bindings/riscv/cpus.yaml

properties:
  compatible:
    items:
      - const:
          - allwinner,sun20i-d1-clint
      - const:
          - thead,clint0

    description:
      Should be "<vendor>,<chip>-clint" and "thead,clint<version>" for
      the T-HEAD derived CLINTs.
      Supported compatible strings are -
      "allwinner,sun20i-d1-clint" for the CLINT in the Allwinner D1 SoC
      and "thead,clint0" for the T-HEAD IP block with no chip
      integration tweaks.

  reg:
    maxItems: 1

  interrupts-extended:
    minItems: 1

additionalProperties: false

required:
  - compatible
  - reg
  - interrupts-extended

examples:
  - |
    timer@2000000 {
      compatible = "allwinner,sun20i-d1-clint", "thead,clint0";
      interrupts-extended = <&cpu1intc 3 &cpu1intc 7
                             &cpu2intc 3 &cpu2intc 7
                             &cpu3intc 3 &cpu3intc 7
                             &cpu4intc 3 &cpu4intc 7>;
       reg = <0x2000000 0x10000>;
    };
...
```

## Documentation/devicetree/bindings/u-boot,chosen.yaml
```yaml
# SPDX-License-Identifier: GPL-2.0-only OR BSD-2-Clause
%YAML 1.2
---
$id: http://devicetree.org/schemas/u-boot,chosen.yaml#
$schema: http://devicetree.org/meta-schemas/core.yaml#

title: U-Boot setup

maintainers:
  - Rafał Miłecki <rafal@milecki.pl>

properties:
  u-boot,env:
    $ref: /schemas/types.yaml#/definitions/phandle-array
    description: |
      A list of storage volumes containing U-Boot environment data.

      Env data can be stored on various kinds of storage devices, e.g.:
      1. Raw flash partition
      2. UBI volume

additionalProperties: true

examples:
  - |
    chosen {
        u-boot,env = <&env>;
    };

    partitions {
        compatible = "fixed-partitions";
        #address-cells = <1>;
        #size-cells = <1>;

        env: partition@0 {
            reg = <0x0000000 0x1000>;
            label = "u-boot-env";
        };
    };
```

## Documentation/devicetree/bindings/u-boot/config.yaml
```yaml
# SPDX-License-Identifier: (GPL-2.0 OR BSD-2-Clause)
%YAML 1.2
---
$id: http://devicetree.org/schemas/u-boot/config.yaml#
$schema: http://devicetree.org/meta-schemas/core.yaml#

title: U-Boot configuration node

maintainers:
  - Simon Glass <sjg@chromium.org>

description: |
  The config node does not represent a real device, but serves as a place
  for passing data between firmware elements, like memory maps. Data in the
  config node does not represent the hardware. It is ignored by operating
  systems.

  Purpose of config node
  ----------------------

  A common problem with firmware is that many builds are needed to deal with the
  slight variations between different, related models. For example, one model
  may have a TPM and another may not. Devicetree provides an excellent solution
  to this problem, in that the devicetree to actually use on a platform can be
  injected in the factory based on which model is being manufactured at the time.

  A related problem causing build proliferation is dealing with the differences
  between development firmware, developer-friendly firmware (e.g. with all
  security features present but with the ability to access the command line),
  test firmware (which runs tests used in the factory), final production
  firmware (before signing), signed firmware (where the signatures have been
  inserted) and the like. Ideally all or most of these should use the same
  U-Boot build, with just some options to determine the features available. For
  example, being able to control whether the UART console or JTAG are available,
  on any image, is a great debugging aid.

  When the firmware consists of multiple parts (various U-Boot phases, TF-A,
  OP-TEE), it is helpful that all operate the same way at runtime, regardless of
  how they were built. This can be achieved by passing the runtime configuration
  (e.g. 'enable UART console', 'here are your public keys') along the chain
  through each firmware stage. It is frustrating to have to replicate a bug on
  production firmware which does happen on developer firmware, because they are
  completely different builds.

  The config node provides useful functionality for this. It allows the different
  controls to be 'factored out' of the U-Boot binary, so they can be controlled
  separately from the initial source-code build. The node can be easily updated
  by a build or factory tool and can control various features in U-Boot. It is
  similar in concept to a Kconfig option, except that it can be changed after
  U-Boot is built.

  The config node is similar in concept to /chosen (see chosen.yaml) except that
  it is for passing information *into* and *between) firmware components,
  instead of from firmware to the Operating System. Also, while operating
  systems typically have a (sometimes extremely long) command line, U-Boot does
  not support this, except with sandbox. The devicetree provides a more
  structured approach in any case.

properties:

  compatible:
    enum:
      - u-boot,config

  bootcmd:
    $ref: /schemas/types.yaml#/definitions/string
    description: |
      Allows overwriting of the boot command used by U-Boot on startup. If
      present, U-Boot uses this command instead. Note that this feature can
      work even if loading the environment is disabled, e.g. for security
      reasons. See also bootsecure.

  bootdelay-sec:
    description: |
      Allows selecting of the U-Boot bootdelay, to control whether U-Boot
      waits on boot or for how long. This allows this option to be configured
      by the build system or by a previous-stage binary. For example, if the
      images is being packed for testing or a user holds down a button, it may
      allow a delay, but disable it for production.

      If this property is not present, a default value is used instead.

      Note that this uses the 'sec' property unit, even though it allows a
      negative value.

      Values:

      -1: no bootdelay and the user cannot interrupt boot
      0: no bootdelay but use user can still interrupt boot by holding down a
        key, if enabled
      >= 1: delay for this many seconds


  bootsecure:
    $ref: /schemas/types.yaml#/definitions/uint32
    default: 0
    maximum: 2
    description: |
      Controls the execution of the boot command in U-Boot, e.g. selecting
      between using a special function to run commands, or the normal CLI. This
      can be used in production images, to restrict the amount of parsing done
      or the options available, to cut back on the available surface for
      security attacks.

      Values:

      0: normal boot using CLI (default if not present)
      1: use secure boot mechanism instead to parse and run commands
        other values are reserved for future use
      2: use simplified command line (e.g. avoid hush)
      3... reserved

  silent-console:
    $ref: /schemas/types.yaml#/definitions/uint32
    default: 0
    maximum: 2
    description: |
      This allows the console to be silenced by default on boot. This can allow
      easy disabling of console output on a production build, for example. When
      suppressed, the console is still active. This feature only suppresses the
      console output itself, on all output devices.

      Values:

      0: console output appears as normal (default)
      1: console output is suppressed but console recording still operates (if
        enabled)
      2: console output is suppressed and not recorded

required:
  - compatible

additionalProperties: false

examples:
  - |
    u-boot,config {
      compatible = "u-boot,config";
      bootcmd = "vboot go auto";
      bootdelay-sec = <(-1)>;
      bootsecure = <1>;
      silent-console = <1>;
    };
```
