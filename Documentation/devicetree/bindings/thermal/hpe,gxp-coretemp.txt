## Documentation/devicetree/bindings/usb/qcom,pmic-typec.yaml
```yaml
# SPDX-License-Identifier: (GPL-2.0-only OR BSD-2-Clause)
%YAML 1.2
---
$id: "http://devicetree.org/schemas/usb/qcom,pmic-typec.yaml#"
$schema: "http://devicetree.org/meta-schemas/core.yaml#"

title: Qualcomm PMIC based USB type C Detection Driver

maintainers:
  - Bryan O'Donoghue <bryan.odonoghue@linaro.org>

description: |
  Qualcomm PMIC Type C Detect

properties:
  compatible:
    enum:
      - qcom,pm8150b-typec

  reg:
    maxItems: 1
    description: Type C base address

  interrupts:
    items:
      - description: Bitmask of CC attach, VBUS error, tCCDebounce done and more
      - description: VCONN Powered Detection
      - description: CC state change
      - description: VCONN over-current condition
      - description: VBUS state change
      - description: Attach Deteach notification
      - description: Legacy cable detect
      - description: Try.Src Try.Snk state change

  interrupt-names:
    items:
      - const: or-rid-detect-change
      - const: vpd-detect
      - const: cc-state-change
      - const: vconn-oc
      - const: vbus-change
      - const: attach-detach
      - const: legacy-cable-detect
      - const: try-snk-src-detect

required:
  - compatible
  - reg
  - interrupts
  - interrupt-names

additionalProperties: false

examples:
  - |
    #include <dt-bindings/interrupt-controller/irq.h>
    #include <dt-bindings/usb/typec/tcpm/qcom,pmic-usb-typec.h>
    pm8150b {
        #address-cells = <1>;
        #size-cells = <0>;

        pm8150b_typec: typec@1500 {
            compatible = "qcom,pm8150b-typec";
            reg = <0x1500>;
            interrupts = <0x2 0x15 PMIC_TYPEC_OR_RID_IRQ
                          IRQ_TYPE_EDGE_RISING>,
                         <0x2 0x15 PMIC_TYPEC_VPD_IRQ
                          IRQ_TYPE_EDGE_BOTH>,
                         <0x2 0x15 PMIC_TYPEC_CC_STATE_IRQ
                          IRQ_TYPE_EDGE_RISING>,
                         <0x2 0x15 PMIC_TYPEC_VCONN_OC_IRQ
                          IRQ_TYPE_EDGE_BOTH>,
                         <0x2 0x15 PMIC_TYPEC_VBUS_IRQ
                          IRQ_TYPE_EDGE_RISING>,
                         <0x2 0x15 PMIC_TYPEC_ATTACH_DETACH_IRQ
                          IRQ_TYPE_EDGE_RISING>,
                         <0x2 0x15 PMIC_TYPEC_LEGACY_CABLE_IRQ
                          IRQ_TYPE_EDGE_BOTH>,
                         <0x2 0x15 PMIC_TYPEC_TRY_SNK_SRC_IRQ
                          IRQ_TYPE_EDGE_RISING>;
            interrupt-names = "or-rid-detect-change",
                              "vpd-detect",
                              "cc-state-change",
                              "vconn-oc",
                              "vbus-change",
                              "attach-detach",
                              "legacy-cable-detect",
                              "try-snk-src-detect";
        };
    };
...
```
