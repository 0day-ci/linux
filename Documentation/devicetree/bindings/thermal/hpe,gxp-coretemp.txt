## Documentation/devicetree/bindings/thermal/hpe,gxp-coretemp.txt
```
* HPE GXP CORETEMP INTERFACE

Required parent device properties:
- compatible : Should be "hpe,gxp-coretemp".
- reg : Specifies base physical address and size of the control register.

Example:

	coretemp: coretemp@c0000130 {
		compatible = "hpe,gxp-coretemp";
		reg = <0xc0000130 0x8>;
	};
```

## Documentation/devicetree/bindings/thermal/qcom-lmh.yaml
```yaml
# SPDX-License-Identifier: (GPL-2.0-only OR BSD-2-Clause)
# Copyright 2021 Linaro Ltd.
%YAML 1.2
---
$id: http://devicetree.org/schemas/thermal/qcom-lmh.yaml#
$schema: http://devicetree.org/meta-schemas/core.yaml#

title: Qualcomm Limits Management Hardware(LMh)

maintainers:
  - Thara Gopinath <thara.gopinath@linaro.org>

description:
  Limits Management Hardware(LMh) is a hardware infrastructure on some
  Qualcomm SoCs that can enforce temperature and current limits as
  programmed by software for certain IPs like CPU.

properties:
  compatible:
    enum:
      - qcom,sdm845-lmh

  reg:
    items:
      - description: core registers

  interrupts:
    maxItems: 1

  '#interrupt-cells':
    const: 1

  interrupt-controller: true

  qcom,lmh-cpu-id:
    description:
      CPU id of the first cpu in the LMh cluster
    $ref: /schemas/types.yaml#/definitions/uint32

  qcom,lmh-temperature-arm:
    description:
      An integer expressing temperature threshold in millicelsius at which
      the LMh thermal FSM is engaged.
    $ref: /schemas/types.yaml#/definitions/int32

  qcom,lmh-temperature-low:
    description:
      An integer expressing temperature threshold in millicelsius at which
      the LMh thermal FSM is engaged.
    $ref: /schemas/types.yaml#/definitions/int32

  qcom,lmh-temperature-high:
    description:
      An integer expressing temperature threshold in millicelsius at which
      the LMh thermal FSM is engaged.
    $ref: /schemas/types.yaml#/definitions/int32

required:
  - compatible
  - reg
  - interrupts
  - #interrupt-cells
  - interrupt-controller
  - qcom,lmh-cpu-id
  - qcom,lmh-temperature-arm
  - qcom,lmh-temperature-low
  - qcom,lmh-temperature-high

additionalProperties: false

examples:
  - |
    #include <dt-bindings/interrupt-controller/arm-gic.h>
    #include <dt-bindings/clock/qcom,rpmh.h>
    #include <dt-bindings/interconnect/qcom,sdm845.h>

    lmh_cluster1: lmh@17d70800 {
      compatible = "qcom,sdm845-lmh";
      reg = <0 0x17d70800 0 0x401>;
      interrupts = <GIC_SPI 33 IRQ_TYPE_LEVEL_HIGH>;
      qcom,lmh-cpu-id = <0x4>;
      qcom,lmh-temperature-arm = <65000>;
      qcom,lmh-temperature-low = <94500>;
      qcom,lmh-temperature-high = <95000>;
      interrupt-controller;
      #interrupt-cells = <1>;
    };
  - |
    lmh_cluster0: lmh@17d78800 {
      compatible = "qcom,sdm845-lmh";
      reg = <0 0x17d78800 0 0x401>;
      interrupts = <GIC_SPI 32 IRQ_TYPE_LEVEL_HIGH>;
      qcom,lmh-cpu-id = <0x0>;
      qcom,lmh-temperature-arm = <65000>;
      qcom,lmh-temperature-low = <94500>;
      qcom,lmh-temperature-high = <95000>;
      interrupt-controller;
      #interrupt-cells = <1>;
    };
  - |
```

## Documentation/devicetree/bindings/thermal/sunplus_thermal.yaml
```yaml
# SPDX-License-Identifier: (GPL-2.0 OR BSD-2-Clause)
# Copyright (C) Sunplus Co., Ltd.
%YAML 1.2
---
$id: http://devicetree.org/schemas/thermal/sunplus_thermal.yaml#
$schema: http://devicetree.org/meta-schemas/core.yaml#

title: Sunplus Thermal controller

maintainers:
  - Li-hao Kuo <lhjeff911@gmail.com>

properties:
  compatible:
    enum:
      - sunplus,sp7021-thermal

  reg:
    maxItems: 1

  reg-names:
    items:
      - const: reg
      - const: moon4

  nvmem-cells:
    maxItems: 1

  nvmem-cell-names:
    const: therm_calib

required:
  - compatible
  - reg
  - reg-names
  - nvmem-cells
  - nvmem-cell-names

additionalProperties: false

examples:
  - |
    thermal@9c000280 {
        compatible = "sunplus,sp7021-thermal";
        reg = <0x9c000280 0x80>;
        nvmem-cells = <&therm_calib>;
        nvmem-cell-names = "therm_calib";
    };
...
```

## Documentation/devicetree/bindings/thermal/virtual,thermal-sensor.yaml
```yaml
# SPDX-License-Identifier: (GPL-2.0-only OR BSD-2-Clause)
# Copyright 2021 BayLibre
%YAML 1.2
---
$id: http://devicetree.org/schemas/thermal/virtual,thermal-sensor.yaml#
$schema: http://devicetree.org/meta-schemas/core.yaml#

title: Virtual thermal sensor binding

maintainers:
  - Alexandre Bailon <abailon@baylibre.com>

description: |
  The virtual thermal sensor device provides a way to aggregate the temperature
  from multiple thermal zones. Basically, this could be used to get the
  maximum, minimum or average temperature.

allOf:
  - $ref: thermal-sensor.yaml#

properties:
  compatible:
    const: virtual,thermal-sensor

  aggregation-function:
    $ref: /schemas/types.yaml#/definitions/uint32
    description:
      Used to select the operations to perform on the sensors to get the virtual
      sensor temperature.
    enum:
      - VIRTUAL_THERMAL_SENSOR_MIN_VAL
      - VIRTUAL_THERMAL_SENSOR_MAX_VAL
      - VIRTUAL_THERMAL_SENSOR_AVG_VAL

  thermal-sensors:
    $ref: /schemas/types.yaml#/definitions/string-array
    description:
      The names of the thermal zone to aggregate.

required:
  - aggregation-function
  - thermal-sensors

additionalProperties: true

examples:
  - |
    #include <dt-bindings/thermal/thermal.h>
    #include <dt-bindings/thermal/virtual-sensor.h>
    #include <dt-bindings/interrupt-controller/arm-gic.h>
    #include <dt-bindings/clock/mt8192-clk.h>

    lvts: lvts@1100b000 {
        compatible = "mediatek,mt6873-lvts";
        reg = <0x1100b000 0x1000>;
        clocks = <&infracfg CLK_INFRA_THERM>;
        clock-names = "lvts_clk";
        #thermal-sensor-cells = <1>;
        interrupts = <GIC_SPI 147 IRQ_TYPE_LEVEL_HIGH>;
    };

    cpu_max_sensor: cpu_max_sensor {
      compatible = "virtual,thermal-sensor";
      #thermal-sensor-cells = <1>;
      aggregation-function = <VIRTUAL_THERMAL_SENSOR_MAX_VAL>;
      thermal-sensors = "cpu1", "cpu2";
    };

    thermal_zones: thermal-zones {
      cpu1 {
        polling-delay = <0>; /* milliseconds */
        polling-delay-passive = <0>; /* milliseconds */
        thermal-sensors = <&lvts 0>;
      };
      cpu2 {
        polling-delay = <0>; /* milliseconds */
        polling-delay-passive = <0>; /* milliseconds */
        thermal-sensors = <&lvts 1>;
      };
      cpu_max {
        polling-delay = <0>; /* milliseconds */
        polling-delay-passive = <0>; /* milliseconds */
        thermal-sensors = <&cpu_max_sensor 0>;
      };
    };
...
```

## Documentation/devicetree/bindings/timer/faraday,fttmr010.yaml
```yaml
# SPDX-License-Identifier: (GPL-2.0-only OR BSD-2-Clause)
%YAML 1.2
---
$id: http://devicetree.org/schemas/timer/faraday,fttmr010.yaml#
$schema: http://devicetree.org/meta-schemas/core.yaml#

title: Faraday Technology timer

maintainers:
  - Linus Walleij <linus.walleij@linaro.org>

description: |
  This timer is a generic IP block from Faraday Technology, embedded in the
  Cortina Systems Gemini SoCs and other designs.

properties:
  compatible:
    oneOf:
      - const: faraday,fttmr010
      - items:
          - const: cortina,gemini-timer
          - const: faraday,fttmr010
      - items:
          - const: moxa,moxart-timer
          - const: faraday,fttmr010
      - const: aspeed,ast2400-timer
      - const: aspeed,ast2500-timer
      - const: aspeed,ast2600-timer

  reg:
    maxItems: 1

  resets:
    maxItems: 1

  interrupts:
    minItems: 1
    maxItems: 3
    description: Should contain the three timer interrupts usually with flags for falling edge

  clocks:
    minItems: 1
    maxItems: 2

  clock-names:
    minItems: 1
    items:
      - const: "PCLK"
      - const: "EXTCLK"

  syscon:
    $ref: /schemas/types.yaml#/definitions/phandle
    maxItems: 1

required:
  - compatible
  - reg
  - interrupts
  - clocks
  - clock-names

additionalProperties: false

examples:
  - |
    #include <dt-bindings/interrupt-controller/irq.h>
    /* taken from arch/arm/boot/dts/gemini.dtsi */
    timer@43000000 {
      compatible = "faraday,fttmr010";
      reg = <0x43000000 0x1000>;
      interrupts = <14 IRQ_TYPE_EDGE_FALLING>, /* Timer 1 */
                   <15 IRQ_TYPE_EDGE_FALLING>, /* Timer 2 */
                   <16 IRQ_TYPE_EDGE_FALLING>; /* Timer 3 */
      clocks = <&extclk>, <&pclk>;
      clock-names = "PCLK", "EXTCLK";
      syscon = <&syscon>;
    };
  - |
    #include <dt-bindings/interrupt-controller/irq.h>
    /* taken from arch/arm/boot/dts/moxart.dtsi */
    timer: timer@98400000 {
      compatible = "moxa,moxart-timer", "faraday,fttmr010";
      reg = <0x98400000 0x42>;
      interrupts = <19 IRQ_TYPE_EDGE_FALLING>;
      clocks = <&clk_apb>;
      clock-names = "PCLK";
    };
...
```

## Documentation/devicetree/bindings/timer/hpe,gxp-timer.txt
```
*HPE GXP TIMER

Required properties:

- compatible : Must be "hpe,gxp-timer"
- reg : The GXP Timer Control Registers (Addresses + size) tuples list.
- interrupts : The interrupt number.
- clock-frequency : The frequency of the clock that drives the counter, in Hz.

Example:

	timer0: timer@c0000080 {
		compatible = "hpe,gxp-timer";
		reg = <0xc0000080 0x1>, <0xc0000094 0x01>, <0xc0000088 0x08>;
		interrupts = <0>;
		interrupt-parent = <&vic0>;
		clock-frequency = <400000000>;
	};
```

## Documentation/devicetree/bindings/timer/hpe,gxp-timer.yaml
```yaml
# SPDX-License-Identifier: (GPL-2.0-only OR BSD-2-Clause)
%YAML 1.2
---
$id: http://devicetree.org/schemas/timer/hpe,gxp-timer.yaml#
$schema: http://devicetree.org/meta-schemas/core.yaml#

title: HPE GXP TIMER

maintainers:
  - Nick Hawkins <nick.hawkins@hpe.com>
  - Jean-Marie Verdun <verdun@hpe.com>

properties:
  compatible:
    const: hpe,gxp-timer

  reg:
    items:
      - description: T0CNT register
      - description: T0CS register
      - description: TIMELO register

  interrupts:
    maxItems: 1

  clock-frequency:
    description: The frequency of the clock that drives the counter, in Hz.

required:
  - compatible
  - reg
  - interrupts
  - clock-frequency

additionalProperties: false

examples:
  - |
    timer@10003000 {
        compatible = "hpe,gxp-timer";
        reg = <0xc0000080 0x1>, <0xc0000094 0x01>, <0xc0000088 0x08>;
        interrupts = <0>;
        interrupt-parent = <&vic0>;
        clock-frequency = <400000000>;
    };
```

## Documentation/devicetree/bindings/timer/intel,keembay-timer.yaml
```yaml
# SPDX-License-Identifier: (GPL-2.0-only OR BSD-2-Clause)
%YAML 1.2
---
$id: http://devicetree.org/schemas/timer/intel,keembay-timer.yaml#
$schema: http://devicetree.org/meta-schemas/core.yaml#

title: Intel Keem Bay SoC Timers

maintainers:
  - Shruthi Sanil <shruthi.sanil@intel.com>

description: |
  The Intel Keem Bay timer driver supports 1 free running counter and 8 timers.
  Each timer is capable of generating inividual interrupt.
  Both the features are enabled through the timer general config register.

  The parent node represents the common general configuration details and
  the child nodes represents the counter and timers.

properties:
  compatible:
    oneOf:
      - items:
          - enum:
              - intel,keembay-gpt-creg
          - const: simple-mfd

  reg:
    description: General configuration register address and length.
    maxItems: 1

  ranges: true

  "#address-cells":
    const: 1

  "#size-cells":
    const: 1

required:
  - compatible
  - reg
  - ranges
  - "#address-cells"
  - "#size-cells"

patternProperties:
  "^counter@[0-9a-f]+$":
    description: Properties for Intel Keem Bay counter.
    type: object
    properties:
      compatible:
        oneOf:
          - items:
              - enum:
                  - intel,keembay-counter

      reg:
        maxItems: 1

      clocks:
        maxItems: 1

    required:
      - compatible
      - reg
      - clocks

  "^timer@[0-9a-f]+$":
    description: Properties for Intel Keem Bay timer
    type: object
    properties:
      compatible:
        oneOf:
          - items:
              - enum:
                  - intel,keembay-timer

      reg:
        maxItems: 1

      interrupts:
        maxItems: 1

      clocks:
        maxItems: 1

    required:
      - compatible
      - reg
      - interrupts
      - clocks

additionalProperties: false

examples:
  - |
    #include <dt-bindings/interrupt-controller/arm-gic.h>
    #include <dt-bindings/interrupt-controller/irq.h>
    #define KEEM_BAY_A53_TIM

    soc {
        #address-cells = <0x2>;
        #size-cells = <0x2>;

        gpt@20331000 {
            compatible = "intel,keembay-gpt-creg", "simple-mfd";
            reg = <0x0 0x20331000 0x0 0xc>;
            ranges = <0x0 0x0 0x20330000 0xF0>;
            #address-cells = <0x1>;
            #size-cells = <0x1>;

            counter@e8 {
                compatible = "intel,keembay-counter";
                reg = <0xe8 0x8>;
                clocks = <&scmi_clk KEEM_BAY_A53_TIM>;
            };

            timer@30 {
                compatible = "intel,keembay-timer";
                reg = <0x30 0xc>;
                interrupts = <GIC_SPI 0x5 IRQ_TYPE_LEVEL_HIGH>;
                clocks = <&scmi_clk KEEM_BAY_A53_TIM>;
            };
        };
    };

...
```

## Documentation/devicetree/bindings/timer/qcom,msm-timer.yaml
```yaml
# SPDX-License-Identifier: (GPL-2.0-only OR BSD-2-Clause)
%YAML 1.2
---
$id: http://devicetree.org/schemas/timer/qcom,msm-timer.yaml#
$schema: http://devicetree.org/meta-schemas/core.yaml#

title: Qualcomm MSM Timer

maintainers:
  - Rob Herring <robh@kernel.org>

properties:
  $nodename:
    pattern: '^timer@[a-f0-9]+$'

  compatible:
    oneOf:
      - items:
          - const: qcom,kpss-timer
          - enum:
              - qcom,kpss-wdt-apq8064
              - qcom,kpss-wdt-ipq8064
              - qcom,kpss-wdt-msm8960
          - const: qcom,msm-timer
      - items:
          - enum:
              - qcom,kpss-timer  # Krait subsystem
              - qcom,scss-timer  # Scorpion subsystem
          - const: qcom,msm-timer

  reg:
    maxItems: 1

  interrupts:
    minItems: 1
    items:
      - description: 1st purpose timer
      - description: 2nd general purpose timer
      - description: 1st watchdog interrupt
      - description: 2nd watchdog interrupt
      - description: 3nd watchdog interrupt

  clocks: true

  clock-names: true

  clock-frequency: true

  cpu-offset:
    $ref: /schemas/types.yaml#/definitions/uint32
    description: >
      Per-cpu offset used when the timer is accessed without the
      CPU remapping facilities. The offset is cpu-offset + (0x10000 * cpu-nr).

required:
  - compatible
  - reg
  - interrupts
  - clock-frequency

additionalProperties: false

examples:
  - |
    timer@200a000 {
        compatible = "qcom,scss-timer", "qcom,msm-timer";
        interrupts = <1 1 0x301>,
                     <1 2 0x301>,
                     <1 3 0x301>,
                     <1 4 0x301>,
                     <1 5 0x301>;
        reg = <0x0200a000 0x100>;
        clock-frequency = <19200000>,
                          <32768>;
        clocks = <&sleep_clk>;
        clock-names = "sleep";
        cpu-offset = <0x40000>;
    };
```
