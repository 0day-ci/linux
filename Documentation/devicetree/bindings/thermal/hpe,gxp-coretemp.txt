## Documentation/devicetree/bindings/ufs/cdns,ufshc.yaml
```yaml
# SPDX-License-Identifier: (GPL-2.0 OR BSD-2-Clause)
%YAML 1.2
---
$id: http://devicetree.org/schemas/ufs/cdns,ufshc.yaml#
$schema: http://devicetree.org/meta-schemas/core.yaml#

title: Cadence Universal Flash Storage (UFS) Controller

maintainers:
  - Dhananjay Kangude <dkangude@cadence.com>

description:
  UFS nodes are defined to describe on-chip Cadence UFS host controllers.
  Each UFS controller instance should have its own node.

properties:
  compatible:
    oneOf:
      - items:
          - enum:
              - cdns,ufshc
              - cdns,ufshc-m31-16nm
          - const: jedec,ufs-2.0
      - items:
          - const: jedec,ufs-2.0

  reg:
    items:
      - description: UFS controller register set

  interrupts:
    maxItems: 1

  clocks:
    minItems: 1
    items:
      - description: Description of core_clk
      - description: Description of phy_clk
      - description: Description of ref_clk

  clock-names:
    minItems: 1
    items:
      - const: core_clk
      - const: phy_clk
      - const: ref_clk

  freq-table-hz:
    $ref: /schemas/types.yaml#/definitions/uint64-matrix
    description:
      Clock frequency table.
      See the ufshcd-pltfrm.txt for details.

  dma-coherent: true

required:
  - compatible
  - reg
  - interrupts
  - freq-table-hz
  - clocks
  - clock-names

additionalProperties: false
unevaluatedProperties: false

examples:
  - |
    #include <dt-bindings/interrupt-controller/irq.h>
    #include <dt-bindings/interrupt-controller/arm-gic.h>

    ufs: ufs@fd030000 {
         compatible = "cdns,ufshc", "jedec,ufs-2.0";
         reg = <0xfd030000 0x10000>;
         interrupts = <0 1 IRQ_TYPE_LEVEL_HIGH>;
         freq-table-hz = <0 0>;
         clocks = <&ufs_core_clk>;
         clock-names = "core_clk";
    };
```

## Documentation/devicetree/bindings/usb/allwinner,sun50i-h6-dwc3.yaml
```yaml
# SPDX-License-Identifier: (GPL-2.0-only OR BSD-2-Clause)
%YAML 1.2
---
$id: http://devicetree.org/schemas/usb/allwinner,sun50i-h6-dwc3.yaml#
$schema: http://devicetree.org/meta-schemas/core.yaml#

title: Allwinner H6 DWC3 USB controller

maintainers:
  - Chen-Yu Tsai <wens@csie.org>
  - Maxime Ripard <mripard@kernel.org>

properties:
  compatible:
    const: allwinner,sun50i-h6-dwc3

  "#address-cells": true

  "#size-cells": true

  ranges: true

  resets:
    maxItems: 1

# Required child node:

patternProperties:
  "^phy@[0-9a-f]+$":
    $ref: ../phy/allwinner,sun50i-h6-usb3-phy.yaml#

  "^usb@[0-9a-f]+$":
    $ref: snps,dwc3.yaml#

required:
  - compatible
  - ranges
  - resets

additionalProperties: false

examples:
  - |
    #include <dt-bindings/interrupt-controller/arm-gic.h>
    #include <dt-bindings/clock/sun50i-h6-ccu.h>
    #include <dt-bindings/reset/sun50i-h6-ccu.h>

    usb3: usb@5200000 {
        compatible = "allwinner,sun50i-h6-dwc3";
        #address-cells = <1>;
        #size-cells = <1>;
        ranges;
        resets = <&ccu RST_BUS_XHCI>;

        dwc3: usb@5200000 {
            compatible = "snps,dwc3";
            reg = <0x05200000 0x10000>;
            interrupts = <GIC_SPI 26 IRQ_TYPE_LEVEL_HIGH>;
            clocks = <&ccu CLK_BUS_XHCI>,
                     <&ccu CLK_BUS_XHCI>,
                     <&rtc 0>;
            clock-names = "ref", "bus_early", "suspend";
            dr_mode = "host";
            phys = <&usb3phy>;
            phy-names = "usb3-phy";
        };

        usb3phy: phy@5210000 {
            compatible = "allwinner,sun50i-h6-usb3-phy";
            reg = <0x5210000 0x10000>;
            clocks = <&ccu CLK_USB_PHY1>;
            resets = <&ccu RST_USB_PHY1>;
            #phy-cells = <0>;
        };
    };
```

## Documentation/devicetree/bindings/usb/analogix,anx7411.yaml
```yaml
# SPDX-License-Identifier: GPL-2.0-only OR BSD-2-Clause
%YAML 1.2
---
$id: "http://devicetree.org/schemas/usb/analogix,anx7411.yaml#"
$schema: "http://devicetree.org/meta-schemas/core.yaml#"

title: Analogix ANX7411 Type-C controller bindings

maintainers:
  - Xin Ji <xji@analogixsemi.com>

properties:
  compatible:
    enum:
      - analogix,anx7411

  reg:
    maxItems: 1

  interrupts:
    maxItems: 1

  connector:
    type: object

    allOf:
      - $ref: ../connector/usb-connector.yaml

    properties:
      compatible:
        const: usb-c-connector

      power-role: true

      data-role: true

      try-power-role: true

    required:
      - compatible

required:
  - compatible
  - reg
  - connector

additionalProperties: false

examples:
  - |
    #include <dt-bindings/interrupt-controller/irq.h>
    i2c1 {
        #address-cells = <1>;
        #size-cells = <0>;

        typec: anx7411@2C {
            compatible = "analogix,anx7411";
            reg = <0x2C>;
            interrupts = <8 IRQ_TYPE_EDGE_FALLING>;
            interrupt-parent = <&gpio0>;

            typec_con: connector {
                compatible = "usb-c-connector";
                power-role = "dual";
                data-role = "dual";
                try-power-role = "source";

                port {
                    typec_con_ep: endpoint {
                        remote-endpoint = <&usbotg_hs_ep>;
                    };
                };
            };
        };
    };
...
```

## Documentation/devicetree/bindings/usb/hisilicon,hi3670-dwc3.yaml
```yaml
# SPDX-License-Identifier: GPL-2.0
%YAML 1.2
---
$id: http://devicetree.org/schemas/usb/hisilicon,hi3670-dwc3.yaml#
$schema: http://devicetree.org/meta-schemas/core.yaml#

title: HiSilicon Kirin970 USB3 Controller

maintainers:
  - Mauro Carvalho Chehab <mchehab+huawei@kernel.org>

description:
  Bindings for the USB3 DWC3 controller present on Kirin970.

properties:
  compatible:
    const: hisilicon,hi3670-dwc3

  clocks:
    maxItems: 4

  clock-names:
    items:
      - const: clk_gate_abb_usb
      - const: hclk_gate_usb3otg
      - const: clk_gate_usb3otg_ref
      - const: aclk_gate_usb3dvfs

  ranges: true

  assigned-clocks:
    maxItems: 1

  assigned-clock-rates:
    maxItems: 1

  resets:
    maxItems: 4

  '#address-cells':
    const: 2

  '#size-cells':
    const: 2

# Required child node:

patternProperties:
  "^usb@[0-9a-f]+$":
    $ref: snps,dwc3.yaml#

required:
  - compatible
  - ranges
  - clocks
  - clock-names
  - assigned-clocks
  - assigned-clock-rates
  - resets

additionalProperties: false

examples:
  - |
    #include <dt-bindings/clock/hi3670-clock.h>
    #include <dt-bindings/interrupt-controller/irq.h>

    bus {
      #address-cells = <2>;
      #size-cells = <2>;

      usb3: hisi_dwc3 {
        compatible = "hisilicon,hi3670-dwc3";
        #address-cells = <2>;
        #size-cells = <2>;
        ranges;

        clocks = <&crg_ctrl HI3670_CLK_GATE_ABB_USB>,
                 <&crg_ctrl HI3670_HCLK_GATE_USB3OTG>,
                 <&crg_ctrl HI3670_CLK_GATE_USB3OTG_REF>,
                 <&crg_ctrl HI3670_ACLK_GATE_USB3DVFS>;
        clock-names = "clk_gate_abb_usb",
                      "hclk_gate_usb3otg",
                      "clk_gate_usb3otg_ref",
                      "aclk_gate_usb3dvfs";

        assigned-clocks = <&crg_ctrl HI3670_ACLK_GATE_USB3DVFS>;
        assigned-clock-rates = <238000000>;
        resets = <&crg_rst 0x90 6>,
                 <&crg_rst 0x90 7>,
                 <&usb31_misc_rst 0xA0 8>,
                 <&usb31_misc_rst 0xA0 9>;

        dwc3: usb@ff100000 {
          compatible = "snps,dwc3";
          reg = <0x0 0xff100000 0x0 0x100000>;

          interrupts = <0 159 IRQ_TYPE_LEVEL_HIGH>,
                       <0 161 IRQ_TYPE_LEVEL_HIGH>;

          phys = <&usb_phy>;
          phy-names = "usb3-phy";
        };
      };
    };
```

## Documentation/devicetree/bindings/usb/hpe,gxp-udc.txt
```
* HPE USB Device Port Controller

Required properties:
- compatible: Must be "hpe,gxp-udc".
- reg: Specifies base physical address and size of the registers.
- interrupts: The interrupt number.
- vdevnum: The particular usb device controller port.
- fepnum: The particular usb device controller options.
- udcg-handle: The usb device controller hub.

Example:

	udc0: udc@80401000 {
		compatible = "hpe,gxp-udc";
		reg = <0x80401000 0x1000>;
		interrupts = <13>;
		interrupt-parent = <&vic1>;
		vdevnum = <0>;
		fepnum = <7>;
		udcg-handle = <&udcg>;
	};
```

## Documentation/devicetree/bindings/usb/microchip,sama7g5-tcpc.yaml
```yaml
# SPDX-License-Identifier: (GPL-2.0 OR BSD-2-Clause)
%YAML 1.2
---
$id: "http://devicetree.org/schemas/usb/microchip,sama7g5-tcpc.yaml#"
$schema: "http://devicetree.org/meta-schemas/core.yaml#"

title: Microchip SAMA7G5 Type-C port controller bindings

maintainers:
  - Cristian Birsan <cristian.birsan@microchip.com>

properties:
  compatible:
    enum:
      - microchip,sama7g5-tcpc

  reg:
    maxItems: 1

  clocks:
    items:
      - description: Peripheral Bus Clock
      - description: Generic Clock

  clock-names:
    items:
      - const: pclk
      - const: gclk

  vbus-supply:
    description: vbus power supply (5V) phandle

  microchip,vbus-gpio:
    description: vbus detect gpio

  connector:
    type: object

    allOf:
      - $ref: ../connector/usb-connector.yaml

    properties:
      compatible:
        const: usb-c-connector

      power-role: true

    required:
      - compatible

required:
  - compatible
  - reg
  - connector

additionalProperties: false

examples:
  - |
    #include <dt-bindings/clock/at91.h>
    #include <dt-bindings/usb/pd.h>
    tcpcb: tcpcb@e0844000 {
      compatible = "microchip,sama7g5-tcpc";
      reg = <0xe0844000 0x3fff>;
      clocks = <&pmc PMC_TYPE_PERIPHERAL 95>, <&pmc PMC_TYPE_GCK 95>;
      clock-names = "pclk", "gclk";

      usb_con: connector {
        #address-cells = <1>;
        #size-cells = <0>;
        compatible = "usb-c-connector";
        label = "USB-C";
        data-role = "device";
        power-role = "sink";
        try-power-role = "sink";
        source-pdos = <PDO_FIXED(5000, 500,
            PDO_FIXED_USB_COMM)>;
        sink-pdos = <PDO_FIXED(5000, 500,
            PDO_FIXED_USB_COMM)>;
        op-sink-microwatt = <2500000>;

        port@1 {
          reg = <1>;
          usb_con_hs: endpoint {
            remote-endpoint = <&usb_phy1>;
          };
        };
      };
    };
...
```

## Documentation/devicetree/bindings/usb/nxp,isp1760.yaml
```yaml
# SPDX-License-Identifier: (GPL-2.0-only OR BSD-2-Clause)
%YAML 1.2
---
$id: http://devicetree.org/schemas/usb/nxp,isp1760.yaml#
$schema: http://devicetree.org/meta-schemas/core.yaml#

title: NXP ISP1760 family controller bindings

maintainers:
  - Sebastian Siewior <bigeasy@linuxtronix.de>
  - Laurent Pinchart <laurent.pinchart@ideasonboard.com>

description: |
  NXP ISP1760 family, which includes ISP1760/1761/1763 devicetree controller
  bindings

properties:
  compatible:
    enum:
      - nxp,isp1760
      - nxp,isp1761
      - nxp,isp1763
  reg:
    maxItems: 1

  interrupts:
    maxItems: 1

  bus-width:
    description:
      Number of data lines.
    enum: [8, 16, 32]
    default: 32

  dr_mode:
    enum:
      - host
      - peripheral

required:
  - compatible
  - reg
  - interrupts

additionalProperties: true

examples:
  - |
    #include <dt-bindings/interrupt-controller/arm-gic.h>
    usb: usb@40200000 {
        compatible = "nxp,usb-isp1763";
        reg = <0x040200000 0x100000>;
        interrupts-parent = <&gic>;
        interrupts = <GIC_SPI 114 IRQ_TYPE_LEVEL_HIGH>;
        bus-width = <16>;
        dr_mode = "host";
    };

...
```

## Documentation/devicetree/bindings/usb/qcom,pmic-pdphy.yaml
```yaml
# SPDX-License-Identifier: (GPL-2.0-only OR BSD-2-Clause)
%YAML 1.2
---
$id: "http://devicetree.org/schemas/usb/qcom,pmic-pdphy.yaml#"
$schema: "http://devicetree.org/meta-schemas/core.yaml#"

title: Qualcomm PMIC based USB PDPHY driver

maintainers:
  - Bryan O'Donoghue <bryan.odonoghue@linaro.org>

description: |
  Qualcomm PMIC Power Delivery PHY driver

properties:
  compatible:
    enum:
      - qcom,pm8150b-pdphy

  reg:
    maxItems: 1
    description: PDPHY base address

  interrupts:
    items:
      - description: Sig TX - transmitted reset signal
      - description: Sig RX - received reset signal
      - description: TX completion
      - description: RX completion
      - description: TX fail
      - description: TX discgard
      - description: RX discgard
      - description: Fast Role Swap event

  interrupt-names:
    items:
      - const: sig-tx
      - const: sig-rx
      - const: msg-tx
      - const: msg-rx
      - const: msg-tx-failed
      - const: msg-tx-discarded
      - const: msg-rx-discarded
      - const: fr-swap

required:
  - compatible
  - reg
  - interrupts
  - interrupt-names

additionalProperties: false

examples:
  - |
    #include <dt-bindings/interrupt-controller/irq.h>
    #include <dt-bindings/usb/typec/tcpm/qcom,pmic-usb-pdphy.h>

    pm8150b {
        #address-cells = <1>;
        #size-cells = <0>;

        pm8150b_pdphy: pdphy@1700 {
            compatible = "qcom,pm8150b-pdphy";
            reg = <0x1700>;
            interrupts = <0x2 0x17 PMIC_PDPHY_SIG_TX_IRQ
                          IRQ_TYPE_EDGE_RISING>,
                         <0x2 0x17 PMIC_PDPHY_SIG_RX_IRQ
                          IRQ_TYPE_EDGE_RISING>,
                         <0x2 0x17 PMIC_PDPHY_MSG_TX_IRQ
                          IRQ_TYPE_EDGE_RISING>,
                         <0x2 0x17 PMIC_PDPHY_MSG_RX_IRQ
                          IRQ_TYPE_EDGE_RISING>,
                         <0x2 0x17 PMIC_PDPHY_MSG_TX_FAIL_IRQ
                          IRQ_TYPE_EDGE_RISING>,
                         <0x2 0x17 PMIC_PDPHY_MSG_TX_DISCARD_IRQ
                          IRQ_TYPE_EDGE_RISING>,
                         <0x2 0x17 PMIC_PDPHY_MSG_RX_DISCARD_IRQ
                          IRQ_TYPE_EDGE_RISING>,
                         <0x2 0x17 PMIC_PDPHY_FR_SWAP_IRQ
                          IRQ_TYPE_EDGE_RISING>;
            interrupt-names = "sig-tx",
                              "sig-rx",
                              "msg-tx",
                              "msg-rx",
                              "msg-tx-failed",
                              "msg-tx-discarded",
                              "msg-rx-discarded",
                              "fr-swap";
        };
    };
...
```

## Documentation/devicetree/bindings/usb/qcom,pmic-tcpm.yaml
```yaml
# SPDX-License-Identifier: (GPL-2.0-only OR BSD-2-Clause)
%YAML 1.2
---
$id: "http://devicetree.org/schemas/usb/qcom,pmic-tcpm.yaml#"
$schema: "http://devicetree.org/meta-schemas/core.yaml#"

title: Qualcomm PMIC TCPM Driver

maintainers:
  - Bryan O'Donoghue <bryan.odonoghue@linaro.org>

description: |
  Qualcomm PMIC Type-C Port Manager Driver

properties:
  compatible:
    enum:
      - qcom,pm8150b-tcpm

  pmic_tcpm_typec:
    $ref: /schemas/types.yaml#/definitions/phandle
    description:
      A phandle to the typec port hardware driver.

  pmic_tcpm_pdphy:
    $ref: /schemas/types.yaml#/definitions/phandle
    description:
      A phandle to the type-c pdphy hardware driver.

required:
  - compatible
  - pmic_tcpm_typec
  - pmic_tcpm_pdphy

additionalProperties: false

examples:
  - |
    #include <dt-bindings/interrupt-controller/irq.h>
    #include <dt-bindings/usb/pd.h>
    #include <dt-bindings/usb/typec/tcpm/qcom,pmic-usb-typec.h>
    #include <dt-bindings/usb/typec/tcpm/qcom,pmic-usb-pdphy.h>

    pm8150b_tcpm: pmic-tcpm {
        compatible = "qcom,pm8150b-tcpm";

        #address-cells = <1>;
        #size-cells = <0>;

        pmic_tcpm_typec = <&pm8150b_typec>;
        pmic_tcpm_pdphy = <&pm8150b_pdphy>;

        connector {
            compatible = "usb-c-connector";

            power-role = "source";
            data-role = "dual";
            self-powered;

            source-pdos = <PDO_FIXED(5000, 3000,
                           PDO_FIXED_DUAL_ROLE |
                           PDO_FIXED_USB_COMM |
                           PDO_FIXED_DATA_SWAP)>;

        };
    };

...
```
