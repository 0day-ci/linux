## Documentation/devicetree/bindings/memory-controllers/ti,gpmc.yaml
```yaml
# SPDX-License-Identifier: (GPL-2.0-only OR BSD-2-Clause)
%YAML 1.2
---
$id: http://devicetree.org/schemas/memory-controllers/ti,gpmc.yaml#
$schema: http://devicetree.org/meta-schemas/core.yaml#

title: Texas Instruments GPMC Memory Controller device-tree bindings

maintainers:
  - Tony Lindgren <tony@atomide.com>
  - Roger Quadros <rogerq@kernel.org>

description:
  The GPMC is a unified memory controller dedicated for interfacing
  with external memory devices like
  - Asynchronous SRAM-like memories and ASICs
  - Asynchronous, synchronous, and page mode burst NOR flash
  - NAND flash
  - Pseudo-SRAM devices

properties:
  compatible:
    items:
      - enum:
          - ti,omap2420-gpmc
          - ti,omap2430-gpmc
          - ti,omap3430-gpmc
          - ti,omap4430-gpmc
          - ti,am3352-gpmc

  reg:
    items:
      - description:
          Configuration registers for the controller.

  interrupts: true

  clocks:
    maxItems: 1
    description: |
      Functional clock. Used for bus timing calculations and
      GPMC configuration.

  clock-names:
    items:
      - const: fck

  dmas:
    items:
      - description: DMA channel for GPMC NAND prefetch

  dma-names:
    items:
      - const: rxtx

  "#address-cells":
    const: 2

  "#size-cells":
    const: 1

  gpmc,num-cs:
    description: maximum number of supported chip-select lines.
    $ref: /schemas/types.yaml#/definitions/uint32

  gpmc,num-waitpins:
    description: maximum number of supported wait pins.
    $ref: /schemas/types.yaml#/definitions/uint32

  ranges:
    minItems: 1
    description: |
      Must be set up to reflect the memory layout with four
      integer values for each chip-select line in use,
      <cs-number> 0 <physical address of mapping> <size>

    items:
      - description: NAND bank 0
      - description: NOR/SRAM bank 0
      - description: NOR/SRAM bank 1

  '#interrupt-cells':
    const: 2

  interrupt-controller:
    description: |
      The GPMC driver implements and interrupt controller for
      the NAND events "fifoevent" and "termcount" plus the
      rising/falling edges on the GPMC_WAIT pins.
      The interrupt number mapping is as follows
      0 - NAND_fifoevent
      1 - NAND_termcount
      2 - GPMC_WAIT0 pin edge
      3 - GPMC_WAIT1 pin edge, and so on.

  '#gpio-cells':
     const: 2

  gpio-controller:
    description: |
      The GPMC driver implements a GPIO controller for the
      GPMC WAIT pins that can be used as general purpose inputs.
      0 maps to GPMC_WAIT0 pin.

patternProperties:
  "@[0-3],[a-f0-9]+$":
    type: object
    description: |
      The child device node represents the device connected to the GPMC
      bus. The device can be a NAND controller, SRAM device, NOR device
      or an ASIC.

    properties:
      compatible:
        description:
          Compatible of attached device.

      reg:
        items:
          - items:
              - description: |
                  Chip Select number, as in the parent range property (cs-number).
              - description: |
                  Offset of the memory region required by the device.
              - description: |
                  Length of the memory region required by the device.

# GPMC Timing properties for child nodes. All are optional and default to 0.

      gpmc,sync-clk-ps:
        description: Minimum clock period for synchronous mode, in picoseconds
        $ref: /schemas/types.yaml#/definitions/uint32

# Chip-select signal timings (in nanoseconds) corresponding to GPMC_CONFIG2:
      gpmc,cs-on-ns:
        description: Assertion time
        $ref: /schemas/types.yaml#/definitions/uint32
      gpmc,cs-rd-off-ns:
        description: Read deassertion time
        $ref: /schemas/types.yaml#/definitions/uint32
      gpmc,cs-wr-off-ns:
        description: Write deassertion time
        $ref: /schemas/types.yaml#/definitions/uint32

# ADV signal timings (in nanoseconds) corresponding to GPMC_CONFIG3:
      gpmc,adv-on-ns:
        description: Assertion time
        $ref: /schemas/types.yaml#/definitions/uint32
      gpmc,adv-rd-off-ns:
        description: Read deassertion time
        $ref: /schemas/types.yaml#/definitions/uint32
      gpmc,adv-wr-off-ns:
        description: Write deassertion time
        $ref: /schemas/types.yaml#/definitions/uint32
      gpmc,adv-aad-mux-on-ns:
        description: Assertion time for AAD
        $ref: /schemas/types.yaml#/definitions/uint32
      gpmc,adv-aad-mux-rd-off-ns:
        description: Read deassertion time for AAD
        $ref: /schemas/types.yaml#/definitions/uint32
      gpmc,adv-aad-mux-wr-off-ns:
        description: Write deassertion time for AAD
        $ref: /schemas/types.yaml#/definitions/uint32

# WE signals timings (in nanoseconds) corresponding to GPMC_CONFIG4:
      gpmc,we-on-ns:
        description: Assertion time
        $ref: /schemas/types.yaml#/definitions/uint32
      gpmc,we-off-ns:
        description: Deassertion time
        $ref: /schemas/types.yaml#/definitions/uint32

# OE signals timings (in nanoseconds) corresponding to GPMC_CONFIG4:
      gpmc,oe-on-ns:
        description: Assertion time
        $ref: /schemas/types.yaml#/definitions/uint32
      gpmc,oe-off-ns:
        description: Deassertion time
        $ref: /schemas/types.yaml#/definitions/uint32
      gpmc,oe-aad-mux-on-ns:
        description:       Assertion time for AAD
        $ref: /schemas/types.yaml#/definitions/uint32
      gpmc,oe-aad-mux-off-ns:
        description:      Deassertion time for AAD
        $ref: /schemas/types.yaml#/definitions/uint32

# Access time and cycle time timings (in nanoseconds) corresponding to
# GPMC_CONFIG5:
      gpmc,page-burst-access-ns:
        description:   Multiple access word delay
        $ref: /schemas/types.yaml#/definitions/uint32
      gpmc,access-ns:
        description:              Start-cycle to first data valid delay
        $ref: /schemas/types.yaml#/definitions/uint32
      gpmc,rd-cycle-ns:
        description:            Total read cycle time
        $ref: /schemas/types.yaml#/definitions/uint32
      gpmc,wr-cycle-ns:
        description:            Total write cycle time
        $ref: /schemas/types.yaml#/definitions/uint32
      gpmc,bus-turnaround-ns:
        description:      Turn-around time between successive accesses
        $ref: /schemas/types.yaml#/definitions/uint32
      gpmc,cycle2cycle-delay-ns:
        description:   Delay between chip-select pulses
        $ref: /schemas/types.yaml#/definitions/uint32
      gpmc,clk-activation-ns:
        description:      GPMC clock activation time
        $ref: /schemas/types.yaml#/definitions/uint32
      gpmc,wait-monitoring-ns:
        description:     Start of wait monitoring with regard to valid data
        $ref: /schemas/types.yaml#/definitions/uint32

# Boolean timing parameters. If property is present, parameter is enabled
# otherwise disabled.
      gpmc,adv-extra-delay:
        description:        ADV signal is delayed by half GPMC clock
        type: boolean
      gpmc,cs-extra-delay:
        description:         CS signal is delayed by half GPMC clock
        type: boolean
      gpmc,cycle2cycle-diffcsen:
        description: |
          Add "cycle2cycle-delay" between successive accesses
          to a different CS
        type: boolean
      gpmc,cycle2cycle-samecsen:
        description: |
          Add "cycle2cycle-delay" between successive accesses
          to the same CS
        type: boolean
      gpmc,oe-extra-delay:
        description:         OE signal is delayed by half GPMC clock
        type: boolean
      gpmc,we-extra-delay:
        description:         WE signal is delayed by half GPMC clock
        type: boolean
      gpmc,time-para-granularity:
        description:  Multiply all access times by 2
        type: boolean

# The following two properties are applicable only to OMAP3+ and AM335x:
      gpmc,wr-access-ns:
        description: |
          In synchronous write mode, for single or
          burst accesses, defines the number of
          GPMC_FCLK cycles from start access time
          to the GPMC_CLK rising edge used by the
          memory device for the first data capture.
        $ref: /schemas/types.yaml#/definitions/uint32
      gpmc,wr-data-mux-bus-ns:
        description: |
          In address-data multiplex mode, specifies
          the time when the first data is driven on
          the address-data bus.
        $ref: /schemas/types.yaml#/definitions/uint32

# GPMC chip-select settings properties for child nodes. All are optional.

      gpmc,burst-length:
        description:     Page/burst length. Must be 4, 8 or 16.
        $ref: /schemas/types.yaml#/definitions/uint32
        enum: [4, 8, 16]
      gpmc,burst-wrap:
        description:       Enables wrap bursting
        type: boolean
      gpmc,burst-read:
        description:       Enables read page/burst mode
        type: boolean
      gpmc,burst-write:
        description:      Enables write page/burst mode
        type: boolean
      gpmc,device-width:
        description: |
          Total width of device(s) connected to a GPMC
          chip-select in bytes. The GPMC supports 8-bit
          and 16-bit devices and so this property must be
          1 or 2.
        $ref: /schemas/types.yaml#/definitions/uint32
        enum: [1, 2]
      gpmc,mux-add-data:
        description: |
          Address and data multiplexing configuration.
          Valid values are 1 for address-address-data
          multiplexing mode and 2 for address-data
          multiplexing mode.
        $ref: /schemas/types.yaml#/definitions/uint32
        enum: [1, 2]
      gpmc,sync-read:
        description: |
          Enables synchronous read. Defaults to asynchronous
          is this is not set.
        type: boolean
      gpmc,sync-write:
        description: |
          Enables synchronous writes. Defaults to asynchronous
          is this is not set.
        type: boolean
      gpmc,wait-pin:
        description: |
          Wait-pin used by client. Must be less than "gpmc,num-waitpins".
        $ref: /schemas/types.yaml#/definitions/uint32
      gpmc,wait-on-read:
        description:     Enables wait monitoring on reads.
        type: boolean
      gpmc,wait-on-write:
        description:    Enables wait monitoring on writes.
        type: boolean

    required:
      - compatible
      - reg

required:
  - compatible
  - reg
  - clocks
  - clock-names
  - gpmc,num-cs
  - gpmc,num-waitpins
  - "#address-cells"
  - "#size-cells"

additionalProperties: false

examples:
  - |
    #include <dt-bindings/interrupt-controller/arm-gic.h>
    #include <dt-bindings/gpio/gpio.h>

    gpmc: memory-controller@50000000 {
      compatible = "ti,am3352-gpmc";
      reg = <0x50000000 0x2000>;
      interrupts = <100>;
      clocks = <&l3s_clkctrl>;
      clock-names = "fck";
      dmas = <&edma 52 0>;
      dma-names = "rxtx";
      gpmc,num-cs = <8>;
      gpmc,num-waitpins = <2>;
      #address-cells = <2>;
      #size-cells = <1>;
      ranges = <0 0 0x08000000 0x10000000>; /* CS0 @addr 0x8000000, size 0x10000000 */
      interrupt-controller;
      #interrupt-cells = <2>;
      gpio-controller;
      #gpio-cells = <2>;

      nand0: nand-controller@0,0 {
        compatible = "ti,omap2-nand";
        reg = <0 0 4>;
        interrupt-parent = <&gpmc>;
        interrupts = <0 IRQ_TYPE_NONE>, /* fifoevent */
                     <1 IRQ_TYPE_NONE>; /* termcount */
        rb-gpios = <&gpmc 0 GPIO_ACTIVE_HIGH>; /* gpmc_wait0 pin */

        #address-cells = <1>;
        #size-cells = <0>;
      };
    };
```

## Documentation/devicetree/bindings/mfd/ahc1ec0.yaml
```yaml
# SPDX-License-Identifier: (GPL-2.0-only OR BSD-2-Clause)
%YAML 1.2
---
$id: http://devicetree.org/schemas/mfd/ahc1ec0.yaml#
$schema: http://devicetree.org/meta-schemas/core.yaml#

title: Advantech Embedded Controller (AHC1EC0)

maintainers:
  - Campion Kang <campion.kang@advantech.com.tw>

description: |
  AHC1EC0 is one of the embedded controllers used by Advantech to provide several
  functions such as watchdog, hwmon, brightness, GPIO, LED, etc. Advantech related
  applications can control the whole system via these functions.

properties:
  compatible:
    const: advantech,ahc1ec0

  advantech,hwmon-profile:
    description:
      The number of sub-devices specified in the platform. Defines for the
      hwmon profiles can found in dt-bindings/mfd/ahc1ec0-dt.
    $ref: /schemas/types.yaml#/definitions/uint32
    maxItems: 1

  advantech,has-watchdog:
    description:
      Some implementations of the EC include a watchdog used to monitor the
      system. This boolean flag is used to specify whether this watchdog is
      present or not. Default is true, otherwise set to false.
    type: boolean

required:
  - compatible

additionalProperties: false

examples:
  - |
    #include <dt-bindings/mfd/ahc1ec0-dt.h>
    ahc1ec0 {
        compatible = "advantech,ahc1ec0";

        advantech,hwmon-profile = <AHC1EC0_HWMON_PRO_UNO2271G>;
        advantech,has-watchdog;
    };
```

## Documentation/devicetree/bindings/mfd/ampere,smpro.yaml
```yaml
# SPDX-License-Identifier: (GPL-2.0-only OR BSD-2-Clause)
%YAML 1.2
---
$id: http://devicetree.org/schemas/mfd/ampere,smpro.yaml#
$schema: http://devicetree.org/meta-schemas/core.yaml#

title: Ampere Altra SMPro firmware driver

maintainers:
  - Quan Nguyen <quan@os.amperecomputing.com>

description: |
  Ampere Altra SMPro firmware may contain different blocks like hardware
  monitoring, error monitoring and other miscellaneous features.

properties:
  compatible:
    enum:
      - ampere,smpro

  reg:
    description:
      I2C device address.
    maxItems: 1

  "#address-cells":
    const: 1

  "#size-cells":
    const: 0

patternProperties:
  "^hwmon(@[0-9a-f]+)?$":
    $ref: ../hwmon/ampere,ac01-hwmon.yaml

  "^misc(@[0-9a-f]+)?$":
    type: object
    description: |
      This module is part of the Ampere Altra SMPro multi-function device
      to support miscellaneous features
    properties:
      compatible:
        enum:
          - ampere,ac01-misc
      reg:
        maxItems: 1

    required:
      - compatible
      - reg

  "^errmon(@[0-9a-f]+)?$":
    type: object
    description: |
      This module is part of the Ampere Altra SMPro multi-function device
      that supports error monitoring feature.

    properties:
      compatible:
        enum:
          - ampere,ac01-errmon
      reg:
        maxItems: 1

    required:
      - compatible
      - reg

required:
  - "#address-cells"
  - "#size-cells"
  - compatible
  - reg

additionalProperties: false

examples:
  - |
    i2c {
        #address-cells = <1>;
        #size-cells = <0>;

        smpro@4f {
            compatible = "ampere,smpro";
            reg = <0x4f>;
            #address-cells = <1>;
            #size-cells = <0>;

            hwmon@10 {
                compatible = "ampere,ac01-hwmon";
                reg = <0x10>;
            };

            misc@b0 {
                compatible = "ampere,ac01-misc";
                reg = <0xb0>;
            };

            errmon@80 {
                compatible = "ampere,ac01-errmon";
                reg = <0x80>;
            };

        };
    };
```
