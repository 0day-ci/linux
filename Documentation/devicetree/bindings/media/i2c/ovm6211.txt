## Documentation/devicetree/bindings/media/mediatek,mdp3-ccorr.yaml
```yaml
# SPDX-License-Identifier: (GPL-2.0-only OR BSD-2-Clause)
%YAML 1.2
---
$id: http://devicetree.org/schemas/media/mediatek,mdp3-ccorr.yaml#
$schema: http://devicetree.org/meta-schemas/core.yaml#

title: Mediatek Media Data Path 3 CCORR Device Tree Bindings

maintainers:
  - Daoyuan Huang <daoyuan.huang@mediatek.com>
  - Moudy Ho <moudy.ho@mediatek.com>

description: |
  One of Media Data Path 3 (MDP3) components used to do color correction with 3X3 matrix.

properties:
  compatible:
    items:
      - enum:
        - mediatek,mt8183-mdp3-ccorr

  mediatek,mdp3-id:
    $ref: /schemas/types.yaml#/definitions/uint32
    maxItems: 1
    description: |
      HW index to distinguish same functionality modules.

  reg:
    description: |
      Physical base address and length of the function block
      register space, the number aligns with the component
      and its own subcomponent.

  mediatek,gce-client-reg:
    $ref: /schemas/types.yaml#/definitions/phandle-array
    description: |
      sub-system id corresponding to the global command engine (GCE)
      register address.
      $ref: /schemas/mailbox/mtk-gce.txt

  clocks:
    minItems: 1

additionalProperties: false

examples:
  - |
    #include <dt-bindings/clock/mt8183-clk.h>
    #include <dt-bindings/gce/mt8183-gce.h>

    mdp3_ccorr: mdp3_ccorr@1401c000 {
      compatible = "mediatek,mt8183-mdp3-ccorr";
      mediatek,mdp3-id = <0>;
      reg = <0x1401c000 0x1000>;
      mediatek,gce-client-reg = <&gce SUBSYS_1401XXXX 0xc000 0x1000>;
      clocks = <&mmsys CLK_MM_MDP_CCORR>;
    };
```

## Documentation/devicetree/bindings/media/mediatek,mdp3-rsz.yaml
```yaml
# SPDX-License-Identifier: (GPL-2.0-only OR BSD-2-Clause)
%YAML 1.2
---
$id: http://devicetree.org/schemas/media/mediatek,mdp3-rsz.yaml#
$schema: http://devicetree.org/meta-schemas/core.yaml#

title: Mediatek Media Data Path 3 Resizer Device Tree Bindings

maintainers:
  - Daoyuan Huang <daoyuan.huang@mediatek.com>
  - Moudy Ho <moudy.ho@mediatek.com>

description: |
  One of Media Data Path 3 (MDP3) components used to do frame resizing.

properties:
  compatible:
    items:
      - enum:
        - mediatek,mt8183-mdp3-rsz

  mediatek,mdp3-id:
    $ref: /schemas/types.yaml#/definitions/uint32
    maxItems: 1
    description: |
      HW index to distinguish same functionality modules.

  reg:
    description: |
      Physical base address and length of the function block
      register space, the number aligns with the component
      and its own subcomponent.

  mediatek,gce-client-reg:
    $ref: /schemas/types.yaml#/definitions/phandle-array
    description: |
      sub-system id corresponding to the global command engine (GCE)
      register address.
      $ref: /schemas/mailbox/mtk-gce.txt

  clocks:
    minItems: 1

additionalProperties: false

examples:
  - |
    #include <dt-bindings/clock/mt8183-clk.h>
    #include <dt-bindings/gce/mt8183-gce.h>

    mdp3_rsz0: mdp3_rsz0@14003000 {
      compatible = "mediatek,mt8183-mdp3-rsz";
      mediatek,mdp3-id = <0>;
      reg = <0x14003000 0x1000>;
      mediatek,gce-client-reg = <&gce SUBSYS_1400XXXX 0x3000 0x1000>;
      clocks = <&mmsys CLK_MM_MDP_RSZ0>;
    };

    mdp3_rsz1: mdp3_rsz1@14004000 {
      compatible = "mediatek,mt8183-mdp3-rsz";
      mediatek,mdp3-id = <1>;
      reg = <0x14004000 0x1000>;
      mediatek,gce-client-reg = <&gce SUBSYS_1400XXXX 0x4000 0x1000>;
      clocks = <&mmsys CLK_MM_MDP_RSZ1>;
    };
```

## Documentation/devicetree/bindings/media/mediatek,mdp3-wrot.yaml
```yaml
# SPDX-License-Identifier: (GPL-2.0-only OR BSD-2-Clause)
%YAML 1.2
---
$id: http://devicetree.org/schemas/media/mediatek,mdp3-wrot.yaml#
$schema: http://devicetree.org/meta-schemas/core.yaml#

title: Mediatek Media Data Path 3 Device Tree Bindings

maintainers:
  - Daoyuan Huang <daoyuan.huang@mediatek.com>
  - Moudy Ho <moudy.ho@mediatek.com>

description: |
  One of Media Data Path 3 (MDP3) components used to write DMA with frame rotation.

properties:
  compatible:
    items:
      - enum:
        - mediatek,mt8183-mdp3-wrot

  mediatek,mdp3-id:
    $ref: /schemas/types.yaml#/definitions/uint32
    maxItems: 1
    description: |
      HW index to distinguish same functionality modules.

  reg:
    description: |
      Physical base address and length of the function block
      register space, the number aligns with the component
      and its own subcomponent.

  mediatek,gce-client-reg:
    $ref: /schemas/types.yaml#/definitions/phandle-array
    description: |
      sub-system id corresponding to the global command engine (GCE)
      register address.
      $ref: /schemas/mailbox/mtk-gce.txt

  power-domains:
    maxItems: 1

  clocks:
    minItems: 1

  iommus:
    $ref: /schemas/types.yaml#/definitions/phandle
    description: |
      Should point to the respective IOMMU block with master
      port as argument.
      $ref: /schemas/iommu/mediatek,iommu.yaml

additionalProperties: false

examples:
  - |
    #include <dt-bindings/clock/mt8183-clk.h>
    #include <dt-bindings/gce/mt8183-gce.h>
    #include <dt-bindings/power/mt8183-power.h>
    #include <dt-bindings/memory/mt8183-larb-port.h>

    mdp3_wrot0: mdp3_wrot0@14005000 {
      compatible = "mediatek,mt8183-mdp3-wrot";
      mediatek,mdp3-id = <0>;
      reg = <0x14005000 0x1000>;
      mediatek,gce-client-reg = <&gce SUBSYS_1400XXXX 0x5000 0x1000>;
      power-domains = <&spm MT8183_POWER_DOMAIN_DISP>;
      clocks = <&mmsys CLK_MM_MDP_WROT0>;
      iommus = <&iommu>;
    };
```

## Documentation/devicetree/bindings/media/mediatek,vcodec-comp-decoder.yaml
```yaml
# SPDX-License-Identifier: (GPL-2.0-only OR BSD-2-Clause)

%YAML 1.2
---
$id: "http://devicetree.org/schemas/media/mediatek,vcodec-comp-decoder.yaml#"
$schema: "http://devicetree.org/meta-schemas/core.yaml#"

title: Mediatek Video Decode Accelerator With Multi Hardware

maintainers:
  - Yunfei Dong <yunfei.dong@mediatek.com>

description: |
  Mediatek Video Decode is the video decode hardware present in Mediatek
  SoCs which supports high resolution decoding functionalities. Required
  master and component node.

  About the Decoder Hardware Block Diagram, please check below:

    +---------------------------------+------------------------------------+
    |                                 |                                    |
    | input -> lat HW -> lat buffer --|--> lat buffer -> core HW -> output |
    |            ||                   |                     ||             |
    +------------||-------------------+---------------------||-------------+
                 ||       lat thread  |  core thread        ||     <master>
    -------------||-----------------------------------------||----------------
                 ||                                         ||     <component>
                 \/ <----------------HW index-------------->\/
           +------------------------------------------------------+
           |                    enable/disable                    |
           |           clk     power    irq    iommu port         |
           |                 (lat/lat soc/core0/core1)            |
           +------------------------------------------------------+

  As above, <master> mean in master device, <component> mean in component device.
  The information of each hardware will be stored in each component device. There
  are two workqueue in master device: lat and core. Enable/disable the lat clk/power/irq
  when lat hardware need to work through hardware index, core is the same.

  Normally the smi common may not the same for each hardware, can't combine all
  hardware in one node, or leading to iommu fault when access dram data.

properties:
  compatible:
    const: mediatek,mt8192-vcodec-dec

  reg:
    maxItems: 1

  iommus:
    minItems: 1
    maxItems: 32
    description: |
      List of the hardware port in respective IOMMU block for current Socs.
      Refer to bindings/iommu/mediatek,iommu.yaml.

  mediatek,scp:
    $ref: /schemas/types.yaml#/definitions/phandle
    maxItems: 1
    description: |
      The node of system control processor (SCP), using
      the remoteproc & rpmsg framework.
      $ref: /schemas/remoteproc/mtk,scp.yaml

  dma-ranges:
    maxItems: 1
    description: |
      Describes the physical address space of IOMMU maps to memory.

  "#address-cells":
    const: 1

  "#size-cells":
    const: 1

  ranges: true

# Required child node:
patternProperties:
  vcodec-lat:
    type: object

    properties:
      compatible:
        const: mediatek,mtk-vcodec-lat

      reg:
        maxItems: 1

      reg-names:
        maxItems: 1

      interrupts:
        maxItems: 1

      iommus:
        minItems: 1
        maxItems: 32
        description: |
          List of the hardware port in respective IOMMU block for current Socs.
          Refer to bindings/iommu/mediatek,iommu.yaml.

      clocks:
        maxItems: 5

      clock-names:
        items:
          - const: vdec-sel
          - const: vdec-soc-vdec
          - const: vdec-soc-lat
          - const: vdec-vdec
          - const: vdec-top

      assigned-clocks:
        maxItems: 1

      assigned-clock-parents:
        maxItems: 1

      power-domains:
        maxItems: 1

    required:
      - compatible
      - reg
      - reg-names
      - interrupts
      - iommus
      - clocks
      - clock-names
      - assigned-clocks
      - assigned-clock-parents
      - power-domains

    additionalProperties: false

  vcodec-core:
    type: object

    properties:
      compatible:
        const: mediatek,mtk-vcodec-core

      reg:
        maxItems: 1

      reg-names:
        maxItems: 1

      interrupts:
        maxItems: 1

      iommus:
        minItems: 1
        maxItems: 32
        description: |
          List of the hardware port in respective IOMMU block for current Socs.
          Refer to bindings/iommu/mediatek,iommu.yaml.

      clocks:
        maxItems: 5

      clock-names:
        items:
          - const: vdec-sel
          - const: vdec-soc-vdec
          - const: vdec-soc-lat
          - const: vdec-vdec
          - const: vdec-top

      assigned-clocks:
        maxItems: 1

      assigned-clock-parents:
        maxItems: 1

      power-domains:
        maxItems: 1

    required:
      - compatible
      - reg
      - reg-names
      - interrupts
      - iommus
      - clocks
      - clock-names
      - assigned-clocks
      - assigned-clock-parents
      - power-domains

    additionalProperties: false

required:
  - compatible
  - reg
  - iommus
  - mediatek,scp
  - dma-ranges
  - ranges

additionalProperties: false

examples:
  - |
    #include <dt-bindings/interrupt-controller/arm-gic.h>
    #include <dt-bindings/memory/mt8192-larb-port.h>
    #include <dt-bindings/interrupt-controller/irq.h>
    #include <dt-bindings/clock/mt8192-clk.h>
    #include <dt-bindings/power/mt8192-power.h>

    vcodec_dec: vcodec_dec@16000000 {
        compatible = "mediatek,mt8192-vcodec-dec";
        reg = <0x16000000 0x1000>;		/* VDEC_SYS */
        mediatek,scp = <&scp>;
        iommus = <&iommu0 M4U_PORT_L4_VDEC_MC_EXT>;
        dma-ranges = <0x1 0x0 0x0 0x40000000 0x0 0xfff00000>;
        #address-cells = <1>;
        #size-cells = <1>;
        ranges;
        lat: vcodec-lat@16010000 {
            compatible = "mediatek,mtk-vcodec-lat";
            reg = <0x16010000 0x800>;
            reg-names = "misc";
            interrupts = <GIC_SPI 426 IRQ_TYPE_LEVEL_HIGH 0>;
            iommus = <&iommu0 M4U_PORT_L5_VDEC_LAT0_VLD_EXT>,
                <&iommu0 M4U_PORT_L5_VDEC_LAT0_VLD2_EXT>,
                <&iommu0 M4U_PORT_L5_VDEC_LAT0_AVC_MV_EXT>,
                <&iommu0 M4U_PORT_L5_VDEC_LAT0_PRED_RD_EXT>,
                <&iommu0 M4U_PORT_L5_VDEC_LAT0_TILE_EXT>,
                <&iommu0 M4U_PORT_L5_VDEC_LAT0_WDMA_EXT>,
                <&iommu0 M4U_PORT_L5_VDEC_LAT0_RG_CTRL_DMA_EXT>,
                <&iommu0 M4U_PORT_L5_VDEC_UFO_ENC_EXT>;
            clocks = <&topckgen CLK_TOP_VDEC_SEL>,
                <&vdecsys_soc CLK_VDEC_SOC_VDEC>,
                <&vdecsys_soc CLK_VDEC_SOC_LAT>,
                <&vdecsys_soc CLK_VDEC_SOC_LARB1>,
                <&topckgen CLK_TOP_MAINPLL_D4>;
            clock-names = "vdec-sel", "vdec-soc-vdec", "vdec-soc-lat",
                "vdec-vdec", "vdec-top";
            assigned-clocks = <&topckgen CLK_TOP_VDEC_SEL>;
            assigned-clock-parents = <&topckgen CLK_TOP_MAINPLL_D4>;
            power-domains = <&spm MT8192_POWER_DOMAIN_VDEC>;
        };

        core: vcodec-core@16025000 {
            compatible = "mediatek,mtk-vcodec-core";
            reg = <0x16025000 0x1000>;
            reg-names = "misc";
            interrupts = <GIC_SPI 425 IRQ_TYPE_LEVEL_HIGH 0>;
            iommus = <&iommu0 M4U_PORT_L4_VDEC_MC_EXT>,
                <&iommu0 M4U_PORT_L4_VDEC_UFO_EXT>,
                <&iommu0 M4U_PORT_L4_VDEC_PP_EXT>,
                <&iommu0 M4U_PORT_L4_VDEC_PRED_RD_EXT>,
                <&iommu0 M4U_PORT_L4_VDEC_PRED_WR_EXT>,
                <&iommu0 M4U_PORT_L4_VDEC_PPWRAP_EXT>,
                <&iommu0 M4U_PORT_L4_VDEC_TILE_EXT>,
                <&iommu0 M4U_PORT_L4_VDEC_VLD_EXT>,
                <&iommu0 M4U_PORT_L4_VDEC_VLD2_EXT>,
                <&iommu0 M4U_PORT_L4_VDEC_AVC_MV_EXT>,
                <&iommu0 M4U_PORT_L4_VDEC_RG_CTRL_DMA_EXT>;
            clocks = <&topckgen CLK_TOP_VDEC_SEL>,
                <&vdecsys CLK_VDEC_VDEC>,
                <&vdecsys CLK_VDEC_LAT>,
                <&vdecsys CLK_VDEC_LARB1>,
                <&topckgen CLK_TOP_MAINPLL_D4>;
            clock-names = "vdec-sel", "vdec-soc-vdec", "vdec-soc-lat",
                "vdec-vdec", "vdec-top";
            assigned-clocks = <&topckgen CLK_TOP_VDEC_SEL>;
            assigned-clock-parents = <&topckgen CLK_TOP_MAINPLL_D4>;
            power-domains = <&spm MT8192_POWER_DOMAIN_VDEC2>;
        };
    };
```

## Documentation/devicetree/bindings/media/microchip-xisc.txt
```
Microchip eXtended Image Sensor Controller (XISC)
----------------------------------------------

Required properties for XISC:
- compatible
	Must be "microchip,sama7g5-xisc".
- reg
	Physical base address and length of the registers set for the device.
- interrupts
	Should contain IRQ line for the XISC.
- clocks
	List of clock specifiers, corresponding to entries in
	the clock-names property;
	Please refer to clock-bindings.txt.
- clock-names
	Required elements: "hclock".
	This is the clock that clocks the sensor controller, and is usually
	fed from the clock tree. It is used for the internal controller logic.
- #clock-cells
	Should be 0.
- clock-output-names
	Should be "isc-mck".
- pinctrl-names, pinctrl-0
	Please refer to pinctrl-bindings.txt.

Optional properties for XISC:
- microchip,mipi-mode;
	As the XISC is usually connected to a demux/bridge, the XISC receives
	the same type of input, however, it should be aware of the type of
	signals received. The mipi-mode enables different internal handling
	of the data and clock lines.

XISC supports a single port node with internal parallel bus.
It should contain one 'port' child node with child 'endpoint' node.
Please refer to the bindings defined in
Documentation/devicetree/bindings/media/video-interfaces.txt.

This endpoint has to be connected to a bridge that acts as a demux from either
a serial interface or acts as a simple direct bridge to a parallel sensor.

Example:
xisc: xisc@e1408000 {
	compatible = "microchip,sama7g5-isc";
	reg = <0xe1408000 0x2000>;
	interrupts = <GIC_SPI 56 IRQ_TYPE_LEVEL_HIGH>;
	#address-cells = <1>;
	#size-cells = <0>;
	clocks = <&pmc PMC_TYPE_PERIPHERAL 56>;
	clock-names = "hclock";
	#clock-cells = <0>;
	clock-output-names = "isc-mck";
	microchip,mipi-mode;

	port@1 {
		reg = <1>;
		xisc_in: endpoint {
		bus-width = <12>;
		hsync-active = <1>;
		vsync-active = <1>;
		remote-endpoint = <&csi2dc_out>;
		};
	};
};
```
