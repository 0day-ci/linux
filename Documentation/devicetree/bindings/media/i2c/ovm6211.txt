## Documentation/devicetree/bindings/media/i2c/ovm6211.txt
```
* Omnivision OVM6211 MIPI CSI-2 sensor

The OVM6211 has an image array capable of operating at up to 120 frames per
second in 400x400 resolution. All required image processing functions including
exposure control are programmable through the SCCB interface.


Required Properties:
- compatible: shall be "ovti,ovm6211"
- clocks: reference to the xvclk input clock
- clock-names: shall be "xvclk"
- avdd-supply: Analog voltage supply, 2.9 volts
- dovdd-supply: Digital I/O voltage supply, 1.8 volts
- dvdd-supply: Digital core voltage supply, 1.8 volts
- reset-gpios: Low active reset gpio
- enable-gpios: High active chip enable gpio

The device node shall contain one 'port' child node with an
'endpoint' subnode for its digital output video port,
in accordance with the video interface bindings defined in
Documentation/devicetree/bindings/media/video-interfaces.txt.
The endpoint optional property 'data-lanes' shall be "<1>".


Example:

	&i2c1 {
		...
        
		camera@60 {
			compatible = "ovti,ovm6211";
			reg = <0x60>;
			clocks = <&clk_cam>;
			clock-names = "xvclk";
			dovdd-supply = <&v1v8>;
			avdd-supply = <&vdda>;
			reset-gpios = <&gpiof 14 GPIO_ACTIVE_LOW>;
			enable-gpios = <&gpiof 15 GPIO_ACTIVE_HIGH>;

			status = "okay";

			port {
				ovm6211_0: endpoint {
					data-lanes = <1>;
					clock-lanes = <0>;
					pclk-max-frequency = <72000000>;
			};
		};
	};
```

## Documentation/devicetree/bindings/media/i2c/techwell,tw9900.yaml
```yaml
# SPDX-License-Identifier: (GPL-2.0-only OR BSD-2-Clause)
%YAML 1.2
---
$id: http://devicetree.org/schemas/media/i2c/techwell,tw9900.yaml#
$schema: http://devicetree.org/meta-schemas/core.yaml#

title: Techwell TW9900 NTSC/PAL/SECAM video decoder

maintainers:
  - Maxime Chevallier <maxime.chevallier@bootlin.com>

description:
  The tw9900 is a multi-standard video decoder, supporting NTSC, PAL and SECAM
  standards with auto-detection features.

properties:
  compatible:
    items:
      - enum:
          - techwell,tw9900

  reg:
    maxItems: 1

  vdd-supply:
    description: VDD power supply

  reset-gpios:
    description: GPIO descriptor for the RESET input pin
    maxItems: 1

  port:
    $ref: /schemas/graph.yaml#/properties/port
    description:
      Video port for the decoder output.

additionalProperties: false

required:
  - compatible
  - reg

examples:
  - |
    #include <dt-bindings/gpio/gpio.h>
    i2c {
            #address-cells = <1>;
            #size-cells = <0>;

            tw9900: tw9900@44 {
                    compatible = "techwell,tw9900";
                    reg = <0x44>;

                    vdd-supply = <&tw9900_supply>;
                    reset-gpios = <&gpio2 5 GPIO_ACTIVE_LOW>;

                    port {
                            tw9900_out: endpoint {
                                    remote-endpoint = <&vip_in>;
                            };
                    };
            };
    };
```

## Documentation/devicetree/bindings/media/i2c/ti,ds90ub953-q1.yaml
```yaml
# SPDX-License-Identifier: (GPL-2.0-only OR BSD-2-Clause)
# Copyright (C) 2019 Renesas Electronics Corp.
%YAML 1.2
---
$id: http://devicetree.org/schemas/media/i2c/ti,ds90ub953-q1.yaml#
$schema: http://devicetree.org/meta-schemas/core.yaml#

title: Texas Instruments DS90UB953-Q1 video serializer

maintainers:
  - Luca Ceresoli <luca@lucaceresoli.net>

description: |
  The TI DS90UB953-Q1 is a MIPI CSI-2 video serializer that forwards a MIPI
  CSI-2 input video stream over an FPD Link 3 connection to a remote
  deserializer. It also allows access to I2C and GPIO from the deserializer.

  The DT definitions can be found in include/dt-bindings/media/ds90ub953.h

  When used as a the remote counterpart of a deserializer (e.g. the
  DS90UB954-Q1), the serializer is described in the
  "deserializer/remote-chips/remote-chip@[01]" node.

properties:
  compatible:
    const: ti,ds90ub953-q1

  reg:
    description: |
      Index of the remote (serializer) RX port that this serializer is
      connected to.
    maxItems: 1

  clocks:
    description: FPD-Link line rate (provided by the deserializer)
    maxItems: 1

  gpio-controller: true

  '#gpio-cells':
    const: 2

  '#clock-cells':
    const: 0

  ti,gpio-functions:
    description: |
      A list of 4 values defining how the 4 GPIO pins are connected in
      hardware; possible values are:
      - DS90_GPIO_FUNC_UNUSED (0): the GPIO is not unused
      - DS90_GPIO_FUNC_INPUT (1): the GPIO is an input to the ds90ub953,
        the remote chip (deserializer) can read its value
      - DS90_GPIO_FUNC_OUTPUT_REMOTE (2): the GPIO is an output from the
        ds90ub953, the remote chip (deserializer) can set its value
      For unspecified values the GPIO is assumed to be unused.
    $ref: /schemas/types.yaml#/definitions/uint32-array
    maxItems: 4

patternProperties:
  '^ti,ds90ub953-q1-(clk|d[0-3])-inv-pol-quirk$':
    description: |
      The MIPI CSI-2 input clock lane or any of the data lanes has inverted
      polarity in hardware

required:
  - compatible
  - reg
  - clocks
  - gpio-controller
  - '#gpio-cells'
  - '#clock-cells'

additionalProperties: false

examples:
  - |
    #include <dt-bindings/media/ds90ub953.h>
    remote-chips {
      #address-cells = <1>;
      #size-cells = <0>;

      remote-chip@0 {
        reg = <0>;
        compatible = "ti,ds90ub953-q1";
        clocks = <&deser>;
        ti,gpio-functions =
          <DS90_GPIO_FUNC_UNUSED
          DS90_GPIO_FUNC_OUTPUT_REMOTE
          DS90_GPIO_FUNC_UNUSED
          DS90_GPIO_FUNC_UNUSED>;

        gpio-controller;
        #gpio-cells = <2>;
        #clock-cells = <0>;
      };
    };
```

## Documentation/devicetree/bindings/media/i2c/ti,ds90ub954-q1.yaml
```yaml
# SPDX-License-Identifier: (GPL-2.0-only OR BSD-2-Clause)
# Copyright (C) 2019 Renesas Electronics Corp.
%YAML 1.2
---
$id: http://devicetree.org/schemas/media/i2c/ti,ds90ub954-q1.yaml#
$schema: http://devicetree.org/meta-schemas/core.yaml#

title: Texas Instruments DS90UB954-Q1 dual video deserializer

maintainers:
  - Luca Ceresoli <luca@lucaceresoli.net>

description: |
  The TI DS90UB954-Q1 is a MIPI CSI-2 video deserializer that forwards
  video streams from up to two FPD-Link 3 connections to a MIPI CSI-2
  output. It also allows access to remote I2C and GPIO.

properties:
  compatible:
    const: ti,ds90ub954-q1

  reg:
    description: |
      main I2C slave address; optionally aliases for RX port registers and
      remote serializers. The main address is mandatory and must be the
      first, others are optional and fall back to defaults if not
      specified. See "reg-names".

  reg-names:
    description: |
      Names of I2C address used to communicate with the chip, must match
      the "reg" values; mandatory if there are 2 or more addresses.
      "main" is the main I2C address, used to access shared registers.
      "rxport0" and "rxport1" are the I2C alias to access FPD-link RX
      port specific registers; must not be used by other slaves on the
      same bus. "ser0" and "ser1" are the I2C alias to access the remote
      serializer connected on each FPD-link RX port; must not be used by
      other slaves on the same bus.
    minItems: 1
    maxItems: 5
    items:
      - const: main
      - const: rxport0
      - const: rxport1
      - const: ser0
      - const: ser1

  clocks:
    description: provider of the clock on the XIN/REFCLK pin
    maxItems: 1

  interrupts:
    maxItems: 1

  reset-gpios:
    description: chip reset GPIO connected to PDB pin (active low)

  i2c-alias-pool:
    description: |
      list of I2C addresses that are known to be available on the "local"
      (SoC-to-deser) I2C bus; they will be picked at runtime and used as
      aliases to reach remote I2C chips

  '#clock-cells':
    description: |
      the DS90UB954 provides the FPD line rate clock to the serializer
    const: 0

  ports:
    $ref: /schemas/graph.yaml#/properties/ports

    patternProperties:
      '^port@[01]$':
        $ref: /schemas/graph.yaml#/$defs/port-base
        description: FPD-Link RX port 0 (RIN0+/RIN0- pins)

        properties:
          endpoint:
            $ref: /schemas/media/video-interfaces.yaml#
            unevaluatedProperties: false

      '^port@2$':
        $ref: /schemas/graph.yaml#/properties/port
        description: MIPI-CSI2 TX port

  remote-chips:
    type: object

    properties:
      '#address-cells':
        const: 1
      '#size-cells':
        const: 0

    patternProperties:
      '^remote-chip@([01]+)$':
        type: object
        $ref: /schemas/media/i2c/ti,ds90ub953-q1.yaml#

    required:
      - '#address-cells'
      - '#size-cells'

    additionalProperties: false

  i2c-atr:
    description: |
      Each child describes the I2C bus on the remote side of an RX port
    type: object

    properties:
      '#address-cells':
        const: 1
      '#size-cells':
        const: 0

    patternProperties:
      '^i2c@([01]+)$':
        type: object

        properties:
          reg:
            maxItems: 1
          '#address-cells':
            const: 1
          '#size-cells':
            const: 0
          clock-frequency:
            minimum: 1
            maximum: 1000000

    additionalProperties: false

required:
  - compatible
  - reg
  - clocks
  - ports
  - remote-chips
  - i2c-atr

additionalProperties: false

examples:
  - |
    #include <dt-bindings/interrupt-controller/irq.h>
    #include <dt-bindings/gpio/gpio.h>
    #include <dt-bindings/media/ds90ub953.h>

    i2c@0 {
      reg = <0x0 0x100>;
      #address-cells = <1>;
      #size-cells = <0>;

      deser: deser@3d {
        compatible = "ti,ds90ub954-q1";
        reg-names = "main", "rxport0", "rxport1", "ser0", "ser1";
        reg       = <0x3d>,  <0x40>,    <0x41>,   <0x44>, <0x45>;
        clocks = <&clk_25M>;
        interrupt-parent = <&gic>;
        interrupts = <3 1 IRQ_TYPE_LEVEL_LOW>;
        reset-gpios = <&gpio 4 GPIO_ACTIVE_LOW>;

        #clock-cells = <0>;

        i2c-alias-pool = /bits/ 16 <0x4a 0x4b 0x4c 0x4d 0x4e 0x4f>;

        ports {
          #address-cells = <1>;
          #size-cells = <0>;

          port@0 {
            reg = <0>;
            ds90ub954_fpd3_in0: endpoint {
              remote-endpoint = <&sensor_0_out>;
            };
          };

          port@2 {
            reg = <2>;
            ds90ub954_mipi_out0: endpoint {
                    data-lanes = <1 2 3 4>;
                    link-frequencies = /bits/ 64 <400000000>;
                    remote-endpoint = <&csirx_0_in>;
            };
          };
        };

        remote-chips {
          #address-cells = <1>;
          #size-cells = <0>;

          des0_ser0: remote-chip@0 {
            reg = <0>;
            compatible = "ti,ds90ub953-q1";
            clocks = <&deser>;
            ti,gpio-functions =
              <DS90_GPIO_FUNC_UNUSED
              DS90_GPIO_FUNC_OUTPUT_REMOTE
              DS90_GPIO_FUNC_UNUSED
              DS90_GPIO_FUNC_UNUSED>;

            gpio-controller;
            #gpio-cells = <2>;
            #clock-cells = <0>;
          };
        };

        i2c-atr {
          #address-cells = <1>;
          #size-cells = <0>;

          remote_i2c0: i2c@0 {
            reg = <0>;
            #address-cells = <1>;
            #size-cells = <0>;

            sensor_0@1a {
              compatible = "sony,imx274";
              reg = <0x1a>;

              reset-gpios = <&des0_ser0 1 GPIO_ACTIVE_LOW>;

              port {
                sensor_0_out: endpoint {
                  remote-endpoint = <&ds90ub954_fpd3_in0>;
                };
              };
            };
          };
        };
      };
    };

...
```

## Documentation/devicetree/bindings/media/intel,keembay-camera.yaml
```yaml
# SPDX-License-Identifier: (GPL-2.0-only OR BSD-2-Clause)
# Copyright (C) 2021 Intel Corporation
%YAML 1.2
---
$id: http://devicetree.org/schemas/media/intel,keembay-camera.yaml#
$schema: http://devicetree.org/meta-schemas/core.yaml#

title: Intel Keem Bay camera subsystem

maintainers:
  - Paul J. Murphy <paul.j.murphy@intel.com>
  - Daniele Alessandrelli <daniele.alessandrelli@intel.com>

properties:
  compatible:
    const: intel,keembay-camera
  memory-region:
    $ref: /schemas/types.yaml#/definitions/phandle

  ports:
    type: object
    $ref: /schemas/graph.yaml#/properties/ports

    "#address-cells":
      const: 1
    "#size-cells":
      const: 0

    properties:
      port@[0-5]:
        type: object
        additionalProperties: false
        $ref: /schemas/graph.yaml#/properties/port
        description:
          The port number matches the D-PHY number (D-PHY#0 - D-PHY#5).

        properties:
          endpoint:
            type: object

            properties:
              data-lanes:
                $ref: video-interfaces.yaml#/properties/data-lanes
                description:
                  Six two-lane d-phys (D-PHY#0 - D-PHY#5) are available, which
                  can be used by six RX controllers (RX-CTRL#0 - RX-CTRL#5).
                  RX-CTRL#0, RX-CTRL#2, RX-CTRL#4 can be connected to two
                  D-PHY's and will be able to work with 3 and 4 lanes. In this
                  case the RX-CTRLs mapped to those D-PHYs cannot be used.

                  Clock and data lanes are defined as follows
                    D-PHY#0 - clock - 0, data - 1, 2
                    D-PHY#1 - clock - 3, data - 4, 5
                    D-PHY#2 - clock - 6, data - 7, 8
                    D-PHY#3 - clock - 9, data - 10, 11
                    D-PHY#4 - clock - 12, data - 13, 14
                    D-PHY#5 - clock - 15, data - 16, 17

            required:
              - data-lanes

      required:
        - reg
        - endpoint

    required:
      - "#address-cells"
      - "#size-cells"
      - port@[0-5]

required:
  - compatible
  - ports


additionalProperties: false

examples:
  - |
    keembay_camera {
        compatible = "intel,keembay-camera";
        memory-region = <&mem>;

        ports {
            #address-cells = <1>;
            #size-cells = <0>;

            port@4 {
                reg = <4>;

                cam: endpoint {
                    remote-endpoint = <&imx334>;
                    data-lanes = <13 14 16 17>;
                };
            };
        };
    };
...
```
