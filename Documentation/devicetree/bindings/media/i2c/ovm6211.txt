## Documentation/devicetree/bindings/media/nxp,imx8mq-mipi-csi2.yaml
```yaml
# SPDX-License-Identifier: (GPL-2.0-only OR BSD-2-Clause)
%YAML 1.2
---
$id: http://devicetree.org/schemas/media/nxp,imx8mq-mipi-csi2.yaml#
$schema: http://devicetree.org/meta-schemas/core.yaml#

title: NXP i.MX8MQ MIPI CSI-2 receiver

maintainers:
  - Martin Kepplinger <martin.kepplinger@puri.sm>

description: |-
  This binding covers the CSI-2 RX PHY and host controller included in the
  NXP i.MX8MQ SoC. It handles the sensor/image input and process for all the
  input imaging devices.

properties:
  compatible:
    enum:
      - fsl,imx8mq-mipi-csi2

  reg:
    maxItems: 1

  clocks:
    items:
      - description: core is the RX Controller Core Clock input. This clock
                     must be exactly equal to or faster than the receive
                     byteclock from the RX DPHY.
      - description: esc is the Rx Escape Clock. This must be the same escape
                     clock that the RX DPHY receives.
      - description: pxl is the pixel clock (phy_ref up to 333Mhz).
      - description: clko2 is the CLKO2 clock root.
                     See the reference manual for details.

  clock-names:
    items:
      - const: core
      - const: esc
      - const: pxl
      - const: clko2

  power-domains:
    maxItems: 1

  reset:
    description:
      The phandle to the imx8mq reset-controller.
    maxItems: 1

  phy:
    description:
      The phandle to the imx8mq syscon iomux-gpr.
    maxItems: 1

  interconnects:
    maxItems: 1

  interconnect-names:
    const: dram

  ports:
    $ref: /schemas/graph.yaml#/properties/ports

    properties:
      port@0:
        $ref: /schemas/graph.yaml#/$defs/port-base
        unevaluatedProperties: false
        description:
          Input port node, single endpoint describing the CSI-2 transmitter.

        properties:
          endpoint:
            $ref: video-interfaces.yaml#
            unevaluatedProperties: false

            properties:
              data-lanes:
                items:
                  minItems: 1
                  maxItems: 4
                  items:
                    - const: 1
                    - const: 2
                    - const: 3
                    - const: 4

            required:
              - data-lanes

      port@1:
        $ref: /schemas/graph.yaml#/properties/port
        description:
          Output port node

    required:
      - port@0
      - port@1

required:
  - compatible
  - reg
  - clocks
  - clock-names
  - power-domains
  - reset
  - phy
  - ports

additionalProperties: false

examples:
  - |
    #include <dt-bindings/clock/imx8mq-clock.h>
    #include <dt-bindings/interconnect/imx8mq.h>

    csi@30a70000 {
        compatible = "fsl,imx8mq-mipi-csi2";
        reg = <0x30a70000 0x1000>;
        clocks = <&clk IMX8MQ_CLK_CSI1_CORE>,
                 <&clk IMX8MQ_CLK_CSI1_ESC>,
                 <&clk IMX8MQ_CLK_CSI1_PHY_REF>,
                 <&clk IMX8MQ_CLK_CLKO2>;
        clock-names = "core", "esc", "pxl", "clko2";
        assigned-clocks = <&clk IMX8MQ_CLK_CSI1_CORE>,
                          <&clk IMX8MQ_CLK_CSI1_PHY_REF>,
                          <&clk IMX8MQ_CLK_CSI1_ESC>;
        assigned-clock-rates = <266000000>, <200000000>, <66000000>;
        assigned-clock-parents = <&clk IMX8MQ_SYS1_PLL_266M>,
                                 <&clk IMX8MQ_SYS2_PLL_1000M>,
                                 <&clk IMX8MQ_SYS1_PLL_800M>;
        power-domains = <&pgc_mipi_csi1>;
        reset = <&src>;
        phy = <&iomuxc_gpr>;
        interconnects = <&noc IMX8MQ_ICM_CSI1 &noc IMX8MQ_ICS_DRAM>;
        interconnect-names = "dram";

        ports {
            #address-cells = <1>;
            #size-cells = <0>;

            port@0 {
                reg = <0>;

                imx8mm_mipi_csi_in: endpoint {
                    remote-endpoint = <&imx477_out>;
                    data-lanes = <1 2 3 4>;
                };
            };

            port@1 {
                reg = <1>;

                imx8mm_mipi_csi_out: endpoint {
                    remote-endpoint = <&csi_in>;
                };
            };
        };
    };

...
```

## Documentation/devicetree/bindings/media/nxp,imx8mq-vpu.yaml
```yaml
# SPDX-License-Identifier: (GPL-2.0 OR BSD-2-Clause)

%YAML 1.2
---
$id: "http://devicetree.org/schemas/media/nxp,imx8mq-vpu.yaml#"
$schema: "http://devicetree.org/meta-schemas/core.yaml#"

title: Hantro G1/G2 VPU codecs implemented on i.MX8MQ SoCs

maintainers:
  - Philipp Zabel <p.zabel@pengutronix.de>

description:
  Hantro G1/G2 video decode accelerators present on i.MX8MQ SoCs.

properties:
  compatible:
    oneOf:
      - const: nxp,imx8mq-vpu
      - const: nxp,imx8mq-vpu-g2

  reg:
    maxItems: 1

  interrupts:
    maxItems: 1

  interrupt-names:
    oneOf:
      - const: g1
      - const: g2

  clocks:
    maxItems: 3

  clock-names:
    items:
      - const: g1
      - const: g2
      - const: bus

  power-domains:
    maxItems: 1

  nxp,imx8m-vpu-ctrl:
    description: Specifies a phandle to syscon VPU hardware control block
    $ref: "/schemas/types.yaml#/definitions/phandle"

required:
  - compatible
  - reg
  - interrupts
  - interrupt-names
  - clocks
  - clock-names
  - nxp,imx8m-vpu-ctrl

additionalProperties: false

examples:
  - |
        #include <dt-bindings/clock/imx8mq-clock.h>
        #include <dt-bindings/interrupt-controller/arm-gic.h>

        vpu_ctrl: syscon@38320000 {
                 compatible = "nxp,imx8mq-vpu-ctrl", "syscon";
                 reg = <0x38320000 0x10000>;
        };

        vpu_g1: video-codec@38300000 {
                compatible = "nxp,imx8mq-vpu";
                reg = <0x38300000 0x10000>;
                interrupts = <GIC_SPI 7 IRQ_TYPE_LEVEL_HIGH>;
                interrupt-names = "g1";
                clocks = <&clk IMX8MQ_CLK_VPU_G1_ROOT>,
                         <&clk IMX8MQ_CLK_VPU_G2_ROOT>,
                         <&clk IMX8MQ_CLK_VPU_DEC_ROOT>;
                clock-names = "g1", "g2", "bus";
                power-domains = <&pgc_vpu>;
                nxp,imx8m-vpu-ctrl = <&vpu_ctrl>;
        };

        vpu_g2: video-codec@38310000 {
                compatible = "nxp,imx8mq-vpu-g2";
                reg = <0x38300000 0x10000>;
                interrupts = <GIC_SPI 8 IRQ_TYPE_LEVEL_HIGH>;
                interrupt-names = "g2";
                clocks = <&clk IMX8MQ_CLK_VPU_G1_ROOT>,
                         <&clk IMX8MQ_CLK_VPU_G2_ROOT>,
                         <&clk IMX8MQ_CLK_VPU_DEC_ROOT>;
                clock-names = "g1", "g2", "bus";
                power-domains = <&pgc_vpu>;
                nxp,imx8m-vpu-ctrl = <&vpu_ctrl>;
        };
```

## Documentation/devicetree/bindings/media/snps,dw-hdmi-rx.yaml
```yaml
# SPDX-License-Identifier: (GPL-2.0-only OR BSD-2-Clause)
%YAML 1.2
---
$id: http://devicetree.org/schemas/media/snps,dw-hdmi-rx.yaml#
$schema: http://devicetree.org/meta-schemas/core.yaml#

title: Synopsys DesignWare HDMI RX Controller Device Tree Bindings

maintainers:
  - Jose Abreu <jose.abreu@synopsys.com>
  - Nelson Costa <nelson.costa@synopsys.com>

description: |
  The Synopsys DesignWare HDMI RX Controller and PHYs e405/e406 is an HDMI 2.0
  Receiver solution that is able to decode video and audio.

properties:
  compatible:
    const: snps,dw-hdmi-rx

  reg:
    maxItems: 1

  interrupts:
    maxItems: 1

  clocks:
    maxItems: 1
    description: |
      phandle to the configuration clock

  clock-names:
    const: cfg

  phys:
    maxItems: 1
    description: |
      phandle for the HDMI RX PHY

  phy-names:
    const: hdmi-phy

  port:
    $ref: /schemas/graph.yaml#/properties/port
    description: |
      Input port node, multiple endpoints describing the HDMI RX data connected
      to the HDMI PHY receiver.

required:
  - compatible
  - reg
  - interrupts
  - clocks
  - clock-names
  - phys
  - phy-names
  - port

additionalProperties: false

examples:
  - |
    hdmi_rx: hdmi-rx@0 {
        compatible = "snps,dw-hdmi-rx";
        reg = <0x0 0x10000>;
        interrupts = <1 2>;

        clocks = <&dw_hdmi_refclk>;
        clock-names = "cfg";

        phys = <&hdmi_e406_phy>;
        phy-names = "hdmi-phy";

        port {
            #address-cells = <1>;
            #size-cells = <0>;

            hdmi_rx_0: endpoint@0 {
                reg = <0>;
                remote-endpoint = <&hdmi_e406_phy_0>;
            };

            hdmi_rx_1: endpoint@1 {
                reg = <1>;
                remote-endpoint = <&hdmi_e406_phy_1>;
            };

            hdmi_rx_2: endpoint@2 {
                reg = <2>;
                remote-endpoint = <&hdmi_e406_phy_2>;
            };

            hdmi_rx_3: endpoint@3 {
                reg = <3>;
                remote-endpoint = <&hdmi_e406_phy_3>;
            };
        };
    };
```

## Documentation/devicetree/bindings/memory-controllers/apple,mcc.yaml
```yaml
# SPDX-License-Identifier: (GPL-2.0-only OR BSD-2-Clause)
%YAML 1.2
---
$id: http://devicetree.org/schemas/memory-controllers/apple,mcc.yaml#
$schema: http://devicetree.org/meta-schemas/core.yaml#

title: Apple SoC MCC memory controller performance controls

maintainers:
  - Hector Martin <marcan@marcan.st>

description: |
  Apple SoCs contain a multichannel memory controller that can have its
  configuration changed to adjust to changing performance requirements from
  the rest of the SoC. This node represents the controller and provides a
  power domain provider that downstream devices can use to adjust the memory
  controller performance level.

properties:
  compatible:
    items:
      - enum:
          - apple,t8103-mcc
      - const: apple,mcc

  reg:
    maxItems: 1

  "#power-domain-cells":
    const: 0

  operating-points-v2:
    $ref: /schemas/types.yaml#/definitions/phandle-array
    description:
      A reference to the OPP table describing the memory controller performance
      levels. Each OPP node should contain an `apple,memory-perf-config`
      property that contains the configuration values for that performance
      level.

  apple,num-channels:
    $ref: /schemas/types.yaml#/definitions/uint32
    description:
      The number of memory channels in use.

required:
  - compatible
  - reg
  - "#power-domain-cells"
  - operating-points-v2
  - apple,num-channels

additionalProperties: false

examples:
  # See clock/apple,cluster-clock.yaml for an example of downstream usage.
  - |
    mcc_opp: opp-table-2 {
        compatible = "operating-points-v2";

        mcc_lowperf: opp0 {
            opp-level = <0>;
            apple,memory-perf-config = <0x813057f 0x1800180>;
        };
        mcc_highperf: opp1 {
            opp-level = <1>;
            apple,memory-perf-config = <0x133 0x55555340>;
        };
    };
    soc {
        #address-cells = <2>;
        #size-cells = <2>;

        mcc: memory-controller@200200000 {
            compatible = "apple,t8103-mcc", "apple,mcc";
            #power-domain-cells = <0>;
            reg = <0x2 0x200000 0x0 0x200000>;
            operating-points-v2 = <&mcc_opp>;
            apple,num-channels = <8>;
        };
    };
```

## Documentation/devicetree/bindings/memory-controllers/hpe,gxp-srom.txt
```
* HPE GXP SROM CONTROLLER

Required properties:

- compatible: Must be one of "hpe,gxp-srom", "simple-mfd", "syscon".
- reg: Specifies base physical address and size of the control registers.

Example:

	srom@80fc0000 {
		compatible = "hpe,gxp-srom", "simple-mfd", "syscon";
		reg = <0x80fc0000 0x100>;
	};
```
