## Documentation/devicetree/bindings/mfd/aspeed,ast2600-pwm-tach.yaml
```yaml
# SPDX-License-Identifier: (GPL-2.0-only OR BSD-2-Clause)
# Copyright (C) 2021 ASPEED, Inc.
%YAML 1.2
---
$id: http://devicetree.org/schemas/mfd/aspeed,ast2600-pwm-tach.yaml#
$schema: http://devicetree.org/meta-schemas/core.yaml#

title: PWM Tach controller Device Tree Bindings

description: |
  The PWM Tach controller is represented as a multi-function device which
  includes:
    PWM
    Tach

maintainers:
  - Billy Tsai <billy_tsai@aspeedtech.com>

properties:
  compatible:
    items:
      - enum:
          - aspeed,ast2600-pwm-tach
      - const: syscon
      - const: simple-mfd
  reg:
    maxItems: 1
  "#address-cells":
    const: 1
  "#size-cells":
    const: 1

required:
  - compatible
  - reg
  - "#address-cells"
  - "#size-cells"

additionalProperties:
  type: object

examples:
  - |
    pwm_tach: pwm_tach@1e610000 {
      compatible = "aspeed,ast2600-pwm-tach", "syscon", "simple-mfd";
      #address-cells = <1>;
      #size-cells = <1>;
      reg = <0x1e610000 0x100>;

      pwm: pwm@0 {
        compatible = "aspeed,ast2600-pwm";
        #pwm-cells = <3>;
        reg = <0x0 0x100>;
      };

      tach: tach@1 {
        compatible = "aspeed,ast2600-tach";
        reg = <0x0 0x100>;
      };
    };
```

## Documentation/devicetree/bindings/mfd/brcm,cru.yaml
```yaml
# SPDX-License-Identifier: GPL-2.0-only OR BSD-2-Clause
%YAML 1.2
---
$id: http://devicetree.org/schemas/mfd/brcm,cru.yaml#
$schema: http://devicetree.org/meta-schemas/core.yaml#

title: Broadcom CRU

maintainers:
  - Rafał Miłecki <rafal@milecki.pl>

description: |
  Broadcom CRU ("Clock and Reset Unit" or "Central Resource Unit") is a hardware
  block grouping smaller blocks. On Broadcom Northstar platform it contains e.g.
  clocks, pinctrl, USB PHY and thermal.

properties:
  compatible:
    items:
      - enum:
          - brcm,ns-cru
      - const: simple-mfd

  reg:
    description: CRU registers

  "#address-cells":
    const: 1

  "#size-cells":
    const: 1

additionalProperties: true

required:
  - reg

examples:
  - |
    cru-bus@1800c100 {
      compatible = "brcm,ns-cru", "simple-mfd";
      reg = <0x1800c100 0x1d0>;
      ranges;
      #address-cells = <1>;
      #size-cells = <1>;
    };
```

## Documentation/devicetree/bindings/mfd/brcm,timer-mfd.yaml
```yaml
# SPDX-License-Identifier: GPL-2.0-only OR BSD-2-Clause
%YAML 1.2
---
$id: http://devicetree.org/schemas/mfd/brcm,timer-mfd.yaml#
$schema: http://devicetree.org/meta-schemas/core.yaml#

title: Broadcom's timer MFD

maintainers:
  - Rafał Miłecki <rafal@milecki.pl>

description: |
  Broadcom's timer is a block used in multiple SoCs (e.g., BCM4908, BCM63xx,
  BCM7038). Despite its name it's not strictly a timer device. It consists of:
  timers, watchdog and software reset handler.

properties:
  compatible:
    items:
      - const: brcm,timer-mfd
      - const: simple-mfd
      - const: syscon

  reg:
    maxItems: 1

  ranges: true

  "#address-cells":
    const: 1

  "#size-cells":
    const: 1

patternProperties:
  '^watchdog@[a-f0-9]+$':
    $ref: ../watchdog/brcm,bcm7038-wdt.yaml

additionalProperties: false

required:
  - reg

examples:
  - |
    timer_mfd: timer-mfd@ff800400 {
        compatible = "brcm,timer-mfd", "simple-mfd", "syscon";
        reg = <0xff800400 0x4c>;
        ranges = <0x0 0xff800400 0x4c>;
        #address-cells = <1>;
        #size-cells = <1>;

        watchdog@28 {
            compatible = "brcm,bcm7038-wdt";
            reg = <0x28 0x8>;
        };
    };

    reboot {
        compatible = "syscon-reboot";
        regmap = <&timer_mfd>;
        offset = <0x34>;
        mask = <1>;
    };
```

## Documentation/devicetree/bindings/mfd/da9063.yaml
```yaml
# SPDX-License-Identifier: (GPL-2.0-only OR BSD-2-Clause)
%YAML 1.2
---
$id: http://devicetree.org/schemas/mfd/da9063.yaml#
$schema: http://devicetree.org/meta-schemas/core.yaml#

title: Dialog DA9063/DA9063L Power Management Integrated Circuit (PMIC)

maintainers:
  - Support Opensource <support.opensource@diasemi.com>

description: |
  DA9063 consists of a large and varied group of sub-devices (I2C Only):

  Device                   Supply Names    Description
  ------                   ------------    -----------
  da9063-regulator        :               : LDOs & BUCKs
  da9063-onkey            :               : On Key
  da9063-rtc              :               : Real-Time Clock (DA9063 only)
  da9063-watchdog         :               : Watchdog

properties:
  compatible:
    oneOf:
      - items:
          - enum:
              - dlg,da9063
              - dlg,da9063l

  reg:
    description:
      I2C device address.
    maxItems: 1

  interrupts:
    maxItems: 1

  interrupt-controller: true

  regulators:
    $ref: ../regulator/da9063-regulator.yaml

  onkey:
    $ref: ../input/da9063-onkey.yaml

  rtc:
    $ref: ../rtc/da9063-rtc.yaml

  watchdog:
    $ref: ../watchdog/da9063-watchdog.yaml

required:
  - compatible
  - reg
  - interrupts
  - interrupt-controller

additionalProperties: false

examples:
  - |
        #include <dt-bindings/interrupt-controller/irq.h>

        i2c1 {
                #size-cells = <0>;
                #address-cells = <1>;

                pmic0: da9063@58 {
                        compatible = "dlg,da9063";
                        reg = <0x58>;
                        interrupt-parent = <&gpio6>;
                        interrupts = <11 IRQ_TYPE_LEVEL_LOW>;
                        interrupt-controller;

                        rtc {
                                compatible = "dlg,da9063-rtc";
                        };

                        wdt {
                                compatible = "dlg,da9063-watchdog";
                        };

                        onkey {
                                compatible = "dlg,da9063-onkey";
                                dlg,disable-key-power;
                        };

                        regulators {
                                DA9063_BCORE1: bcore1 {
                                        regulator-name = "BCORE1";
                                        regulator-min-microvolt = <300000>;
                                        regulator-max-microvolt = <1570000>;
                                        regulator-min-microamp = <500000>;
                                        regulator-max-microamp = <2000000>;
                                        regulator-boot-on;
                                };
                                DA9063_LDO11: ldo11 {
                                        regulator-name = "LDO_11";
                                        regulator-min-microvolt = <900000>;
                                        regulator-max-microvolt = <3600000>;
                                        regulator-boot-on;
                                };
                        };
                };
        };
```

## Documentation/devicetree/bindings/mfd/delta,tn48m-cpld.yaml
```yaml
# SPDX-License-Identifier: (GPL-2.0-only OR BSD-2-Clause)
%YAML 1.2
---
$id: http://devicetree.org/schemas/mfd/delta,tn48m-cpld.yaml#
$schema: http://devicetree.org/meta-schemas/core.yaml#

title: Delta Networks TN48M CPLD controller

maintainers:
  - Robert Marko <robert.marko@sartura.hr>

description: |
  Lattice CPLD onboard the TN48M switches is used for system
  management.

  It provides information about the hardware model, revision,
  PSU status etc.

  It is also being used as a GPIO expander for the SFP slots.

properties:
  compatible:
    const: delta,tn48m-cpld

  reg:
    description:
      I2C device address.
    maxItems: 1

  gpio-controller: true

  "#gpio-cells":
    const: 2
    description:
      The first cell is the pin number and the second cell is used to specify
      the gpio active state.

required:
  - compatible
  - reg
  - gpio-controller
  - "#gpio-cells"

additionalProperties: false

examples:
  - |
    i2c {
        #address-cells = <1>;
        #size-cells = <0>;

        cpld@41 {
            compatible = "delta,tn48m-cpld";
            reg = <0x41>;

            gpio-controller;
            #gpio-cells = <2>;
        };
    };
```
