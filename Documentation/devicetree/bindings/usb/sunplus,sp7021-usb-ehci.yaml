## Documentation/devicetree/bindings/watchdog/sunplus,sp7021-wdt.yaml
```yaml
# SPDX-License-Identifier: (GPL-2.0-only OR BSD-2-Clause)
# Copyright (C) Sunplus Co., Ltd. 2021
%YAML 1.2
---
$id: http://devicetree.org/schemas/watchdog/sunplus,sp7021-wdt.yaml#
$schema: http://devicetree.org/meta-schemas/core.yaml#

title: Sunplus SoCs Watchdog Device Tree Bindings

maintainers:
  - XianTao Hu <xt.hu@cqplus1.com>

allOf:
  - $ref: watchdog.yaml#

properties:
  compatible:
    const: sunplus,sp7021-wdt

  reg:
    maxItems: 1

  clocks:
    maxItems: 1

  resets:
    maxItems: 1

required:
  - compatible
  - reg
  - clocks
  - resets

additionalProperties: false

examples:
  - |
    watchdog: watchdog@9c000630 {
        compatible = "sunplus,sp7021-wdt";
        reg = <0x9c000630 0x08>;
        clocks = <&clkc 0x24>;
        resets = <&rstc 0x14>;
    };
...
```

## Documentation/devicetree/bindings/watchdog/xlnx,versal-wwdt.yaml
```yaml
# SPDX-License-Identifier: (GPL-2.0 OR BSD-2-Clause)
%YAML 1.2
---
$id: http://devicetree.org/schemas/watchdog/xlnx,versal-wwdt.yaml#
$schema: http://devicetree.org/meta-schemas/core.yaml#

title: Xilinx Versal Window Watchdog Timer Controller

maintainers:
  - Neeli Srinivas <sneeli@xilinx.com>

description:
  Versal watchdog driver uses Window watchdog mode. Window watchdog
  timer(WWDT) contains closed(first) and open(second) window with
  32 bit width. WWDT will generate an interrupt after the first window
  timeout and reset signal after the second window timeout. Timeout
  and pretimeout configuration, Stop and Refresh trigger only in open
  window.

properties:
  compatible:
    enum:
      - xlnx,versal-wwdt-1.0
  reg:
    maxItems: 1

  clocks:
    maxItems: 1

  timeout-sec: true

  pretimeout-sec: true

  interrupts:
    items:
      - description: Watchdog interrupt
      - description: Watchdog reset pending interrupt
    description:
      Interrupt line names "wdt" or "wwdt_reset_pending".
      wdt - will assert high after first (closed) window
      timer expires. wwdt_reset_pending - will assert high
      after second (open) window timer expires if WRP
      (Watchdog Reset pending) is configured with third
      (SST) timer.

  interrupt-names:
    items:
      - const: wdt
      - const: wwdt_reset_pending

required:
  - compatible
  - reg
  - clocks
  - interrupts
  - interrupt-names

additionalProperties: false

examples:
  - |
        watchdog@fd4d0000 {
           compatible = "xlnx,versal-wwdt-1.0";
           reg = <0xfd4d0000 0x10000>;
           clocks = <&clock25>;
           timeout-sec = <30>;
           pretimeout-sec = <25>;
           interrupts = <0 0x64 1>, <0 0x6D 1>;
           interrupt-names = "wdt", "wwdt_reset_pending";
        };
...
```

## Documentation/devicetree/bindings/xrt/xlnx,xrt-group.yaml
```yaml
# SPDX-License-Identifier: (GPL-2.0-only OR BSD-2-Clause)
%YAML 1.2
---
$id: http://devicetree.org/schemas/xrt/xlnx,xrt-group.yaml#
$schema: http://devicetree.org/meta-schemas/core.yaml#

title: Xilinx XRT group for Alveo platforms

description: |
  The xrt group is a pseudo device which is used to manage and
  support xrt devices in the same Alveo partition. It is part
  of XRT infrastructure.

maintainers:
  - Lizhi Hou <lizhi.hou@xilinx.com>

properties:
  compatible:
    const: xlnx,xrt-group

  "#address-cells":
    const: 3

  "#size-cells":
    const: 2

  ranges: true

patternProperties:
  "^.*@[0-5],[0-9a-f]+,[0-9a-f]+$":
    description: xrt devices belongs to this group
    type: object

required:
  - compatible
  - "#address-cells"
  - "#size-cells"
  - ranges

additionalProperties: false

examples:
  - |
    xrt-bus {
        #address-cells = <2>;
        #size-cells = <2>;
        xrt-group@48,0 {
            compatible = "xlnx,xrt-group";
            #address-cells = <3>;
            #size-cells = <2>;
            ranges = <0 0 0 0 0xe0000000 0 0x2000000
                      2 0 0 0 0xe4200000 0 0x40000>;
            ep_fpga_configuration_00@0,0,1e88000 {
                reg = <0 0 0x1e88000 0 0x8000>;
            };
        };
    };
```

## arch/arm/configs/imxrt_defconfig
```kconfig
# CONFIG_LOCALVERSION_AUTO is not set
CONFIG_SYSVIPC=y
CONFIG_USELIB=y
CONFIG_NO_HZ=y
CONFIG_HIGH_RES_TIMERS=y
CONFIG_BPF_SYSCALL=y
CONFIG_PREEMPT_VOLUNTARY=y
CONFIG_BSD_PROCESS_ACCT=y
CONFIG_BSD_PROCESS_ACCT_V3=y
CONFIG_PSI=y
CONFIG_IKCONFIG=y
CONFIG_IKCONFIG_PROC=y
CONFIG_LOG_BUF_SHIFT=18
CONFIG_MEMCG=y
CONFIG_BLK_CGROUP=y
CONFIG_CFS_BANDWIDTH=y
CONFIG_CGROUP_PIDS=y
CONFIG_CGROUP_RDMA=y
CONFIG_CGROUP_FREEZER=y
CONFIG_CGROUP_DEVICE=y
CONFIG_CGROUP_CPUACCT=y
CONFIG_CGROUP_PERF=y
CONFIG_CGROUP_BPF=y
CONFIG_NAMESPACES=y
CONFIG_USER_NS=y
CONFIG_CHECKPOINT_RESTORE=y
CONFIG_SCHED_AUTOGROUP=y
CONFIG_RELAY=y
CONFIG_BLK_DEV_INITRD=y
CONFIG_EXPERT=y
CONFIG_SGETMASK_SYSCALL=y
# CONFIG_FUTEX is not set
CONFIG_KALLSYMS_ALL=y
CONFIG_PC104=y
# CONFIG_SLUB_DEBUG is not set
# CONFIG_COMPAT_BRK is not set
CONFIG_SLAB_FREELIST_RANDOM=y
CONFIG_SLAB_FREELIST_HARDENED=y
CONFIG_PROFILING=y
# CONFIG_MMU is not set
CONFIG_ARCH_MXC=y
CONFIG_SOC_IMXRT=y
# CONFIG_ARM_DMA_MEM_BUFFERABLE is not set
CONFIG_SET_MEM_PARAM=y
CONFIG_DRAM_BASE=0x80000000
CONFIG_DRAM_SIZE=0x02000000
CONFIG_HZ_250=y
CONFIG_FORCE_MAX_ZONEORDER=14
CONFIG_PARAVIRT=y
# CONFIG_ATAGS is not set
CONFIG_CMDLINE="console=ttyS0 root=/dev/mmcblk0p2 rw earlycon rootwait"
CONFIG_BLK_DEV_BSGLIB=y
CONFIG_BLK_DEV_INTEGRITY=y
CONFIG_BLK_DEV_ZONED=y
CONFIG_BLK_DEV_THROTTLING=y
CONFIG_BLK_WBT=y
CONFIG_BLK_SED_OPAL=y
CONFIG_PARTITION_ADVANCED=y
CONFIG_BSD_DISKLABEL=y
CONFIG_MINIX_SUBPARTITION=y
CONFIG_SOLARIS_X86_PARTITION=y
CONFIG_UNIXWARE_DISKLABEL=y
CONFIG_LDM_PARTITION=y
CONFIG_CMDLINE_PARTITION=y
# CONFIG_MQ_IOSCHED_KYBER is not set
CONFIG_BINFMT_FLAT=y
CONFIG_CLEANCACHE=y
CONFIG_ZPOOL=y
CONFIG_ZBUD=y
CONFIG_Z3FOLD=y
CONFIG_UEVENT_HELPER=y
CONFIG_DEVTMPFS=y
CONFIG_DEVTMPFS_MOUNT=y
# CONFIG_STANDALONE is not set
CONFIG_FW_LOADER_USER_HELPER=y
CONFIG_FW_LOADER_USER_HELPER_FALLBACK=y
CONFIG_IMX_WEIM=y
CONFIG_BLK_DEV_LOOP=y
CONFIG_BLK_DEV_RAM=y
CONFIG_BLK_DEV_RAM_COUNT=1
CONFIG_BLK_DEV_RAM_SIZE=65536
# CONFIG_INPUT_KEYBOARD is not set
# CONFIG_INPUT_MOUSE is not set
# CONFIG_SERIO is not set
CONFIG_LEGACY_PTY_COUNT=2
CONFIG_SERIAL_FSL_LPUART=y
CONFIG_SERIAL_FSL_LPUART_CONSOLE=y
CONFIG_SERIAL_NONSTANDARD=y
CONFIG_SERIAL_DEV_BUS=y
CONFIG_TTY_PRINTK=y
CONFIG_TTY_PRINTK_LEVEL=7
CONFIG_PINCTRL_IMXRT1050=y
CONFIG_GPIO_SYSFS=y
CONFIG_GPIO_MXC=y
# CONFIG_HWMON is not set
# CONFIG_HID is not set
# CONFIG_USB_SUPPORT is not set
CONFIG_MMC=y
CONFIG_MMC_SDHCI=y
CONFIG_MMC_SDHCI_PLTFM=y
CONFIG_MMC_SDHCI_ESDHC_IMX=y
CONFIG_DMADEVICES=y
CONFIG_FSL_EDMA=y
# CONFIG_MX3_IPU is not set
# CONFIG_VIRTIO_MENU is not set
# CONFIG_VHOST_MENU is not set
CONFIG_MEMORY=y
CONFIG_EXT2_FS=y
CONFIG_EXT2_FS_XATTR=y
CONFIG_EXT2_FS_POSIX_ACL=y
CONFIG_EXT2_FS_SECURITY=y
CONFIG_EXT3_FS=y
CONFIG_EXT3_FS_POSIX_ACL=y
CONFIG_EXT3_FS_SECURITY=y
# CONFIG_FILE_LOCKING is not set
# CONFIG_DNOTIFY is not set
CONFIG_QUOTA=y
# CONFIG_PRINT_QUOTA_WARNING is not set
CONFIG_AUTOFS4_FS=y
CONFIG_VFAT_FS=y
CONFIG_FAT_DEFAULT_UTF8=y
CONFIG_EXFAT_FS=y
CONFIG_CONFIGFS_FS=y
# CONFIG_MISC_FILESYSTEMS is not set
CONFIG_NLS_DEFAULT="cp437"
CONFIG_NLS_CODEPAGE_437=y
CONFIG_NLS_ASCII=y
CONFIG_NLS_ISO8859_1=y
CONFIG_NLS_UTF8=y
CONFIG_LSM="yama,loadpin,integrity,apparmor"
# CONFIG_CRYPTO_MANAGER_DISABLE_TESTS is not set
# CONFIG_CRYPTO_HW is not set
CONFIG_PRINTK_TIME=y
CONFIG_CONSOLE_LOGLEVEL_DEFAULT=15
CONFIG_CONSOLE_LOGLEVEL_QUIET=15
CONFIG_MESSAGE_LOGLEVEL_DEFAULT=7
CONFIG_DYNAMIC_DEBUG=y
# CONFIG_DEBUG_BUGVERBOSE is not set
CONFIG_DEBUG_INFO=y
CONFIG_DEBUG_INFO_DWARF4=y
CONFIG_GDB_SCRIPTS=y
CONFIG_MAGIC_SYSRQ=y
CONFIG_MAGIC_SYSRQ_DEFAULT_ENABLE=0x01b6
CONFIG_DEBUG_FS=y
CONFIG_PAGE_POISONING=y
CONFIG_SCHED_STACK_END_CHECK=y
CONFIG_SOFTLOCKUP_DETECTOR=y
CONFIG_DEFAULT_HUNG_TASK_TIMEOUT=1
# CONFIG_SCHED_DEBUG is not set
CONFIG_SCHEDSTATS=y
CONFIG_STACKTRACE=y
CONFIG_DEBUG_USER=y
CONFIG_DEBUG_LL=y
CONFIG_DEBUG_UNCOMPRESS=y
CONFIG_EARLY_PRINTK=y
# CONFIG_RUNTIME_TESTING_MENU is not set
CONFIG_MEMTEST=y
```

## arch/arm/configs/sp7021_defconfig
```kconfig
CONFIG_DEFAULT_HOSTNAME="SP7021-Ev"
CONFIG_SYSVIPC=y
CONFIG_USELIB=y
CONFIG_NO_HZ_IDLE=y
CONFIG_HIGH_RES_TIMERS=y
CONFIG_PREEMPT=y
CONFIG_IKCONFIG=y
CONFIG_IKCONFIG_PROC=y
CONFIG_LOG_BUF_SHIFT=14
CONFIG_BLK_DEV_INITRD=y
CONFIG_INITRAMFS_SOURCE="../rootfs/initramfs/disk/ ../rootfs/initramfs/initramfs.devnodes"
CONFIG_INITRAMFS_ROOT_UID=-1
CONFIG_INITRAMFS_ROOT_GID=-1
# CONFIG_RD_GZIP is not set
# CONFIG_RD_BZIP2 is not set
# CONFIG_RD_LZMA is not set
# CONFIG_RD_XZ is not set
# CONFIG_RD_LZO is not set
# CONFIG_RD_LZ4 is not set
CONFIG_CC_OPTIMIZE_FOR_SIZE=y
# CONFIG_FHANDLE is not set
CONFIG_KALLSYMS_ALL=y
CONFIG_EMBEDDED=y
CONFIG_PERF_EVENTS=y
CONFIG_SLAB=y
CONFIG_ARCH_SUNPLUS=y
# CONFIG_VDSO is not set
CONFIG_SMP=y
CONFIG_HAVE_ARM_ARCH_TIMER=y
CONFIG_THUMB2_KERNEL=y
CONFIG_HIGHMEM=y
# CONFIG_HIGHPTE is not set
CONFIG_FORCE_MAX_ZONEORDER=12
CONFIG_ZBOOT_ROM_TEXT=0x98307000
CONFIG_ZBOOT_ROM_BSS=0x03400000
CONFIG_CMDLINE="root=/dev/ram rw init=/init console=ttyS0,115200 earlyprintk mem=512M@0x0"
CONFIG_AUTO_ZRELADDR=y
CONFIG_VFP=y
CONFIG_NEON=y
CONFIG_MODULES=y
CONFIG_MODULE_UNLOAD=y
CONFIG_MODVERSIONS=y
# CONFIG_CORE_DUMP_DEFAULT_ELF_HEADERS is not set
CONFIG_NET=y
CONFIG_PACKET=y
CONFIG_PACKET_DIAG=y
CONFIG_UNIX=y
CONFIG_INET=y
CONFIG_IP_MULTICAST=y
CONFIG_IP_PNP=y
CONFIG_IP_PNP_DHCP=y
CONFIG_IP_PNP_BOOTP=y
CONFIG_IP_PNP_RARP=y
CONFIG_NET_IPIP=m
CONFIG_BRIDGE=m
CONFIG_VLAN_8021Q=m
CONFIG_NETLINK_DIAG=y
CONFIG_CAN=y
CONFIG_CFG80211=m
CONFIG_CFG80211_WEXT=y
CONFIG_MAC80211=m
CONFIG_CAIF=y
CONFIG_CEPH_LIB=y
CONFIG_CEPH_LIB_USE_DNS_RESOLVER=y
CONFIG_UEVENT_HELPER=y
CONFIG_UEVENT_HELPER_PATH="/sbin/hotplug"
CONFIG_DEVTMPFS=y
CONFIG_DEVTMPFS_MOUNT=y
CONFIG_BLK_DEV_LOOP=y
CONFIG_NETDEVICES=y
# CONFIG_NET_VENDOR_ALACRITECH is not set
# CONFIG_NET_VENDOR_AMAZON is not set
# CONFIG_NET_VENDOR_AQUANTIA is not set
# CONFIG_NET_VENDOR_ARC is not set
# CONFIG_NET_VENDOR_BROADCOM is not set
# CONFIG_NET_VENDOR_CADENCE is not set
# CONFIG_NET_VENDOR_CAVIUM is not set
# CONFIG_NET_VENDOR_CIRRUS is not set
# CONFIG_NET_VENDOR_CORTINA is not set
# CONFIG_NET_VENDOR_EZCHIP is not set
# CONFIG_NET_VENDOR_FARADAY is not set
# CONFIG_NET_VENDOR_GOOGLE is not set
# CONFIG_NET_VENDOR_HISILICON is not set
# CONFIG_NET_VENDOR_HUAWEI is not set
# CONFIG_NET_VENDOR_INTEL is not set
# CONFIG_NET_VENDOR_MARVELL is not set
# CONFIG_NET_VENDOR_MICREL is not set
# CONFIG_NET_VENDOR_MICROCHIP is not set
# CONFIG_NET_VENDOR_MICROSEMI is not set
# CONFIG_NET_VENDOR_NATSEMI is not set
# CONFIG_NET_VENDOR_NETRONOME is not set
# CONFIG_NET_VENDOR_NI is not set
# CONFIG_NET_VENDOR_PENSANDO is not set
# CONFIG_NET_VENDOR_QUALCOMM is not set
# CONFIG_NET_VENDOR_RENESAS is not set
# CONFIG_NET_VENDOR_ROCKER is not set
# CONFIG_NET_VENDOR_SAMSUNG is not set
# CONFIG_NET_VENDOR_SEEQ is not set
# CONFIG_NET_VENDOR_SOLARFLARE is not set
# CONFIG_NET_VENDOR_SMSC is not set
# CONFIG_NET_VENDOR_SOCIONEXT is not set
# CONFIG_NET_VENDOR_STMICRO is not set
# CONFIG_NET_VENDOR_SYNOPSYS is not set
# CONFIG_NET_VENDOR_VIA is not set
# CONFIG_NET_VENDOR_WIZNET is not set
# CONFIG_NET_VENDOR_XILINX is not set
CONFIG_NET_VENDOR_SUNPLUS=y
CONFIG_INPUT_POLLDEV=y
CONFIG_INPUT_SPARSEKMAP=y
CONFIG_INPUT_MOUSEDEV=y
CONFIG_INPUT_EVDEV=y
# CONFIG_INPUT_KEYBOARD is not set
# CONFIG_INPUT_MOUSE is not set
CONFIG_INPUT_MISC=y
CONFIG_INPUT_UINPUT=y
CONFIG_SERIO_LIBPS2=y
# CONFIG_LEGACY_PTYS is not set
# CONFIG_HW_RANDOM is not set
# CONFIG_HWMON is not set
CONFIG_MEDIA_SUPPORT=y
CONFIG_MEDIA_SUPPORT_FILTER=y
CONFIG_MEDIA_CAMERA_SUPPORT=y
CONFIG_MEDIA_PLATFORM_SUPPORT=y
CONFIG_MEDIA_USB_SUPPORT=y
CONFIG_USB_VIDEO_CLASS=y
CONFIG_FB=y
CONFIG_FB_SP7021=y
CONFIG_FRAMEBUFFER_CONSOLE=y
CONFIG_FRAMEBUFFER_CONSOLE_DEFERRED_TAKEOVER=y
CONFIG_HIDRAW=y
CONFIG_GEMINI_USB=y
CONFIG_USB_USE_PLATFORM_RESOURCE=y
CONFIG_USB_EHCI_HCD=y
CONFIG_USB_EHCI_HCD_PLATFORM=y
CONFIG_USB_OHCI_HCD=y
CONFIG_USB_OHCI_HCD_PLATFORM=y
CONFIG_SUNPLUS_USB_PHY=y
CONFIG_USB_SUNPLUS_OTG=y
CONFIG_USB_GADGET=y
CONFIG_USB_DEVICE_LOSE_PACKET_AFTER_SET_INTERFACE_WORKAROUND=y
CONFIG_USB_DEVICE_EP11_NOT_AUTO_SWITCH_WORKAROUND=y
CONFIG_USB_GADGET_SUNPLUS=y
CONFIG_USB_ZERO=y
CONFIG_MMC=y
CONFIG_SP_EMMC=m
CONFIG_STAGING=y
# CONFIG_IOMMU_SUPPORT is not set
CONFIG_PWM=y
CONFIG_PWM_SP7021=y
CONFIG_RESET_CONTROLLER=y
CONFIG_EXT2_FS=y
# CONFIG_DNOTIFY is not set
CONFIG_FANOTIFY=y
CONFIG_VFAT_FS=y
CONFIG_FAT_DEFAULT_IOCHARSET="utf8"
CONFIG_EXFAT_FS=y
CONFIG_TMPFS=y
CONFIG_TMPFS_POSIX_ACL=y
# CONFIG_MISC_FILESYSTEMS is not set
CONFIG_NFS_FS=y
CONFIG_NFS_V4=y
CONFIG_ROOT_NFS=y
CONFIG_NLS_CODEPAGE_437=y
CONFIG_NLS_ASCII=y
CONFIG_NLS_ISO8859_1=y
CONFIG_NLS_UTF8=y
CONFIG_CRC16=y
CONFIG_PRINTK_TIME=y
CONFIG_DYNAMIC_DEBUG=y
CONFIG_MAGIC_SYSRQ=y
CONFIG_DEBUG_FS=y
# CONFIG_SCHED_DEBUG is not set
CONFIG_SCHEDSTATS=y
# CONFIG_DEBUG_PREEMPT is not set
# CONFIG_FTRACE is not set
CONFIG_DEBUG_USER=y
```

## arch/arm/mach-hpe/Kconfig
```kconfig
menuconfig ARCH_HPE
	bool "HPE SoC support"
	help
	  This enables support for HPE ARM based SoC chips
if ARCH_HPE

config ARCH_HPE_GXP
	bool "HPE GXP SoC"
	select ARM_VIC
	select PINCTRL
	select IRQ_DOMAIN
	select GENERIC_IRQ_CHIP
	select MULTI_IRQ_HANDLER
	select SPARSE_IRQ
	select CLKSRC_MMIO
	depends on ARCH_MULTI_V7
	help
	  Support for GXP SoCs

endif
```

## arch/arm/mach-sunplus/Kconfig
```kconfig
# SPDX-License-Identifier: (GPL-2.0-only OR BSD-2-Clause)

config SOC_SP7021
	bool "Sunplus SP7021 SoC support"
	default y
	select CPU_V7
	select ARM_GIC
	select SUNPLUS_SP7021_INTC
	select HAVE_SMP
	select ARM_PSCI
	select COMMON_CLK_SP7021
	select PINCTRL
	select PINCTRL_SPPCTL
	select OF_OVERLAY
	select GPIOLIB
	help
	  Support for Sunplus SP7021 SoC. It is based on ARM 4-core
	  Cotex-A7 with various peripherals (ex: I2C, SPI, SDIO,
	  Ethernet and etc.), FPGA interface,  chip-to-chip bus.
	  It is designed for industrial control.
```
