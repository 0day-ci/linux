## Documentation/devicetree/bindings/usb/sunplus,sp7021-usb-ehci.yaml
```yaml
# SPDX-License-Identifier: (GPL-2.0-only OR BSD-2-Clause)
# Copyright (C) Sunplus Co., Ltd. 2021
%YAML 1.2
---
$id: http://devicetree.org/schemas/usb/sunplus,sp7021-usb-ehci.yaml#
$schema: http://devicetree.org/meta-schemas/core.yaml#

title: Sunplus SP7021 EHCI Device Tree bindings for ehci0/ehci1

maintainers:
  - Vincent Shih <vincent.sunplus@gmail.com>

allOf:
  - $ref: usb-hcd.yaml#

properties:
  compatible:
    enum:
      - sunplus,sp7021-usb-ehci0
      - sunplus,sp7021-usb-ehci1

  clocks:
    maxItems: 2

  clock-names:
    items:
      - const: usbc_clk
      - const: uphy_clk

  resets:
    maxItems: 2

  reset-names:
    items:
      - const: usbc_rst
      - const: uphy_rst

  reg:
    items:
      - description: USBC register region
      - description: UPHY register region
      - description: MOON4 register region

  reg-names:
    items:
      - const: usbc
      - const: uphy
      - const: moon4

  interrupts:
    maxItems: 1

  nvmem-cell-names:
    description: names corresponding to the nvmem cells of disconnect voltage
    const: disc_vol

  nvmem-cells:
    description: nvmem cell address of disconnect voltage
    maxItems: 1

  port-num:
    description:  identify ehci0 (port0) and ehci1 (port1)

required:
  - compatible
  - clocks
  - clock-names
  - resets
  - reset-names
  - reg
  - reg-names
  - interrupts
  - nvmem-cell-names
  - nvmem-cells
  - port-num

additionalProperties: false

examples:
  - |
    #include <dt-bindings/interrupt-controller/irq.h>

    sp_ehci0: usb@9c102100 {
      compatible = "sunplus,sp7021-usb-ehci";
      clocks = <&clkc 0x3a>, <&clkc 0x3d>;
      clock-names = "usbc_clk", "uphy_clk";
      resets = <&rstc 0x2a>, <&rstc 0x2d>;
      reset-names = "usbc_rst", "uphy_rst";
      reg = <0x9c102100 0x68>, <0x9c004a80 0x80>, <0x9c000200 0x80>;
      reg-names = "usbc", "uphy", "moon4";
      interrupt-parent = <&intc>;
      interrupts = <14 IRQ_TYPE_LEVEL_HIGH>;
      nvmem-cell-names = "disc_vol";
      nvmem-cells = <&disc_vol>;
      port-num = <0>;
    };
...
```

## Documentation/devicetree/bindings/usb/sunplus,sp7021-usb-ohci.yaml
```yaml
# SPDX-License-Identifier: (GPL-2.0-only OR BSD-2-Clause)
# Copyright (C) Sunplus Co., Ltd. 2021
%YAML 1.2
---
$id: http://devicetree.org/schemas/usb/sunplus,sp7021-usb-ohci.yaml#
$schema: http://devicetree.org/meta-schemas/core.yaml#

title: Sunplus SP7021 OHCI Controller Device Tree Bindings

allOf:
  - $ref: usb-hcd.yaml#

maintainers:
  - Vincent Shih <vincent.sunplus@gmail.com>

description:
  Sunplus SP7021 USB HOST IP is a USB2.0 Host Controller. It supports both
  Enhanced Host Controller Interface (EHCI) and Open Host Controller Interface
  (OHCI).

  It supports 32-bits address bus and 64bit data bus interface, compliant
  to AMBA AXI interface for data transfer.

  It supports 32-bits address and data bus interface, compliant to AMBA
  AHB interface for register configurations.

  It supports 32-bits address and data bus interface, compliant to AMBA
  AXI interface for register alternative configurations.

  The UTM Interface block generates PHY control signals, compliant to
  USB2.0 Transceiver Macrocell Interface Specification Revision 1.0.

properties:
  compatible:
    const: sunplus,sp7021-usb-ohci

  reg:
    maxItems: 1

  clocks:
    maxItems: 1

  resets:
    maxItems: 1

  interrupts:
    maxItems: 1

required:
  - compatible
  - reg
  - clocks
  - resets
  - interrupts

unevaluatedProperties: false

examples:
  - |
    #include <dt-bindings/interrupt-controller/irq.h>

    sp_ohci0: usb@9c102080 {
      compatible = "sunplus,sp7021-usb-ohci";
      reg = <0x9c102080 0x68>;
      clocks = <&clkc 0x3a>;
      resets = <&rstc 0x2a>;
      interrupt-parent = <&intc>;
      interrupts = <15 IRQ_TYPE_LEVEL_HIGH>;
    };
```

## Documentation/devicetree/bindings/usb/ti,ts5usba224.yaml
```yaml
# SPDX-License-Identifier: (GPL-2.0-only OR BSD-2-Clause)
%YAML 1.2
---
$id: http://devicetree.org/schemas/usb/ti,ts5usba224.yaml#
$schema: http://devicetree.org/meta-schemas/core.yaml#

title: TS5USBA224 USB 2.0 High Speed and Audio mux DT bindings

description:
  The Texas Instruments TS5USBA224 is a double-pole, double throw
  (DPDT) multiplexer that includes a low-distortion audio switch and a
  USB 2.0 High Speed switch in the same package.

maintainers:
  - Alvin Šipraga <alsi@bang-olufsen.dk>

properties:
  compatible:
    enum:
      - ti,ts5usba224

  asel-gpio:
    description: Output GPIO for A_SEL signal
    maxItems: 1

  accessory:
    type: boolean
    description:
      Indicates that this is an Accessory Mode mux.

  port:
    $ref: /schemas/graph.yaml#/properties/port
    description:
      OF graph bindings modelling a Type-C port controller.

required:
  - compatible
  - asel-gpio
  - accessory
  - port

additionalProperties: false

examples:
  - |
    usbaudiomux@0 {
      compatible = "ti,ts5usba224";
      asel-gpios = <&gpio1 7 GPIO_ACTIVE_HIGH>;
      accessory;

      port {
        usb_audio_mux1: endpoint {
          remote-endpoint = <&typec1_mux>;
        };
      };
    };
```

## Documentation/devicetree/bindings/usb/ti,tusb320xa.yaml
```yaml
# SPDX-License-Identifier: (GPL-2.0-only OR BSD-2-Clause)
%YAML 1.2
---
$id: http://devicetree.org/schemas/usb/ti,tusb320xa.yaml#
$schema: http://devicetree.org/meta-schemas/core.yaml#

title: TUSB320xA Type-C port controller DT bindings

description:
  The Texas Instruments TUSB320xA is a USB Type-C port controller which
  supports role and plug orientation detection using the CC pins. It is
  compatible with the USB Type-C Cable and Connector Specification v1.1.

maintainers:
  - Alvin Šipraga <alsi@bang-olufsen.dk>

properties:
  compatible:
    enum:
      - ti,tusb320la
      - ti,tusb320ha

  reg:
    maxItems: 1

  interrupts:
    maxItems: 1

  ports:
    $ref: /schemas/graph.yaml#/properties/ports

    patternProperties:
      '^port@':
        $ref: /schemas/graph.yaml#/properties/port
        description:
          OF graph bindings modelling any "usb-role-switch" or "accessory" mux.

required:
  - compatible
  - reg
  - interrupts

additionalProperties: false

examples:
  - |
    #include <dt-bindings/interrupt-controller/irq.h>

    i2c {
      #address-cells = <1>;
      #size-cells = <0>;

      tcpc@47 {
        compatible = "ti,tusb320la";
        reg = <0x47>;
        interrupt-parent = <&gpio5>;
        interrupts = <2 IRQ_TYPE_LEVEL_LOW>;

        ports {
          #address-cells = <1>;
          #size-cells = <0>;

          port@0 {
            reg = <0>;
            typec1_mux: endpoint {
              remote-endpoint = <&usb_audio_mux1>;
            };
          };

          port@1 {
            reg = <1>;
            typec1_dr_sw: endpoint {
              remote-endpoint = <&usbotg1_drd_sw>;
            };
          };
        };
      };
    };
```

## Documentation/devicetree/bindings/virtio/virtio-device.yaml
```yaml
# SPDX-License-Identifier: (GPL-2.0-only OR BSD-2-Clause)
%YAML 1.2
---
$id: http://devicetree.org/schemas/virtio/virtio-device.yaml#
$schema: http://devicetree.org/meta-schemas/core.yaml#

title: Virtio device bindings

maintainers:
  - Viresh Kumar <viresh.kumar@linaro.org>

description:
  These bindings are applicable to virtio devices irrespective of the bus they
  are bound to, like mmio or pci.

# We need a select here so we don't match all nodes with 'virtio,mmio'
properties:
  $nodename:
    pattern: '^[a-z0-9]+-virtio(-[a-z0-9]+)?$'
    description: |
      Exactly one node describing the virtio device. The name of the node isn't
      significant but its phandle can be used to by a user of the virtio device.

  compatible:
    pattern: "^virtio,[0-9a-f]+$"
    description: Virtio device nodes.
      "virtio,DID", where DID is the virtio device id. The textual
      representation of DID shall be in lower case hexadecimal with leading
      zeroes suppressed.

required:
  - compatible

additionalProperties: true

examples:
  - |
    virtio@3000 {
        compatible = "virtio,mmio";
        reg = <0x3000 0x100>;
        interrupts = <43>;

        i2c-virtio {
            compatible = "virtio,22";
        };
    };
...
```

## Documentation/devicetree/bindings/watchdog/brcm,bcm63xx-wdt.yaml
```yaml
# SPDX-License-Identifier: GPL-2.0-only OR BSD-2-Clause
%YAML 1.2
---
$id: http://devicetree.org/schemas/watchdog/brcm,bcm63xx-wdt.yaml#
$schema: http://devicetree.org/meta-schemas/core.yaml#

title: BCM63xx watchdog

allOf:
  - $ref: "watchdog.yaml#"

maintainers:
  - Rafał Miłecki <rafal@milecki.pl>

properties:
  compatible:
    enum:
      - brcm,bcm3368-wdt
      - brcm,bcm4908-wdt
      - brcm,bcm6328-wdt
      - brcm,bcm6338-wdt
      - brcm,bcm6345-wdt
      - brcm,bcm6348-wdt
      - brcm,bcm6358-wdt
      - brcm,bcm6362-wdt
      - brcm,bcm6368-wdt
      - brcm,bcm6838-wdt
      - brcm,bcm6848-wdt
      - brcm,bcm6858-wdt
      - brcm,bcm60333-wdt
      - brcm,bcm63138-wdt
      - brcm,bcm63148-wdt
      - brcm,bcm63268-wdt
      - brcm,bcm63381-wdt
      - brcm,bcm68360-wdt

  reg:
    maxItems: 1

unevaluatedProperties: false

required:
  - reg

examples:
  - |
    watchdog@ff800400 {
      compatible = "brcm,bcm4908-wdt";
      reg = <0xff800400 0x3c>;
    };
```

## Documentation/devicetree/bindings/watchdog/brcm,bcm7038-wdt.yaml
```yaml
# SPDX-License-Identifier: GPL-2.0-only OR BSD-2-Clause
%YAML 1.2
---
$id: http://devicetree.org/schemas/watchdog/brcm,bcm7038-wdt.yaml#
$schema: http://devicetree.org/meta-schemas/core.yaml#

title: BCM63xx and BCM7038 watchdog timer

allOf:
  - $ref: "watchdog.yaml#"

maintainers:
  - Florian Fainelli <f.fainelli@gmail.com>
  - Justin Chen <justinpopo6@gmail.com>
  - Rafał Miłecki <rafal@milecki.pl>

properties:
  compatible:
    items:
      - enum:
          - brcm,bcm4908-wdt
          - brcm,bcm60333-wdt
          - brcm,bcm63138-wdt
          - brcm,bcm63148-wdt
          - brcm,bcm63268-wdt
          - brcm,bcm63381-wdt
          - brcm,bcm6848-wdt
          - brcm,bcm6858-wdt
          - brcm,bcm68360-wdt
          - brcm,bcm6338-wdt
          - brcm,bcm6345-wdt
          - brcm,bcm6348-wdt
          - brcm,bcm7038-wdt
      - const: brcm,bcm63xx-wdt

  reg:
    maxItems: 1

  clocks:
    maxItems: 1
    description: >
      The clock running the watchdog. If no clock is found the driver will
      default to 27000000 Hz.

unevaluatedProperties: false

required:
  - reg

examples:
  - |
    watchdog@f040a7e8 {
      compatible = "brcm,bcm7038-wdt", "brcm,bcm63xx-wdt";
      reg = <0xf040a7e8 0x16>;
      clocks = <&upg_fixed>;
    };
```

## Documentation/devicetree/bindings/watchdog/da9063-watchdog.yaml
```yaml
# SPDX-License-Identifier: (GPL-2.0-only OR BSD-2-Clause)
%YAML 1.2
---
$id: http://devicetree.org/schemas/watchdog/da9063-watchdog.yaml#
$schema: http://devicetree.org/meta-schemas/core.yaml#

title: Watchdog driver for Dialog DA9063/DA9063L Power Management Integrated Circuit (PMIC)

maintainers:
  - Support Opensource <support.opensource@diasemi.com>

description: |
  This module is part of the DA9063 MFD device. For more details, see
  Documentation/devicetree/bindings/mfd/da9063.yaml.

  The watchdog controller is represented as a sub-node of the PMIC node
  on the device tree.

  This node defines settings for the Watchdog timer associated
  with the DA9063 and DA9063L. There are currently no entries in this
  binding, however compatible = "dlg,da9063-watchdog" should be added
  if a node is created.

properties:
  compatible:
    const: dlg,da9063-watchdog

required:
  - compatible

additionalProperties: false
```

## Documentation/devicetree/bindings/watchdog/faraday,ftwdt010.yaml
```yaml
# SPDX-License-Identifier: (GPL-2.0-only OR BSD-2-Clause)
%YAML 1.2
---
$id: http://devicetree.org/schemas/watchdog/faraday,ftwdt010.yaml#
$schema: http://devicetree.org/meta-schemas/core.yaml#

title: Faraday Technology FTWDT010 watchdog

maintainers:
  - Linus Walleij <linus.walleij@linaro.org>

description: |
  This is an IP part from Faraday Technology found in the Gemini
  SoCs and others.

properties:
  compatible:
    oneOf:
      - const: "faraday,ftwdt010"
      - items:
          - const: "cortina,gemini-watchdog"
          - const: "faraday,ftwdt010"
      - items:
          - const: "moxa,moxart-watchdog"
          - const: "faraday,ftwdt010"
  reg:
    maxItems: 1
  resets:
    maxItems: 1
  clocks:
    maxItems: 1
  clock-names:
    const: PCLK
  interrupts:
    maxItems: 1
  timeout-sec:
    description: the default watchdog timeout in seconds.

required:
  - compatible
  - reg

additionalProperties: false

examples:
  - |
    #include <dt-bindings/interrupt-controller/irq.h>
    watchdog@41000000 {
      compatible = "faraday,ftwdt010";
      reg = <0x41000000 0x1000>;
      interrupts = <3 IRQ_TYPE_LEVEL_HIGH>;
    };
  - |
    watchdog: watchdog@98500000 {
      compatible = "moxa,moxart-watchdog", "faraday,ftwdt010";
      reg = <0x98500000 0x10>;
      clocks = <&clk_apb>;
      clock-names = "PCLK";
    };
...
```

## Documentation/devicetree/bindings/watchdog/gpio-wdt.txt
```
* GPIO-controlled Watchdog

Required Properties:
- compatible: Should contain "linux,wdt-gpio".
- gpios: From common gpio binding; gpio connection to WDT reset pin.
- hw_algo: The algorithm used by the driver. Should be one of the
  following values:
  - toggle: Either a high-to-low or a low-to-high transition clears
    the WDT counter. The watchdog timer is disabled when GPIO is
    left floating or connected to a three-state buffer.
  - level: Low or high level starts counting WDT timeout,
    the opposite level disables the WDT. Active level is determined
    by the GPIO flags.
- hw_margin_ms: Maximum time to reset watchdog circuit (milliseconds).

Optional Properties:
- always-running: If the watchdog timer cannot be disabled, add this flag to
  have the driver keep toggling the signal without a client. It will only cease
  to toggle the signal when the device is open and the timeout elapsed.
- start-at-boot: Start pinging hw watchdog at probe, in order to take advantage
  of kernel configs:
  - WATCHDOG_HANDLE_BOOT_ENABLED: Avoid possible reboot if hw watchdog was been
    enabled before the kernel (by uboot for example) and userspace doesn't take
    control of /dev/watchdog in time;
  - WATCHDOG_OPEN_TIMEOUT: Reboot if userspace doesn't take control of
    /dev/watchdog within the timeout.

Example:
	watchdog: watchdog {
		/* ADM706 */
		compatible = "linux,wdt-gpio";
		gpios = <&gpio3 9 GPIO_ACTIVE_LOW>;
		hw_algo = "toggle";
		hw_margin_ms = <1600>;
	};
```

## Documentation/devicetree/bindings/watchdog/hpe,gxp-wdt.txt
```
* HPE GXP Controlled Watchdog

Required Properties:
- compatible: Should contain "hpe,gxp-wdt".
- reg: The GXP Watchdog Control Registers (Addresses + size) tuples list.

Example:
	watchdog: watchdog@c0000090 {
		compatible = "hpe,gxp-wdt";
		reg = <0xc0000090 0x02>, <0xc0000096 0x01>;
	};
```

## Documentation/devicetree/bindings/watchdog/hpe,gxp-wdt.yaml
```yaml
# SPDX-License-Identifier: (GPL-2.0-only OR BSD-2-Clause)
%YAML 1.2
---
$id: http://devicetree.org/schemas/watchdog/hpe,gxp-wdt.yaml#
$schema: http://devicetree.org/meta-schemas/core.yaml#

title: HPE GXP Controlled Watchdog

allOf:
  - $ref: "watchdog.yaml#"

maintainers:
  - Nick Hawkins <nick.hawkins@hpe.com>
  - Jean-Marie Verdun <verdun@hpe.com>

properties:
  compatible:
    const: hpe,gxp-wdt

  reg:
    items:
      - description: WDGRST register
      - description: WDGCS register

required:
  - compatible
  - reg

unevaluatedProperties: false

examples:
  - |
    watchdog0:  watchdog@c0000090 {
      compatible = "hpe,gxp-wdt";
      reg = <0xc0000090 0x02>, <0xc0000096 0x01>;
    };
```
