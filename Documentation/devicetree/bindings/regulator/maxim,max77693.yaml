## Documentation/devicetree/bindings/regulator/ti,tps65090.yaml
```yaml
# SPDX-License-Identifier: GPL-2.0-only
%YAML 1.2
---
$id: http://devicetree.org/schemas/regulator/ti,tps65090.yaml#
$schema: http://devicetree.org/meta-schemas/core.yaml#

title: Texas Instruments TPS65090 voltage regulator

maintainers:
  - Mark Brown <broonie@kernel.org>

properties:
  compatible:
    const: ti,tps65090

  reg:
    maxItems: 1

  interrupts:
    maxItems: 1

  vsys1-supply:
    description: input supply for DCDC1

  vsys2-supply:
    description: input supply for DCDC2

  vsys3-supply:
    description: input supply for DCDC3

  infet1-supply:
    description: input supply for FET1

  infet2-supply:
    description: input supply for FET2

  infet3-supply:
    description: input supply for FET3

  infet4-supply:
    description: input supply for FET4

  infet5-supply:
    description: input supply for FET5

  infet6-supply:
    description: input supply for FET6

  infet7-supply:
    description: input supply for FET7

  vsys-l1-supply:
    description: input supply for LDO1

  vsys-l2-supply:
    description: input supply for LDO2

  charger:
    $ref: ../power/supply/tps65090-charger.yaml

  regulators:
    type: object
    description: A node that houses a sub-node for each regulator within the device. Each sub-node
      is identified using the node's name, with valid values listed below. The content of each
      sub-node is defined by the standard binding for regulators; see regulator.txt.

    patternProperties:
      "^dcdc[1-3]|fet[1-7]|ldo[1-2]$":
        $ref: regulator.yaml
        properties:
          ti,enable-ext-control:
            $ref: /schemas/types.yaml#/definitions/flag
            description: This is applicable for DCDC1, DCDC2 and DCDC3. If DCDCs are externally
              controlled then this property should be there.

          dcdc-ext-control-gpios:
            $ref: /schemas/types.yaml#/definitions/phandle-array
            description: This is applicable for DCDC1, DCDC2 and DCDC3. If DCDCs are externally
              controlled and if it is from GPIO then GPIO number should be provided. If it is
              externally controlled and no GPIO entry then driver will just configure this rails
              as external control and will not provide any enable/disable APIs.

          ti,overcurrent-wait:
            $ref: /schemas/types.yaml#/definitions/uint32
            description: This is applicable to FET registers, which have a poorly defined
              "overcurrent wait" field.  If this property is present it should be between 0 - 3.
              If this property isn't present we won't touch the "overcurrent wait" field and we'll
              leave it to the BIOS/EC to deal with.
            enum: [ 0, 1, 2, 3 ]

additionalProperties: false

required:
  - compatible
  - reg
  - interrupts
  - regulators

examples:
  - |
    i2c {
      #address-cells = <1>;
      #size-cells = <0>;

      pmic@48 {
        compatible = "ti,tps65090";
        reg = <0x48>;
        interrupts = <0 88 0x4>;

        vsys1-supply = <&some_reg>;
        vsys2-supply = <&some_reg>;
        vsys3-supply = <&some_reg>;
        infet1-supply = <&some_reg>;
        infet2-supply = <&some_reg>;
        infet3-supply = <&some_reg>;
        infet4-supply = <&some_reg>;
        infet5-supply = <&some_reg>;
        infet6-supply = <&some_reg>;
        infet7-supply = <&some_reg>;
        vsys-l1-supply = <&some_reg>;
        vsys-l2-supply = <&some_reg>;

        regulators {
          dcdc1 {
            regulator-name = "dcdc1";
            regulator-boot-on;
            regulator-always-on;
            ti,enable-ext-control;
            dcdc-ext-control-gpios = <&gpio 10 0>;
          };

          dcdc2 {
            regulator-name = "dcdc2";
            regulator-boot-on;
            regulator-always-on;
          };

          dcdc3 {
            regulator-name = "dcdc3";
            regulator-boot-on;
            regulator-always-on;
          };

          fet1 {
            regulator-name = "fet1";
            regulator-boot-on;
            regulator-always-on;
          };

          fet2 {
            regulator-name = "fet2";
            regulator-boot-on;
            regulator-always-on;
          };

          fet3 {
            regulator-name = "fet3";
            regulator-boot-on;
            regulator-always-on;
          };

          fet4 {
            regulator-name = "fet4";
            regulator-boot-on;
            regulator-always-on;
          };

          fet5 {
            regulator-name = "fet5";
            regulator-boot-on;
            regulator-always-on;
          };

          fet6 {
            regulator-name = "fet6";
            regulator-boot-on;
            regulator-always-on;
          };

          fet7 {
            regulator-name = "fet7";
            regulator-boot-on;
            regulator-always-on;
          };

          ldo1 {
            regulator-name = "ldo1";
            regulator-boot-on;
            regulator-always-on;
          };

          ldo2 {
            regulator-name = "ldo2";
            regulator-boot-on;
            regulator-always-on;
          };
        };
      };
    };
```

## Documentation/devicetree/bindings/regulator/ti,tps6586x.yaml
```yaml
# SPDX-License-Identifier: GPL-2.0-only
%YAML 1.2
---
$id: http://devicetree.org/schemas/regulator/ti,tps6586x.yaml#
$schema: http://devicetree.org/meta-schemas/core.yaml#

title: Texas Instruments TPS6586x family of voltage regulator

maintainers:
  - Mark Brown <broonie@kernel.org>

properties:
  compatible:
    const: ti,tps6586x

  reg:
    maxItems: 1

  interrupts:
    maxItems: 1

  sys-supply:
    description: input supply for SYS

  vin-sm0-supply:
    description: input supply for SM0

  vin-sm1-supply:
    description: input supply for SM1

  vin-sm2-supply:
    description: input supply for SM2

  vinldo01-supply:
    description: input supply for LDO0 and LDO1

  vinldo23-supply:
    description: input supply for LDO2 and LDO3

  vinldo4-supply:
    description: input supply for LDO4

  vinldo678-supply:
    description: input supply for LDO6, LDO7 and LDO8

  vinldo9-supply:
    description: input supply for LDO9

  ti,system-power-controller:
    $ref: /schemas/types.yaml#/definitions/flag
    description: If this property exists, it specifies that this PMIC controls the system power.

  regulators:
    type: object
    description: |
      A node that houses a sub-node for each regulator within the device. Each sub-node is
      identified using the node's name (or the deprecated regulator-compatible property if
      present), with valid values listed below. The content of each sub-node is defined by the
      standard binding for regulators; see regulator.yaml.

      Note: LDO5 and LDO_RTC is supplied by SYS regulator internally and the operating system
        needs to take care of establishing the proper parent child relationships.

    patternProperties:
      "^sys|sm[0-2]|ldo[0-9]|ldo_rtc$":
        $ref: regulator.yaml

allOf:
  - $ref: /schemas/gpio/gpio.yaml

unevaluatedProperties: false

required:
  - compatible
  - reg
  - interrupts

examples:
  - |
    i2c {
      #address-cells = <1>;
      #size-cells = <0>;

      pmic@34 {
        compatible = "ti,tps6586x";
        reg = <0x34>;
        interrupts = <0 88 0x4>;

        #gpio-cells = <2>;
        gpio-controller;

        ti,system-power-controller;

        sys-supply = <&dummy>;
        vin-sm0-supply = <&dummy>;
        vin-sm1-supply = <&dummy>;
        vin-sm2-supply = <&dummy>;
        vinldo01-supply = <&dummy>;
        vinldo23-supply = <&dummy>;
        vinldo4-supply = <&dummy>;
        vinldo678-supply = <&dummy>;
        vinldo9-supply = <&dummy>;

        regulators {
          sys {
            regulator-name = "vdd_sys";
            regulator-boot-on;
            regulator-always-on;
          };

          sm0 {
            regulator-min-microvolt = < 725000>;
            regulator-max-microvolt = <1500000>;
            regulator-boot-on;
            regulator-always-on;
          };

          sm1 {
            regulator-min-microvolt = < 725000>;
            regulator-max-microvolt = <1500000>;
            regulator-boot-on;
            regulator-always-on;
          };

          sm2 {
            regulator-min-microvolt = <3000000>;
            regulator-max-microvolt = <4550000>;
            regulator-boot-on;
            regulator-always-on;
          };

          ldo0 {
            regulator-name = "PCIE CLK";
            regulator-min-microvolt = <3300000>;
            regulator-max-microvolt = <3300000>;
          };

          ldo1 {
            regulator-min-microvolt = < 725000>;
            regulator-max-microvolt = <1500000>;
          };

          ldo2 {
            regulator-min-microvolt = < 725000>;
            regulator-max-microvolt = <1500000>;
          };

          ldo3 {
            regulator-min-microvolt = <1250000>;
            regulator-max-microvolt = <3300000>;
          };

          ldo4 {
            regulator-min-microvolt = <1700000>;
            regulator-max-microvolt = <2475000>;
          };

          ldo5 {
            regulator-min-microvolt = <1250000>;
            regulator-max-microvolt = <3300000>;
          };

          ldo6 {
            regulator-min-microvolt = <1250000>;
            regulator-max-microvolt = <3300000>;
          };

          ldo7 {
            regulator-min-microvolt = <1250000>;
            regulator-max-microvolt = <3300000>;
          };

          ldo8 {
            regulator-min-microvolt = <1250000>;
            regulator-max-microvolt = <3300000>;
          };

          ldo9 {
            regulator-min-microvolt = <1250000>;
            regulator-max-microvolt = <3300000>;
          };
        };
      };
    };
```

## Documentation/devicetree/bindings/remoteproc/avm,wasp-rproc.yaml
```yaml
# SPDX-License-Identifier: (GPL-2.0 OR BSD-2-Clause)
%YAML 1.2
---
$id: http://devicetree.org/schemas/remoteproc/avm,wasp-rproc.yaml#
$schema: http://devicetree.org/meta-schemas/core.yaml#

title: AVM WASP processor controller bindings

maintainers:
  - Daniel Kestrel <kestrelseventyfour@gmail.com>

description: |
  This document defines the bindings for the remoteproc component that loads and
  boots firmwares on the AVM Wireless Assistent Support Processor (WASP) SoC
  that is attached to some AVM Fritzbox devices (3390, 3490, 5490, 5491, 7490).

properties:
  compatible:
    enum:
      - avm,fritzbox3390-wasp
      - avm,fritzboxx490-wasp

  avm,wasp-mdio:
    $ref: /schemas/types.yaml#/definitions/phandle
    description: Lantiq GSWIP switch mdio.

  avm,wasp-port:
    $ref: /schemas/types.yaml#/definitions/phandle
    description: Network port, where the WASP SoC is connected to.

  avm,reset-gpios:
    description: Reset gpio of the WASP SoC.

  avm,startup-gpios:
    description: Startup gpio of the WASP SoC.

required:
  - compatible
  - avm,wasp-mdio
  - avm,wasp-port
  - avm,reset-gpios
  - avm,startup-gpios

additionalProperties: false

examples:
  - |
    #include <dt-bindings/gpio/gpio.h>

    remoteproc {
        compatible = "avm,fritzboxx490-wasp";
        avm,wasp-mdio = <&gswip_mdio>;
        avm,wasp-port = <&port5>;
        avm,reset-gpios = <&gpio 34 GPIO_ACTIVE_HIGH>;
        avm,startup-gpios = <&gpio 5 GPIO_ACTIVE_HIGH>;
    };
```

## Documentation/devicetree/bindings/remoteproc/fsl,imx-dsp-rproc.yaml
```yaml
# SPDX-License-Identifier: (GPL-2.0-only or BSD-2-Clause)
%YAML 1.2
---
$id: http://devicetree.org/schemas/remoteproc/fsl,imx-dsp-rproc.yaml#
$schema: http://devicetree.org/meta-schemas/core.yaml#

title: i.MX DSP Remoteproc Devices

maintainers:
  - Shengjiu Wang <shengjiu.wang@nxp.com>

description:
  This binding provides support for DSP processors found on i.MX family of SoCs

properties:
  compatible:
    enum:
      - fsl,imx8qxp-hifi4
      - fsl,imx8qm-hifi4
      - fsl,imx8mp-hifi4
      - fsl,imx8ulp-hifi4

  clocks:
    description:
      Main functional clock for the remote processor
    minItems: 1
    items:
      - description: core clock
      - description: internal memory clock
      - description: debug interface clock
      - description: network interconnect clock
      - description: message unit clock

  clock-names:
    description: |
      List of clock names for the remote processor.
    minItems: 1
    items:
      - const: core
      - const: ocram
      - const: debug
      - const: nic
      - const: mu

  fsl,dsp-ctrl:
    $ref: /schemas/types.yaml#/definitions/phandle
    description:
      Phandle to syscon block which provide access for processor enablement

  mbox-names:
    items:
      - const: tx
      - const: rx
      - const: rxdb

  mboxes:
    description:
      This property is required only if the rpmsg/virtio functionality is used.
      List of <&phandle type channel> - 1 channel for TX, 1 channel for RX, 1 channel for RXDB.
      (see mailbox/fsl,mu.yaml)
    minItems: 1
    maxItems: 3

  firmware-name:
    description: |
      Default name of the firmware to load to the remote processor.

  memory-region:
    description:
      If present, a phandle for a reserved memory area that used for vdev buffer,
      resource table, vring region and others used by remote processor.
    minItems: 1
    maxItems: 32

  reg:
    description: |
      Address space for any remoteproc memories present on the SoC.

  power-domains:
    minItems: 1
    maxItems: 32

required:
  - compatible
  - reg
  - mboxes
  - mbox-names
  - clocks
  - clock-names
  - firmware-name

additionalProperties: false

examples:
  - |
    #include <dt-bindings/clock/imx8mp-clock.h>
    dsp_reserved: dsp@92400000 {
      reg = <0x92400000 0x1000000>;
      no-map;
    };
    dsp_vdev0vring0: vdev0vring0@942f0000 {
      reg = <0x942f0000 0x8000>;
      no-map;
    };
    dsp_vdev0vring1: vdev0vring1@942f8000 {
      reg = <0x942f8000 0x8000>;
      no-map;
    };
    dsp_vdev0buffer: vdev0buffer@94300000 {
      compatible = "shared-dma-pool";
      reg = <0x94300000 0x100000>;
      no-map;
    };

    dsp: dsp@3b6e8000 {
      compatible = "fsl,imx8mp-hifi4";
      reg = <0x3B6E8000 0x88000>;
      clocks = <&audio_blk_ctrl IMX8MP_CLK_AUDIOMIX_DSP_ROOT>,
               <&audio_blk_ctrl IMX8MP_CLK_AUDIOMIX_OCRAMA_IPG>,
               <&audio_blk_ctrl IMX8MP_CLK_AUDIOMIX_DSPDBG_ROOT>;
      clock-names = "core", "ocram", "debug";
      firmware-name = "imx/dsp/hifi4.bin";
      power-domains = <&audiomix_pd>;
      mbox-names = "tx", "rx", "rxdb";
      mboxes = <&mu2 0 0>,
               <&mu2 1 0>,
               <&mu2 3 0>;
      memory-region = <&dsp_vdev0buffer>, <&dsp_vdev0vring0>,
                      <&dsp_vdev0vring1>, <&dsp_reserved>;
      fsl,dsp-ctrl = <&audio_blk_ctrl>;
    };
```
