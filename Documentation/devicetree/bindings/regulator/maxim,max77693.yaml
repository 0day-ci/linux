## Documentation/devicetree/bindings/reserved-memory/reserved-memory.txt
```
*** Reserved memory regions ***

Reserved memory is specified as a node under the /reserved-memory node.
The operating system shall exclude reserved memory from normal usage
one can create child nodes describing particular reserved (excluded from
normal use) memory regions. Such memory regions are usually designed for
the special usage by various device drivers.

Parameters for each memory region can be encoded into the device tree
with the following nodes:

/reserved-memory node
---------------------
#address-cells, #size-cells (required) - standard definition
    - Should use the same values as the root node
ranges (required) - standard definition
    - Should be empty

/reserved-memory/ child nodes
-----------------------------
Each child of the reserved-memory node specifies one or more regions of
reserved memory. Each child node may either use a 'reg' property to
specify a specific range of reserved memory, or a 'size' property with
optional constraints to request a dynamically allocated block of memory.

Following the generic-names recommended practice, node names should
reflect the purpose of the node (ie. "framebuffer" or "dma-pool"). Unit
address (@<address>) should be appended to the name if the node is a
static allocation.

Properties:
Requires either a) or b) below.
a) static allocation
   reg (required) - standard definition
b) dynamic allocation
   size (required) - length based on parent's #size-cells
                   - Size in bytes of memory to reserve.
   alignment (optional) - length based on parent's #size-cells
                        - Address boundary for alignment of allocation.
   alloc-ranges (optional) - prop-encoded-array (address, length pairs).
                           - Specifies regions of memory that are
                             acceptable to allocate from.

If both reg and size are present, then the reg property takes precedence
and size is ignored.

Additional properties:
compatible (optional) - standard definition
    - may contain the following strings:
        - shared-dma-pool: This indicates a region of memory meant to be
          used as a shared pool of DMA buffers for a set of devices. It can
          be used by an operating system to instantiate the necessary pool
          management subsystem if necessary.
        - vendor specific string in the form <vendor>,[<device>-]<usage>
#memory-region-cells (optional) -
    - Defines how many cells are used to form the memory region specifier.
      The memory region specifier contains additional information on how a
      reserved memory region referenced by the corresponding phandle will
      be used in a specific context.
no-map (optional) - empty property
    - Indicates the operating system must not create a virtual mapping
      of the region as part of its standard mapping of system memory,
      nor permit speculative access to it under any circumstances other
      than under the control of the device driver using the region.
reusable (optional) - empty property
    - The operating system can use the memory in this region with the
      limitation that the device driver(s) owning the region need to be
      able to reclaim it back. Typically that means that the operating
      system can use that region to store volatile or cached data that
      can be otherwise regenerated or migrated elsewhere.

A node must not carry both the no-map and the reusable property as these are
logically contradictory.

Linux implementation note:
- If a "linux,cma-default" property is present, then Linux will use the
  region for the default pool of the contiguous memory allocator.

- If a "linux,dma-default" property is present, then Linux will use the
  region for the default pool of the consistent DMA allocator.

Device node references to reserved memory
-----------------------------------------
Regions in the /reserved-memory node may be referenced by other device
nodes by adding a memory-region property to the device node.

memory-region (optional) - phandle, specifier pairs to children of /reserved-memory
memory-region-names (optional) - a list of names, one for each corresponding
  entry in the memory-region property

Reserved memory region references can be accompanied by a memory region
specifier, which provides additional information about how the memory region
will be used in that specific context. If a reserved memory region does not
have the #memory-region-cells property, 0 is implied and no information
besides the phandle is conveyed. For reserved memory regions that contain
#memory-region-cells = <1>, the following encoding applies if not otherwise
overridden by the bindings selected by the region's compatible string:

  - bit 0: If set, requests that the region be identity mapped if the system
    uses an IOMMU for I/O virtual address translations. This is used, for
    example, when a bootloader has configured a display controller to display
    a boot splash. Once the OS takes over and enables the IOMMU for the given
    display controller, the IOMMU may fault if the framebuffer hasn't been
    mapped to the IOMMU at the address that the display controller tries to
    access.

Example
-------
This example defines 3 contiguous regions are defined for Linux kernel:
one default of all device drivers (named linux,cma@72000000 and 64MiB in size),
one dedicated to the framebuffer device (named framebuffer@78000000, 8MiB), and
one for multimedia processing (named multimedia-memory@77000000, 64MiB).

/ {
	#address-cells = <1>;
	#size-cells = <1>;

	memory {
		reg = <0x40000000 0x40000000>;
	};

	reserved-memory {
		#address-cells = <1>;
		#size-cells = <1>;
		ranges;

		/* global autoconfigured region for contiguous allocations */
		linux,cma {
			compatible = "shared-dma-pool";
			reusable;
			size = <0x4000000>;
			alignment = <0x2000>;
			linux,cma-default;
		};

		display_reserved: framebuffer@78000000 {
			reg = <0x78000000 0x800000>;
		};

		multimedia_reserved: multimedia@77000000 {
			compatible = "acme,multimedia-memory";
			reg = <0x77000000 0x4000000>;
		};
	};

	/* ... */

	fb0: video@12300000 {
		memory-region = <&display_reserved>;
		/* ... */
	};

	scaler: scaler@12500000 {
		memory-region = <&multimedia_reserved>;
		/* ... */
	};

	codec: codec@12600000 {
		memory-region = <&multimedia_reserved>;
		/* ... */
	};
};
```

## Documentation/devicetree/bindings/reserved-memory/reserved-memory.yaml
```yaml
# SPDX-License-Identifier: GPL-2.0
%YAML 1.2
---
$id: http://devicetree.org/schemas/reserved-memory/reserved-memory.yaml#
$schema: http://devicetree.org/meta-schemas/core.yaml#

title: /reserved-memory Node

maintainers:
  - Devicetree Specification Mailing List <devicetree-spec@vger.kernel.org>

description: >
  Reserved memory is specified as a node under the /reserved-memory node. The
  operating system shall exclude reserved memory from normal usage one can
  create child nodes describing particular reserved (excluded from normal use)
  memory regions. Such memory regions are usually designed for the special
  usage by various device drivers.

properties:
  $nodename:
    const: reserved-memory

  "#address-cells": true
  "#size-cells": true
  ranges: true

patternProperties:
  "^(?!(ranges))[a-z,-]*(@[0-9]+)?$":
    type: object

    description: >
      Each child of the reserved-memory node specifies one or more regions of
      reserved memory. Each child node may either use a 'reg' property to
      specify a specific range of reserved memory, or a 'size' property with
      optional constraints to request a dynamically allocated block of memory.

      Following the generic-names recommended practice, node names should
      reflect the purpose of the node (ie. "framebuffer" or "dma-pool"). Unit
      address (@<address>) should be appended to the name if the node is a
      static allocation.

    properties:
      reg: true

      size:
        $ref: /schemas/types.yaml#/definitions/uint32-array
        description: >
          Length based on parent's \#size-cells. Size in bytes of memory to
          reserve.

      alignment:
        $ref: /schemas/types.yaml#/definitions/uint32-array
        description: >
          Length based on parent's \#size-cells. Address boundary for
          alignment of allocation.

      alloc-ranges:
        $ref: /schemas/types.yaml#/definitions/uint32-array
        description: >
          Address and Length pairs. Specifies regions of memory that are
          acceptable to allocate from.

      compatible:
        oneOf:
          - const: shared-dma-pool
            description: >
              This indicates a region of memory meant to be used as a shared
              pool of DMA buffers for a set of devices. It can be used by an
              operating system to instantiate the necessary pool management
              subsystem if necessary.

          # Vendor-specific compatibles in the form <vendor>,[<device>-]<usage>
          - const: mediatek,trustzone-bootinfo

      no-map:
        type: boolean
        description: >
          Indicates the operating system must not create a virtual mapping of
          the region as part of its standard mapping of system memory, nor
          permit speculative access to it under any circumstances other than
          under the control of the device driver using the region.

      reusable:
        type: boolean
        description: >
          The operating system can use the memory in this region with the
          limitation that the device driver(s) owning the region need to be
          able to reclaim it back. Typically that means that the operating
          system can use that region to store volatile or cached data that
          can be otherwise regenerated or migrated elsewhere.

      linux,cma-default:
        type: boolean
        description: >
          If this property is present, then Linux will use the region for the
          default pool of the contiguous memory allocator.

      linux,dma-default:
        type: boolean
        description: >
          If this property is present, then Linux will use the region for the
          default pool of the consistent DMA allocator.

    allOf:
      - if:
          required:
            - no-map

        then:
          not:
            required:
              - reusable

      - if:
          required:
            - reusable

        then:
          not:
            required:
              - no-map

    oneOf:
      - required:
          - reg

      - required:
          - size

    additionalProperties: true

additionalProperties: true

examples:
  - |
      / {
          #address-cells = <1>;
          #size-cells = <1>;
          model = "MediaTek MT2701 evaluation board";
          compatible = "mediatek,mt2701-evb", "mediatek,mt2701";

          reserved-memory {
              #address-cells = <1>;
              #size-cells = <1>;
              ranges;

              /* global autoconfigured region for contiguous allocations */
              linux,cma {
                  compatible = "shared-dma-pool";
                  reusable;
                  size = <0x4000000>;
                  alignment = <0x2000>;
                  linux,cma-default;
              };

              display_reserved: framebuffer@78000000 {
                  reg = <0x78000000 0x800000>;
              };

              trustzone-bootinfo@80002000 {
                  compatible = "mediatek,trustzone-bootinfo";
                  reg = <0x80002000 0x1000>;
              };
          };
      };

...
```

## Documentation/devicetree/bindings/reset/gpio-reset.yaml
```yaml
# SPDX-License-Identifier: (GPL-2.0+ OR BSD-2-Clause)
%YAML 1.2
---
$id: http://devicetree.org/schemas/reset/gpio-reset.yaml#
$schema: http://devicetree.org/meta-schemas/core.yaml#

title: Generic GPIO reset driver

maintainers:
  - Sean Anderson <seanga2@gmail.com>

description: |
  This is a generic GPIO reset driver which can provide a reset-controller
  interface for GPIO-based reset lines. This driver always operates with
  logical GPIO values; to invert the polarity, specify GPIO_ACTIVE_LOW in the
  GPIO's flags.

properties:
  compatible:
    const: gpio-reset

  '#reset-cells':
    const: 1

  reset-gpios:
    description: |
      GPIOs to assert when asserting a reset. There is a one-to-one mapping
      between the reset specifier and the index of the GPIO in this list to
      assert.

  done-gpios:
    description: |
      GPIOs which indicate that the device controlled by the GPIO has exited
      reset. There must be one done GPIO for each reset GPIO, or no done GPIOs
      at all. The driver will wait for up to done-timeout-us for the
      corresponding done GPIO to assert before returning.

  pre-assert-us:
    default: 0
    description: |
      Microseconds to delay between when the reset was requested to be
      asserted, and asserting the reset GPIO

  post-assert-us:
    default: 0
    description: |
      Microseconds to delay after asserting the reset GPIO and before returning
      to the caller.

  pre-deassert-us:
    default: 0
    description: |
      Microseconds to delay between when the reset was requested to be
      deasserted, and asserting the reset GPIO

  post-deassert-us:
    default: 0
    description: |
      Microseconds to delay after deasserting the reset GPIO and before
      returning to the caller. This delay is always present, even if the done
      GPIO goes high earlier.

  done-timeout-us:
    default: 1000
    description:
      Microseconds to wait for the done GPIO to assert after deasserting the
      reset GPIO. If post-deassert-us is present, this property defaults to 10
      times that delay. The timeout starts after waiting for the post deassert
      delay.

required:
  - '#reset-cells'
  - compatible
  - reset-gpios

additionalProperties: false

examples:
  - |
    #include <dt-bindings/gpio/gpio.h>
    pcs_reset: reset-pcs {
        #reset-cells = <1>;
        compatible = "gpio-reset";
        reset-gpios = <&gpio 0 GPIO_ACTIVE_LOW>,
                      <&gpio 1 GPIO_ACTIVE_LOW>,
                      <&gpio 2 GPIO_ACTIVE_LOW>,
                      <&gpio 3 GPIO_ACTIVE_LOW>;
        done-gpios = <&gpio 4 GPIO_ACTIVE_HIGH>,
                     <&gpio 5 GPIO_ACTIVE_HIGH>,
                     <&gpio 6 GPIO_ACTIVE_HIGH>,
                     <&gpio 7 GPIO_ACTIVE_HIGH>;
        post-deassert-us = <100>;
    };
```

## Documentation/devicetree/bindings/reset/sunplus,reset.yaml
```yaml
# SPDX-License-Identifier: (GPL-2.0-only OR BSD-2-Clause)
# Copyright (C) Sunplus Co., Ltd. 2021
%YAML 1.2
---
$id: "http://devicetree.org/schemas/reset/sunplus,reset.yaml#"
$schema: "http://devicetree.org/meta-schemas/core.yaml#"

title: Sunplus SoC Reset Controller

maintainers:
  - Qin Jian <qinjian@cqplus1.com>

properties:
  compatible:
    const: sunplus,sp7021-reset

  "#reset-cells":
    const: 1

  reg:
    maxItems: 1

required:
  - compatible
  - "#reset-cells"
  - reg

additionalProperties: false

examples:
  - |
    rstc: reset@9c000054 {
      compatible = "sunplus,sp7021-reset";
      #reset-cells = <1>;
      reg = <0x9c000054 0x28>;
    };

...
```

## Documentation/devicetree/bindings/riscv/nuclei.yaml
```yaml
# SPDX-License-Identifier: (GPL-2.0-only OR BSD-2-Clause)
%YAML 1.2
---
$id: http://devicetree.org/schemas/riscv/nuclei.yaml#
$schema: http://devicetree.org/meta-schemas/core.yaml#

title: Nuclei SoC-based boards

maintainers:
  - Icenowy Zheng <icenowy@nucleisys.com>

description:
  Nuclei SoC-based boards

properties:
  $nodename:
    const: '/'
  compatible:
    oneOf:
      - items:
          - const: nuclei,demosoc-ux600-ddr200t
          - const: nuclei,demosoc-ux600
          - const: nuclei,demosoc

additionalProperties: true

...
```
