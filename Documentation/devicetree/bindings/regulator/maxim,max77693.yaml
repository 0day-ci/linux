## Documentation/devicetree/bindings/regulator/maxim,max77693.yaml
```yaml
# SPDX-License-Identifier: GPL-2.0-only OR BSD-2-Clause
%YAML 1.2
---
$id: http://devicetree.org/schemas/regulator/maxim,max77693.yaml#
$schema: http://devicetree.org/meta-schemas/core.yaml#

title: Maxim MAX77693 MicroUSB and Companion Power Management IC regulators

maintainers:
  - Chanwoo Choi <cw00.choi@samsung.com>
  - Krzysztof Kozlowski <krzysztof.kozlowski@canonical.com>

description: |
  This is a part of device tree bindings for Maxim MAX77693 MicroUSB Integrated
  Circuit (MUIC).

  See also Documentation/devicetree/bindings/mfd/maxim,max77693.yaml for
  additional information and example.

patternProperties:
  "^ESAFEOUT[12]$":
    type: object
    $ref: regulator.yaml#
    unevaluatedProperties: false
    description: |
      Safeout LDO regulator.

    properties:
      regulator-min-microvolt: true
      regulator-max-microvolt: true

    required:
      - regulator-name

  "^CHARGER$":
    type: object
    $ref: regulator.yaml#
    unevaluatedProperties: false
    description: |
      Current regulator.

    properties:
      regulator-min-microamp: true
      regulator-max-microamp: true

    required:
      - regulator-name

additionalProperties: false
```

## Documentation/devicetree/bindings/regulator/qcom,pm8008-regulator.yaml
```yaml
# SPDX-License-Identifier: GPL-2.0-only OR BSD-2-Clause
%YAML 1.2
---
$id: http://devicetree.org/schemas/regulator/qcom,pm8008-regulator.yaml#
$schema: http://devicetree.org/meta-schemas/core.yaml#

title: Qualcomm Technologies, Inc. PM8008 Regulator bindings

maintainers:
  - Satya Priya <skakit@codeaurora.org>

description:
  Qualcomm Technologies, Inc. PM8008 is an I2C controlled PMIC
  containing 7 LDO regulators.

patternProperties:
  "^LDO[1-7]$":
    type: object
    $ref: "regulator.yaml#"
    description: PM8008 regulator peripherals of PM8008 regulator device

    properties:
      regulator-name: true

    required:
      - regulator-name

    unevaluatedProperties: false

additionalProperties: false
...
```

## Documentation/devicetree/bindings/regulator/qcom,qca6390.yaml
```yaml
# SPDX-License-Identifier: (GPL-2.0 OR BSD-2-Clause)
%YAML 1.2
---
$id: "http://devicetree.org/schemas/regulator/qcom,qca6390.yaml#"
$schema: "http://devicetree.org/meta-schemas/core.yaml#"

title: Qualcomm QCA6390 WiFi + Bluetoot SoC bindings

maintainers:
  - Andy Gross <agross@kernel.org>
  - Bjorn Andersson <bjorn.andersson@linaro.org>

description: |
  This binding describes thes Qualcomm QCA6390 or QCA6391 power supplies and
  enablement pins.

properties:
  compatible:
    const: qcom,qca6390

  vddaon-supply:
    description:
      0.95V always-on LDO power input

  vddpmu-supply:
    description:
      0.95V LDO power input to PMU

  vddrfa1-supply:
    description:
      0.95V LDO power input to RFA

  vddrfa2-supply:
    description:
      1.25V LDO power input to RFA

  vddrfa3-supply:
    description:
      2V LDO power input to RFA

  vddpcie1-supply:
    description:
      1.25V LDO power input to PCIe part

  vddpcie2-supply:
    description:
      2V LDO power input to PCIe part

  vddio-supply:
    description:
      1.8V VIO input

additionalProperties: false

examples:
  - |
    #include <dt-bindings/gpio/gpio.h>
    qca6390: qca6390 {
      compatible = "qcom,qca6390";

      vddaon-supply = <&vreg_s6a_0p95>;
      vddpmu-supply = <&vreg_s2f_0p95>;
      vddrfa1-supply = <&vreg_s2f_0p95>;
      vddrfa2-supply = <&vreg_s8c_1p3>;
      vddrfa3-supply = <&vreg_s5a_1p9>;
      vddpcie1-supply = <&vreg_s8c_1p3>;
      vddpcie2-supply = <&vreg_s5a_1p9>;
      vddio-supply = <&vreg_s4a_1p8>;
    };
...
```

## Documentation/devicetree/bindings/regulator/sprd,sc2730-regulator.yaml
```yaml
# SPDX-License-Identifier: (GPL-2.0-only OR BSD-2-Clause)
# Copyright 2019-2021 Unisoc Inc.
%YAML 1.2
---
$id: "http://devicetree.org/schemas/regulator/sprd,sc2730-regulator.yaml#"
$schema: "http://devicetree.org/meta-schemas/core.yaml#"

title: Unisoc SC2730 Voltage Regulators Device Tree Bindings

maintainers:
  - Orson Zhai <orsonzhai@gmail.com>
  - Baolin Wang <baolin.wang7@gmail.com>
  - Chunyan Zhang <zhang.lyra@gmail.com>

properties:
  compatible:
    const: sprd,sc2730-regulator

  reg:
    maxItems: 1

patternProperties:
  "^(DCDC|BUCK|LDO)_.+":
    # Child node
    type: object
    description: dcdc/buck/ldo regulator nodes(s).
    $ref: "regulator.yaml#"

required:
  - compatible
  - reg

additionalProperties: false

examples:
  - |
    pmic {
      #address-cells = <1>;
      #size-cells = <0>;

      regulators@1800 {
        compatible = "sprd,sc2730-regulator";
        reg = <0x1800>;

        DCDC_CPU {
          regulator-name = "vddcpu";
          regulator-min-microvolt = <200000>;
          regulator-max-microvolt = <1596875>;
          regulator-ramp-delay = <25000>;
          regulator-always-on;
        };

        LDO_VDDWCN {
          regulator-name = "vddwcn";
          regulator-min-microvolt = <900000>;
          regulator-max-microvolt = <1845000>;
          regulator-ramp-delay = <25000>;
        };
      };
    };
...
```

## Documentation/devicetree/bindings/regulator/ti,palmas-pmic.yaml
```yaml
# SPDX-License-Identifier: GPL-2.0-only
%YAML 1.2
---
$id: http://devicetree.org/schemas/regulator/ti,palmas-pmic.yaml#
$schema: http://devicetree.org/meta-schemas/core.yaml#

title: Texas Instruments Palmas family of PMICs regulator IP block

maintainers:
  - Mark Brown <broonie@kernel.org>

description: |
  The TPS659038 for the AM57x class have OTP spins that have different part numbers but the same
  functionality. There is not a need to add the OTP spins to the Palmas driver. The spin devices
  should use the TPS659038 as it's compatible value.

  This is the list of those devices: tps659037

definitions:
  regulator:
    type: object
    properties:
      ti,warm-reset:
        $ref: /schemas/types.yaml#/definitions/flag
        description: maintain voltage during warm reset

      ti,roof-floor:
        description: This takes as optional argument on platform supporting the rail from
          desired external control. If there is no argument then it will be assume that it is
          controlled by NSLEEP pin.
        oneOf:
          - $ref: /schemas/types.yaml#/definitions/flag
          - $ref: /schemas/types.yaml#/definitions/uint32
            #oneOf:
            #  - description: ENABLE1 pin
            #    const: 1
            #  - description: ENABLE2 pin
            #    const: 2
            #  - description: NSLEEP pin
            #    const: 3

      ti,mode-sleep:
        $ref: /schemas/types.yaml#/definitions/uint32
        description: Mode to adopt in PMIC sleep.
        #oneOf:
        #  - description: off
        #    const: 0
        #  - description: auto
        #    const: 1
        #  - description: ECO
        #    const: 2
        #  - description: forced PWM
        #    const: 3

      ti,smps-range:
        $ref: /schemas/types.yaml#/definitions/uint32
        description: OTP has the wrong range set for the hardware so override
        #oneOf:
        #  - description: low range
        #    const: 0
        #  - description: high range
        #    const: 1

properties:
  compatible:
    items:
      - enum:
          - ti,twl6035-pmic
          - ti,twl6036-pmic
          - ti,twl6037-pmic
          - ti,tps65913-pmic
          - ti,tps65914-pmic
          - ti,tps65917-pmic
          - ti,tps659038-pmic
      - const: ti,palmas-pmic

  interrupts:
    maxItems: 1

  ti,ldo6-vibrator:
    $ref: /schemas/types.yaml#/definitions/flag
    description: Specifies whether LDO6 is in vibrator mode or not.

  regulators:
    type: object
    description: |
      Must contain a sub-node per regulator from the list below. Each sub-node should contain the
      constraints and initialization information for that regulator. See regulator.txt for a
      description of standard properties for these sub-nodes. Additional custom properties are
      listed below.

    patternProperties:
      "^smps(12|123|3|34|457|6|7|8|9|10_out1|10_out2)$":
        $ref: "#/definitions/regulator"

      "^ldo[1-9]|ldoln|ldousb$":
        $ref: "#/definitions/regulator"

patternProperties:
  "^smps(([1-9]|10)-in-)|(smps10-out2-)supply$":
    description: Input supply for the corresponding SMPS regulator.

  "^ldo([1-9]|ln|usb)-in-supply$":
    description: Input supply for the corresponding LDO regulator.

additionalProperties: false

required:
  - compatible

examples:
  - |
    #include <dt-bindings/interrupt-controller/irq.h>

    pmic {
      compatible = "ti,twl6035-pmic", "ti,palmas-pmic";
      interrupt-parent = <&palmas>;
      interrupts = <14 IRQ_TYPE_NONE>;
      interrupts-name = "short-irq";

      ti,ldo6-vibrator;

      ti,system-power-controller;

      regulators {
        smps12_reg: smps12 {
          regulator-name = "smps12";
          regulator-min-microvolt = < 600000>;
          regulator-max-microvolt = <1500000>;
          regulator-always-on;
          regulator-boot-on;
          ti,warm-reset;
          ti,roof-floor = <1>; /* ENABLE1 control */
          ti,mode-sleep = <0>;
          ti,smps-range = <1>;
        };

        ldo1_reg: ldo1 {
          regulator-name = "ldo1";
          regulator-min-microvolt = <2800000>;
          regulator-max-microvolt = <2800000>;
        };
      };
    };
```

## Documentation/devicetree/bindings/regulator/ti,tps51632.yaml
```yaml
# SPDX-License-Identifier: GPL-2.0-only
%YAML 1.2
---
$id: http://devicetree.org/schemas/regulator/ti,tps51632.yaml#
$schema: http://devicetree.org/meta-schemas/core.yaml#

title: Texas Instruments TPS51632 voltage regulator

maintainers:
  - Mark Brown <broonie@kernel.org>

properties:
  compatible:
    const: ti,tps51632

  reg:
    maxItems: 1

  ti,enable-pwm-dvfs:
    $ref: /schemas/types.yaml#/definitions/flag
    description: Enable the DVFS voltage control through the PWM interface.

  ti,dvfs-step-20mV:
    $ref: /schemas/types.yaml#/definitions/flag
    description: The 20 mV step voltage when PWM DVFS enabled. Missing this will set 10 mV step
      voltage in PWM DVFS mode. In normal mode, the voltage step is 10 mV as per datasheet.

allOf:
  - $ref: regulator.yaml

unevaluatedProperties: false

required:
  - compatible
  - reg

examples:
  - |
    i2c {
      #address-cells = <1>;
      #size-cells = <0>;

      regulator@43 {
        compatible = "ti,tps51632";
        reg =  <0x43>;
        regulator-name = "tps51632-vout";
        regulator-min-microvolt = <500000>;
        regulator-max-microvolt = <1500000>;
        regulator-boot-on;
        ti,enable-pwm-dvfs;
        ti,dvfs-step-20mV;
      };
    };
```

## Documentation/devicetree/bindings/regulator/ti,tps62360.yaml
```yaml
# SPDX-License-Identifier: GPL-2.0-only
%YAML 1.2
---
$id: http://devicetree.org/schemas/regulator/ti,tps62360.yaml#
$schema: http://devicetree.org/meta-schemas/core.yaml#

title: Texas Instruments TPS62360 voltage regulator

maintainers:
  - Mark Brown <broonie@kernel.org>

properties:
  compatible:
    enum:
      - ti,tps62360
      - ti,tps62361
      - ti,tps62362
      - ti,tps62363

  reg:
    maxItems: 1

  ti,enable-vout-discharge:
    $ref: /schemas/types.yaml#/definitions/flag
    description: Enable output discharge.

  ti,enable-pull-down:
    $ref: /schemas/types.yaml#/definitions/flag
    description: Enable pull down.

  ti,vsel0-gpio:
    $ref: /schemas/types.yaml#/definitions/phandle-array
    description: GPIO for controlling VSEL0 line. If this property is missing, then assume that
      there is no GPIO for VSEL0 control.

  ti,vsel1-gpio:
    $ref: /schemas/types.yaml#/definitions/phandle-array
    description: GPIO for controlling VSEL1 line. If this property is missing, then assume that
      there is no GPIO for VSEL1 control.

  ti,vsel0-state-high:
    $ref: /schemas/types.yaml#/definitions/flag
    description: Initial state of VSEL0 input is high. If this property is missing, then assume
      the state as low (0).

  ti,vsel1-state-high:
    $ref: /schemas/types.yaml#/definitions/flag
    description: Initial state of VSEL1 input is high. If this property is missing, then assume
      the state as low (0).

allOf:
  - $ref: regulator.yaml

unevaluatedProperties: false

required:
  - compatible
  - reg

examples:
  - |
    i2c {
      #address-cells = <1>;
      #size-cells = <0>;

      regulator@60 {
        compatible = "ti,tps62361";
        reg = <0x60>;
        regulator-name = "tps62361-vout";
        regulator-min-microvolt = <500000>;
        regulator-max-microvolt = <1500000>;
        regulator-boot-on;
        ti,vsel0-gpio = <&gpio1 16 0>;
        ti,vsel1-gpio = <&gpio1 17 0>;
        ti,vsel0-state-high;
        ti,vsel1-state-high;
        ti,enable-pull-down;
        ti,enable-vout-discharge;
      };
    };
```
