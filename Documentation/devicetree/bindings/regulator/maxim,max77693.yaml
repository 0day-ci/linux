## Documentation/devicetree/bindings/remoteproc/mtk,apu.yaml
```yaml
# SPDX-License-Identifier: (GPL-2.0-only OR BSD-2-Clause)
%YAML 1.2

---
$id: "http://devicetree.org/schemas/remoteproc/mtk,apu.yaml#"
$schema: "http://devicetree.org/meta-schemas/core.yaml#"

title: MT8183 AI Processor Unit (APU) a.k.a. Vision Processor Unit (VPU)

description:
  This document defines the binding for the APU, a co-processor that could
  offload the CPU for machine learning and neural network.

maintainers:
  - Alexandre Bailon <abailon@bayLibre.com>

properties:
  compatible:
    const: mediatek,mt8183-apu

  reg:
    maxItems: 1

  interrupts:
    maxItems: 1

  clocks:
    description:
      Three clocks are expected for AXI, IPU and JTAG.
      The JTAG clock seems to be required to run the DSP,
      even when JTAG is not in use."
    maxItems: 3

  clock-names:
    items:
      - const: axi
      - const: ipu
      - const: jtag

  iommus:
    maxItems: 3

  memory-region:
    maxItems: 1

  power-domains:
    maxItems: 1

  pinctrl:
    description: pinctrl handles, required to configure pins for JTAG.

  pinctrl-names:
    items:
      - const: jtag

required:
  - compatible
  - reg
  - interrupts
  - clocks
  - clock-names
  - iommus
  - memory-region
  - power-domains

additionalProperties: false

examples:
  - |
    #include <dt-bindings/clock/mt8183-clk.h>
    #include <dt-bindings/interrupt-controller/arm-gic.h>
    #include <dt-bindings/memory/mt8183-larb-port.h>
    #include <dt-bindings/power/mt8183-power.h>

    reserved-memory {
      #address-cells = <1>;
      #size-cells = <1>;
      ranges;

      vdev0vring0: vdev0vring0 {
        compatible = "shared-dma-pool";
        size = <0 0x00008000>;
        no-map;
      };

      vdev0vring1: vdev0vring1 {
        compatible = "shared-dma-pool";
        size = <0 0x00008000>;
        no-map;
      };

      vdev0buffer: vdev0buffer {
        compatible = "shared-dma-pool";
        size = <0 0x00100000>;
        no-map;
      };
    };

    apu0: apu@19100000 {
      compatible = "mediatek,mt8183-apu";
      reg = <0x19180000 0x14000>;
      interrupts = <GIC_SPI 292 IRQ_TYPE_LEVEL_LOW>;

      iommus = <&iommu M4U_PORT_IMG_IPUO>,
         <&iommu M4U_PORT_IMG_IPU3O>,
         <&iommu M4U_PORT_IMG_IPUI>;

      clocks = <&ipu_core0 CLK_IPU_CORE0_AXI>,
         <&ipu_core0 CLK_IPU_CORE0_IPU>,
         <&ipu_core0 CLK_IPU_CORE0_JTAG>;

      clock-names = "axi", "ipu", "jtag";

      power-domains = <&scpsys MT8183_POWER_DOMAIN_VPU_CORE0>;
      memory-region = <&vdev0buffer>, <&vdev0vring0>, <&vdev0vring1>;
      memory-region-names = "vdev0buffer", "vdev0vring0", "vdev0vring1";
    };
...
```

## Documentation/devicetree/bindings/remoteproc/mtk,scp.yaml
```yaml
# SPDX-License-Identifier: (GPL-2.0 OR BSD-2-Clause)
%YAML 1.2
---
$id: http://devicetree.org/schemas/remoteproc/mtk,scp.yaml#
$schema: http://devicetree.org/meta-schemas/core.yaml#

title: Mediatek SCP Bindings

maintainers:
  - Tinghan Shen <tinghan.shen@mediatek.com>

description:
  This binding provides support for ARM Cortex M4 Co-processor found on some
  Mediatek SoCs.

properties:
  compatible:
    enum:
      - mediatek,mt8183-scp
      - mediatek,mt8192-scp
      - mediatek,mt8195-scp

  reg:
    description: |
      Should contain the address ranges for memory regions SRAM and CFG,
    maxItems: 2

  reg-names:
    description: |
      Contains the corresponding names for the two memory regions. These
      should be named "sram", "cfg".

  clocks:
    description: |
        Clock for co-processor (see ../clock/clock-bindings.txt).
        Required by mt8183 and mt8192.
    maxItems: 1

  clock-names:
    description: |
      Contains the corresponding name for the clock. This should be
      named "main". Required by mt8183 and mt8192.

required:
  - compatible
  - reg
  - reg-names

patternProperties:
  ".*":
    if:
      type: object
    then:
      description:
        Subnodes of the SCP represent rpmsg devices. The names of the devices
        are not important. The properties of these nodes are defined by the
        individual bindings for the rpmsg devices.

      properties:
        mtk,rpmsg-name:
          description:
            Contains the name for the rpmsg device. Used to match
            the subnode to rpmsg device announced by SCP.

      required:
        - mtk,rpmsg-name

additionalProperties: true

examples:
  - |
    #include <dt-bindings/clock/mt8183-clk.h>

    soc {
        #address-cells = <2>;
        #size-cells = <2>;
        scp: scp@10500000 {
            compatible = "mediatek,mt8183-scp";
            reg = <0 0x10500000 0 0x80000>,
                  <0 0x105c0000 0 0x5000>;
            reg-names = "sram", "cfg";
            clocks = <&infracfg CLK_INFRA_SCPSYS>;
            clock-names = "main";
        };
    };
```

## Documentation/devicetree/bindings/remoteproc/qcom,hexagon-v56.yaml
```yaml
# SPDX-License-Identifier: (GPL-2.0-only OR BSD-2-Clause)
%YAML 1.2
---
$id: http://devicetree.org/schemas/remoteproc/qcom,hexagon-v56.yaml#
$schema: http://devicetree.org/meta-schemas/core.yaml#

title: Qualcomm Hexagon v56 Peripheral Image Loader

maintainers:
  - Bjorn Andersson <bjorn.andersson@linaro.org>

description:
  This document defines the binding for a component that loads and boots firmware
  on the Qualcomm Technology Inc. Hexagon v56 core.

properties:
  compatible:
    enum:
      - qcom,qcs404-cdsp-pil
      - qcom,sdm845-adsp-pil

  reg:
    maxItems: 1
    description:
      The base address and size of the qdsp6ss register

  interrupts-extended:
    minItems: 5
    maxItems: 5

  interrupt-names:
    minItems: 5
    maxItems: 5

  clocks:
    minItems: 7
    maxItems: 8
    description:
      List of phandles and clock specifier pairs for the Hexagon,
      per clock-names below.

  clock-names:
    minItems: 7
    maxItems: 8

  power-domains:
    maxItems: 1

  resets:
    minItems: 1
    maxItems: 2
    description:
      reference to the list of resets for the Hexagon.

  reset-names:
    minItems: 1
    maxItems: 2

  memory-region:
    maxItems: 1
    description: Reference to the reserved-memory for the Hexagon core

  qcom,halt-regs:
    $ref: /schemas/types.yaml#/definitions/phandle-array
    description:
      Phandle reference to a syscon representing TCSR followed by the
      three offsets within syscon for q6, modem and nc halt registers.

  qcom,smem-states:
    $ref: /schemas/types.yaml#/definitions/phandle-array
    description: States used by the AP to signal the Hexagon core
    items:
      - description: Stop the modem

  qcom,smem-state-names:
    $ref: /schemas/types.yaml#/definitions/string-array
    description: The names of the state bits used for SMP2P output
    items:
      - const: stop

  glink-edge:
    type: object
    description:
      Qualcomm G-Link subnode which represents communication edge, channels
      and devices related to the ADSP.

required:
  - compatible
  - reg
  - interrupts-extended
  - interrupt-names
  - clocks
  - clock-names
  - power-domains
  - qcom,halt-regs
  - memory-region
  - qcom,smem-states
  - qcom,smem-state-names

additionalProperties: false

allOf:
  - if:
      properties:
        compatible:
          contains:
            enum:
              - qcom,qcs404-cdsp-pil
              - qcom,sdm845-adsp-pil
    then:
      properties:
        interrupts-extended:
          items:
            - description: Watchdog interrupt
            - description: Fatal interrupt
            - description: Ready interrupt
            - description: Handover interrupt
            - description: Stop acknowledge interrupt
        interrupt-names:
          items:
            - const: wdog
            - const: fatal
            - const: ready
            - const: handover
            - const: stop-ack

  - if:
      properties:
        compatible:
          contains:
            enum:
              - qcom,sdm845-adsp-pil
    then:
      properties:
        clocks:
          items:
            - description: XO clock
            - description: SWAY clock
            - description: LPASS AHBS AON clock
            - description: LPASS AHBM AON clock
            - description: QDSP6SS XO clock
            - description: QDSP6SS SLEEP clock
            - description: QDSP6SS CORE clock
        clock-names:
          items:
            - const: xo
            - const: sway_cbcr
            - const: lpass_ahbs_aon_cbcr
            - const: lpass_ahbm_aon_cbcr
            - const: qdsp6ss_xo
            - const: qdsp6ss_sleep
            - const: qdsp6ss_core

  - if:
      properties:
        compatible:
          contains:
            enum:
              - qcom,qcs404-cdsp-pil
    then:
      properties:
        clocks:
          items:
            - description: XO clock
            - description: SWAY clock
            - description: TBU clock
            - description: BIMC clock
            - description: AHB AON clock
            - description: Q6SS SLAVE clock
            - description: Q6SS MASTER clock
            - description: Q6 AXIM clock
        clock-names:
          items:
            - const: xo
            - const: sway
            - const: tbu
            - const: bimc
            - const: ahb_aon
            - const: q6ss_slave
            - const: q6ss_master
            - const: q6_axim

  - if:
      properties:
        compatible:
          contains:
            enum:
              - qcom,sc7280-wpss-pil
    then:
      properties:
        clocks:
          items:
            - description: GCC WPSS AHB BDG Master clock
            - description: GCC WPSS AHB clock
            - description: GCC WPSS RSCP clock
        clock-names:
          items:
            - const: gcc_wpss_ahb_bdg_mst_clk
            - const: gcc_wpss_ahb_clk
            - const: gcc_wpss_rscp_clk

  - if:
      properties:
        compatible:
          contains:
            enum:
              - qcom,qcs404-cdsp-pil
              - qcom,sdm845-adsp-pil
    then:
      properties:
        power-domains:
          items:
            - description: CX power domain

  - if:
      properties:
        compatible:
          contains:
            enum:
              - qcom,sdm845-adsp-pil
    then:
      properties:
        resets:
          items:
            - description: PDC SYNC
            - description: CC LPASS
        reset-names:
          items:
            - const: pdc_sync
            - const: cc_lpass

  - if:
      properties:
        compatible:
          contains:
            enum:
              - qcom,qcs404-cdsp-pil
    then:
      properties:
        resets:
          items:
            - description: CDSP restart
        reset-names:
          items:
            - const: restart

examples:
  - |
    #include <dt-bindings/interrupt-controller/arm-gic.h>
    #include <dt-bindings/clock/qcom,rpmh.h>
    #include <dt-bindings/clock/qcom,gcc-sdm845.h>
    #include <dt-bindings/clock/qcom,lpass-sdm845.h>
    #include <dt-bindings/power/qcom-rpmpd.h>
    #include <dt-bindings/reset/qcom,sdm845-pdc.h>
    #include <dt-bindings/reset/qcom,sdm845-aoss.h>
    remoteproc@17300000 {
        compatible = "qcom,sdm845-adsp-pil";
        reg = <0x17300000 0x40c>;

        interrupts-extended = <&intc GIC_SPI 162 IRQ_TYPE_EDGE_RISING>,
                <&adsp_smp2p_in 0 IRQ_TYPE_EDGE_RISING>,
                <&adsp_smp2p_in 1 IRQ_TYPE_EDGE_RISING>,
                <&adsp_smp2p_in 2 IRQ_TYPE_EDGE_RISING>,
                <&adsp_smp2p_in 3 IRQ_TYPE_EDGE_RISING>;
        interrupt-names = "wdog", "fatal", "ready",
                "handover", "stop-ack";

        clocks = <&rpmhcc RPMH_CXO_CLK>,
                 <&gcc GCC_LPASS_SWAY_CLK>,
                 <&lpasscc LPASS_Q6SS_AHBS_AON_CLK>,
                 <&lpasscc LPASS_Q6SS_AHBM_AON_CLK>,
                 <&lpasscc LPASS_QDSP6SS_XO_CLK>,
                 <&lpasscc LPASS_QDSP6SS_SLEEP_CLK>,
                 <&lpasscc LPASS_QDSP6SS_CORE_CLK>;
        clock-names = "xo", "sway_cbcr",
                "lpass_ahbs_aon_cbcr",
                "lpass_ahbm_aon_cbcr", "qdsp6ss_xo",
                "qdsp6ss_sleep", "qdsp6ss_core";

        power-domains = <&rpmhpd SDM845_CX>;

        resets = <&pdc_reset PDC_AUDIO_SYNC_RESET>,
                 <&aoss_reset AOSS_CC_LPASS_RESTART>;
        reset-names = "pdc_sync", "cc_lpass";

        qcom,halt-regs = <&tcsr_mutex_regs 0x22000>;

        memory-region = <&pil_adsp_mem>;

        qcom,smem-states = <&adsp_smp2p_out 0>;
        qcom,smem-state-names = "stop";
    };
```
