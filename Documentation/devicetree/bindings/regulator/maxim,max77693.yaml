## Documentation/devicetree/bindings/remoteproc/xlnx,r5f-rproc.yaml
```yaml
# SPDX-License-Identifier: (GPL-2.0-only or BSD-2-Clause)
%YAML 1.2
---
$id: http://devicetree.org/schemas/remoteproc/xlnx,r5f-rproc.yaml#
$schema: http://devicetree.org/meta-schemas/core.yaml#

title: Xilinx R5F processor subsystem

maintainers:
  - Ben Levinsky <ben.levinsky@xilinx.com>
  - Tanmay Shah <tanmay.shah@xilinx.com>

description: |
  The Xilinx platforms include a pair of Cortex-R5F processors (RPU) for
  real-time processing based on the Cortex-R5F processor core from ARM.
  The Cortex-R5F processor implements the Arm v7-R architecture and includes a
  floating-point unit that implements the Arm VFPv3 instruction set.

properties:
  compatible:
    const: xlnx,zynqmp-r5fss

  xlnx,cluster-mode:
    $ref: /schemas/types.yaml#/definitions/uint32
    description: |
      The RPU MPCore can operate in split mode(Dual-processor performance), Safety
      lock-step mode(Both RPU cores execute the same code in lock-step,
      clock-for-clock) or Single CPU mode (RPU core 0 can be held in reset while
      core 1 runs normally). The processor does not support dynamic configuration.
      Switching between modes is only permitted immediately after a processor reset.
      If set to  1 then lockstep mode and if 0 then split mode.
      If set to  2 then single CPU mode. When not defined, default will be lockstep mode.

  "#address-cells":
    const: 1

  "#size-cells":
    const: 1

  reg:
    items:
      - description: RPU subsystem status and control registers

patternProperties:
  "^r5f-[a-f0-9]+$":
    type: object
    description: |
      The RPU is located in the Low Power Domain of the Processor Subsystem.
      Each processor includes separate L1 instruction and data caches and
      tightly coupled memories (TCM). System memory is cacheable, but the TCM
      memory space is non-cacheable.

      Each RPU contains one 64KB memory and two 32KB memories that
      are accessed via the TCM A and B port interfaces, for a total of 128KB
      per processor. In lock-step mode, the processor has access to 256KB of
      TCM memory.

    properties:
      compatible:
        const: xlnx,zynqmp-r5f

      power-domains:
        description: |
          phandle to a PM domain provider node and an args specifier containing
          the r5f0 and r5f1 node id value.

      reg:
        items:
          - description: RPU0 and RPU1 control and status registers

      mboxes:
        items:
          - description: |
              Bi-directional channel to send data to RPU and receive ack from RPU.
              Request and response message buffers are available and each buffer is 32 bytes.
          - description: |
              Bi-directional channel to receive data from RPU and send ack from RPU.
              Request and response message buffers are available and each buffer is 32 bytes.
        minItems: 1

      mbox-names:
        items:
          - const: tx
          - const: rx
        minItems: 1

      sram:
        $ref: /schemas/types.yaml#/definitions/phandle-array
        minItems: 1
        description: |
          phandles to one or more reserved on-chip SRAM regions. Other than TCM,
          the RPU can execute instructions and access data from, the OCM memory,
          the main DDR memory, and other system memories.

          The regions should be defined as child nodes of the respective SRAM
          node, and should be defined as per the generic bindings in,
          Documentation/devicetree/bindings/sram/sram.yaml

      memory-region:
        $ref: /schemas/types.yaml#/definitions/phandle-array
        description: |
          List of phandles to the reserved memory regions associated with the
          remoteproc device. This is variable and describes the memories shared with
          the remote processor (e.g. remoteproc firmware and carveouts, rpmsg
          vrings, ...). This reserved memory region will be allocated on DDR memory.
          See Documentation/devicetree/bindings/reserved-memory/reserved-memory.txt

    required:
      - compatible
      - power-domains

    unevaluatedProperties: false

required:
  - compatible

additionalProperties: false

examples:
  - |
    r5fss: r5fss@ff9a0000 {
        compatible = "xlnx,zynqmp-r5fss";
        xlnx,cluster-mode = <1>;

        #address-cells = <1>;
        #size-cells = <1>;
        reg = <0xff9a0000 0x228>;

        r5f-0 {
            compatible = "xlnx,zynqmp-r5f";
            power-domains = <&zynqmp_firmware 0x7>;
        };

        r5f-1 {
            compatible = "xlnx,zynqmp-r5f";
            power-domains = <&zynqmp_firmware 0x8>;
        };
    };
...
```

## Documentation/devicetree/bindings/reserved-memory/actions,owl-soc-serial.yaml
```yaml
# SPDX-License-Identifier: (GPL-2.0-only OR BSD-2-Clause)
%YAML 1.2
---
$id: http://devicetree.org/schemas/reserved-memory/actions,owl-soc-serial.yaml#
$schema: http://devicetree.org/meta-schemas/core.yaml#

title: Actions Semi Owl reserved-memory for SoC serial number

maintainers:
  - Cristian Ciocaltea <cristian.ciocaltea@gmail.com>

description: |
  Provide access to the memory region where the two parts of the Actions
  Semi Owl SoC serial number (low & high) can be read from. This information
  is provided by the bootloader, hence expose it under /reserved-memory node.

  Please refer to reserved-memory.txt in this directory for common binding
  part and usage.

  This is currently supported only on the S500 SoC variant.

properties:
  compatible:
    oneOf:
      - const: actions,owl-soc-serial
      - items:
          - enum:
              - actions,s500-soc-serial
          - const: actions,owl-soc-serial

  reg:
    maxItems: 1

required:
  - compatible
  - reg

additionalProperties: true

examples:
  - |
    reserved-memory {
        #address-cells = <1>;
        #size-cells = <1>;
        ranges;

        soc_serial: soc-serial@800 {
            compatible = "actions,s500-soc-serial", "actions,owl-soc-serial";
            reg = <0x800 0x8>;
        };
    };

...
```

## Documentation/devicetree/bindings/reserved-memory/ramoops.yaml
```yaml
# SPDX-License-Identifier: (GPL-2.0 OR BSD-2-Clause)
%YAML 1.2
---
$id: "http://devicetree.org/schemas/reserved-memory/ramoops.yaml#"
$schema: "http://devicetree.org/meta-schemas/core.yaml#"

title: Ramoops oops/panic logger

description: |
  ramoops provides persistent RAM storage for oops and panics, so they can be
  recovered after a reboot. This is a child-node of "/reserved-memory", and
  is named "ramoops" after the backend, rather than "pstore" which is the
  subsystem.

  Parts of this storage may be set aside for other persistent log buffers, such
  as kernel log messages, or for optional ECC error-correction data.  The total
  size of these optional buffers must fit in the reserved region.

  Any remaining space will be used for a circular buffer of oops and panic
  records.  These records have a configurable size, with a size of 0 indicating
  that they should be disabled.

  At least one of "record-size", "console-size", "ftrace-size", or "pmsg-size"
  must be set non-zero, but are otherwise optional as listed below.

maintainers:
  - Kees Cook <keescook@chromium.org>

properties:
  compatible:
    const: ramoops

  reg:
    description: region of memory that is preserved between reboots

  ecc-size:
    description: enables ECC support and specifies ECC buffer size in bytes
    default: 0 # no ECC

  record-size:
    description: maximum size in bytes of each kmsg dump
    default: 0

  console-size:
    description: size in bytes of log buffer reserved for kernel messages
    default: 0

  ftrace-size:
    description: size in bytes of log buffer reserved for function tracing and profiling
    default: 0

  pmsg-size:
    description: size in bytes of log buffer reserved for userspace messages
    default: 0

  mem-type:
    description: if present, sets the type of mapping is to be used to map the reserved region.
    default: 0
    enum:
      - const: 0
        description: write-combined
      - const: 1
        description: unbuffered
      - const: 2
        description: cached

  unbuffered:
    deprecated: true
    description: |
      use mem_type instead. If present, and mem_type is not specified,
      it is equivalent to mem_type = 1 and uses unbuffered mappings to map
      the reserved region (defaults to buffered mappings mem_type = 0).
      If both are specified -- "mem_type" overrides "unbuffered".

  max-reason:
    default: 2 # log oopses and panics
    description: |
      If present, sets maximum type of kmsg dump reasons to store.
      This can be set to INT_MAX to store all kmsg dumps.
      See include/linux/kmsg_dump.h KMSG_DUMP_* for other
      kmsg dump reason values. Setting this to 0 (KMSG_DUMP_UNDEF), means the
      reason filtering will be controlled by the printk.always_kmsg_dump boot

  param:
    description: if unset, it will be KMSG_DUMP_OOPS, otherwise KMSG_DUMP_MAX.

  no-dump-oops:
    deprecated: true
    description: |
      Use max_reason instead. If present, and max_reason is not specified,
      it is equivalent to max_reason = 1 (KMSG_DUMP_PANIC).

  flags:
    default: 0
    description: |
      If present, pass ramoops behavioral flags
      (see include/linux/pstore_ram.h RAMOOPS_FLAG_* for flag values).

additionalProperties: false

required:
  - compatible
  - reg

anyOf:
  - required: [record-size]
  - required: [console-size]
  - required: [ftrace-size]
  - required: [pmsg-size]

examples:
  - |
    reserved-memory {
      #address-cells = <1>;
      #size-cells = <1>;
      ranges;

      ramoops@bfdf0000 {
        compatible = "ramoops";
        reg = <0xbfdf0000 0x10000>; /* 64kB */
        console-size = <0x8000>;    /* 32kB */
        record-size = <0x400>;      /*  1kB */
        ecc-size = <16>;
      };
    };
```
