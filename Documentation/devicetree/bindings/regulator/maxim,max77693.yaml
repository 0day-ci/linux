## Documentation/devicetree/bindings/rtc/abracon,abx80x.txt
```
Abracon ABX80X I2C ultra low power RTC/Alarm chip

The Abracon ABX80X family consist of the ab0801, ab0803, ab0804, ab0805, ab1801,
ab1803, ab1804 and ab1805. The ab0805 is the superset of ab080x and the ab1805
is the superset of ab180x.

Required properties:

 - "compatible": should one of:
        "abracon,abx80x"
        "abracon,ab0801"
        "abracon,ab0803"
        "abracon,ab0804"
        "abracon,ab0805"
        "abracon,ab1801"
        "abracon,ab1803"
        "abracon,ab1804"
        "abracon,ab1805"
        "microcrystal,rv1805"
	Using "abracon,abx80x" will enable chip autodetection.
 - "reg": I2C bus address of the device

Optional properties:

The abx804 and abx805 have a trickle charger that is able to charge the
connected battery or supercap. Both the following properties have to be defined
and valid to enable charging:

 - "abracon,tc-diode": should be "standard" (0.6V) or "schottky" (0.3V)
 - "abracon,tc-resistor": should be <0>, <3>, <6> or <11>. 0 disables the output
                          resistor, the other values are in kOhm.

The RTC can produce square wave output on a dedicated pin for an external usage
or for calibration purpose. A valid string should be assigned to the "sqw"
property to enable the output:

 - "sqw": should be one of the following:
	"1_century", "32768_Hz", "8192_Hz", "4096_Hz", "2048_Hz", "1024_Hz",
	"512_Hz", "256_Hz", "128_Hz", "64_Hz", "32_Hz", "16_Hz", "8_Hz", "4_Hz",
	"2_Hz", "1_Hz",	"1/2_Hz", "1/4_Hz", "1/8_Hz", "1/16_Hz", "1/32_Hz",
	"1_min", "16384_Hz", "100_Hz", "1_hour", "1_day", "TIRQ", "nTIRQ",
	"1_year", "1_Hz_to_Counters", "1/32_Hz_from_Acal", "1/8_Hz_from_Acal",
	"none"

The RTCs support XT calibration that allows to improve the RTC accuracy.
To perform the calibration follow the instruction:

	Write the nominal XT frequency (in milliHerz) 32768000 to
		/sys/class/rtc/your_rtc/xt-frequency
		to ensure the calibration is not occurring.
	Select the XT oscillator by writing by writing xtal to
		/sys/class/rtc/your_rtc/oscillator
	Configure the square wave SQW output by writing
		32768_Hz to /sys/class/rtc/your_rtc/sqw
	Measure the square wave frequency on the output pin in milliHerz.
	Assign the measured value to the property xt-frequency.
```

## Documentation/devicetree/bindings/rtc/da9063-rtc.yaml
```yaml
# SPDX-License-Identifier: (GPL-2.0-only OR BSD-2-Clause)
%YAML 1.2
---
$id: http://devicetree.org/schemas/rtc/da9063-rtc.yaml#
$schema: http://devicetree.org/meta-schemas/core.yaml#

title: RTC driver for Dialog DA9063/DA9063L Power Management Integrated Circuit (PMIC)

maintainers:
  - Support Opensource <support.opensource@diasemi.com>

description:
  This module is part of the DA9063 MFD device. For more details, see
  Documentation/devicetree/bindings/mfd/da9063.yaml.

  The RTC controller is represented as a sub-node of the PMIC node
  on the device tree.

  This node defines settings for the Real-Time Clock associated with
  the DA9063 only. The RTC is not present in DA9063L. There are currently
  no entries in this binding, however compatible = "dlg,da9063-rtc" should
  be added if a node is created.

properties:
  compatible:
    const: dlg,da9063-rtc

required:
  - compatible

additionalProperties: false
```

## Documentation/devicetree/bindings/rtc/emmicro,em3027.yaml
```yaml
# SPDX-License-Identifier: (GPL-2.0-only OR BSD-2-Clause)
%YAML 1.2
---
$id: http://devicetree.org/schemas/rtc/emmicro,em3027.yaml#
$schema: http://devicetree.org/meta-schemas/core.yaml#

title: EM Microelectronic EM3027 RTC Device Tree Bindings

maintainers:
  - Alexandre Belloni <alexandre.belloni@bootlin.com>

properties:
  compatible:
    const: emmicro,em3027

  reg:
    maxItems: 1

allOf:
  - $ref: "rtc.yaml#"

additionalProperties: false

required:
  - compatible
  - reg

examples:
  - |
    i2c {
      #address-cells = <1>;
      #size-cells = <0>;

      rtc@56 {
        compatible = "emmicro,em3027";
        reg = <0x56>;
      };
    };
```
