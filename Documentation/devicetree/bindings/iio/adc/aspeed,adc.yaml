## Documentation/devicetree/bindings/input/touchscreen/wacom,generic.yaml
```yaml
# SPDX-License-Identifier: (GPL-2.0 OR BSD-2-Clause)
%YAML 1.2
---
$id: http://devicetree.org/schemas/input/touchscreen/wacom,generic.yaml#
$schema: http://devicetree.org/meta-schemas/core.yaml#

title: Wacom I2C Controller

maintainers:
  - Alistair Francis <alistair@alistair23.me>

allOf:
  - $ref: touchscreen.yaml#

properties:
  compatible:
    const: wacom,i2c-30

  reg:
    maxItems: 1

  interrupts:
    maxItems: 1

  vdd-supply:
    description: Power Supply

  flip-tilt-x:
    type: boolean
    description: Flip the tilt X values read from device

  flip-tilt-y:
    type: boolean
    description: Flip the tilt Y values read from device

  flip-pos-x:
    type: boolean
    description: Flip the X position values read from device

  flip-pos-y:
    type: boolean
    description: Flip the Y position values read from device

  flip-distance:
    type: boolean
    description: Flip the distance values read from device

required:
  - compatible
  - reg
  - interrupts

unevaluatedProperties: false

examples:
  - |
    #include "dt-bindings/interrupt-controller/irq.h"
    i2c {
        #address-cells = <1>;
        #size-cells = <0>;
        digitiser@9 {
                compatible = "wacom,i2c-30";
                reg = <0x9>;
                interrupt-parent = <&gpio1>;
                interrupts = <9 IRQ_TYPE_LEVEL_LOW>;
                vdd-supply = <&reg_touch>;
        };
    };
```

## Documentation/devicetree/bindings/interrupt-controller/arm,vic.yaml
```yaml
# SPDX-License-Identifier: GPL-2.0
%YAML 1.2
---
$id: http://devicetree.org/schemas/interrupt-controller/arm,vic.yaml#
$schema: http://devicetree.org/meta-schemas/core.yaml#

title: ARM Vectored Interrupt Controller

maintainers:
  - Rob Herring <robh@kernel.org>

description: |+
  One or more Vectored Interrupt Controllers (VIC's) can be connected in an
  ARM system for interrupt routing.  For multiple controllers they can either
  be nested or have the outputs wire-OR'd together.

allOf:
  - $ref: /schemas/interrupt-controller.yaml#

properties:
  compatible:
    oneOf:
      - const: arm,pl190-vic
      - const: arm,pl192-vic

  interrupt-controller: true

  "#interrupt-cells":
    const: 1
    description:
      The number of cells to define the interrupts.  It must be 1 as the
      VIC has no configuration options for interrupt sources. The single
      cell defines the interrupt number.

  reg:
    description: The register bank for the VIC.
    maxItems: 1

  interrupts:
    description:
      Interrupt source for the parent interrupt controller if the VIC
      is nested.
    maxItems: 1

  interrupts-extended:
    description:
      Interrupt source for the parent interrupt controllers if the VIC
      is nested.
    maxItems: 1

  valid-mask:
    description:
      A one cell big bit mask of valid interrupt sources. Each bit
      represents single interrupt source, starting from source 0 at
      LSb and ending at source 31 at MSb. A bit that is set means
      that the source is wired and clear means otherwise. If unspecified,
      defaults to all valid.
    $ref: /schemas/types.yaml#/definitions/uint32
    maxItems: 1

  valid-wakeup-mask:
    description:
      A one cell big bit mask of interrupt sources that can be configured
      as wake up source for the system. Order of bits is the same as for
      valid-mask property. A set bit means that this interrupt source
      can be configured as a wake up source for the system. If unspecied,
      defaults to all interrupt sources configurable as wake up sources.
    $ref: /schemas/types.yaml#/definitions/uint32
    maxItems: 1

required:
  - compatible
  - reg
  - interrupt-controller
  - "#interrupt-cells"

additionalProperties: false

examples:
  - |
    // GICv1
    vic0: interrupt-controller@60000 {
      compatible = "arm,pl192-vic";
      interrupt-controller;
      #interrupt-cells = <1>;
      reg = <0x60000 0x1000>;

      valid-mask = <0xffffff7f>;
      valid-wakeup-mask = <0x0000ff7f>;
    };

...
```

## Documentation/devicetree/bindings/interrupt-controller/fsl,ls-extirq.txt
```
* Freescale Layerscape external IRQs

Some Layerscape SOCs (LS1021A, LS1043A, LS1046A
LS1088A, LS208xA, LX216xA) support inverting
the polarity of certain external interrupt lines.

The device node must be a child of the node representing the
Supplemental Configuration Unit (SCFG).

Required properties:
- compatible: should be "fsl,<soc-name>-extirq", e.g. "fsl,ls1021a-extirq".
  "fsl,ls1043a-extirq": for LS1043A, LS1046A.
  "fsl,ls1088a-extirq": for LS1088A, LS208xA, LX216xA.
- #interrupt-cells: Must be 2. The first element is the index of the
  external interrupt line. The second element is the trigger type.
- #address-cells: Must be 0.
- interrupt-controller: Identifies the node as an interrupt controller
- reg: Specifies the Interrupt Polarity Control Register (INTPCR) in
  the SCFG or the External Interrupt Control Register (IRQCR) in
  the ISC.
- fsl,extirq-map: An array of elements through which the mapping between
  external interrupts and GIC interrupts is specified. The first member of each
  array element is the index of the extirq line. The second member must be
  zero. The third member must be a phandle to the interrupt parent (the GIC).
  The remaining number of members in an array element depends on the
  #interrupt-cells property of the interrupt parent, and are used to specify
  the parent interrupt.

Example:
	scfg: scfg@1570000 {
		compatible = "fsl,ls1021a-scfg", "syscon";
		reg = <0x0 0x1570000 0x0 0x10000>;
		big-endian;
		#address-cells = <1>;
		#size-cells = <1>;
		ranges = <0x0 0x0 0x1570000 0x10000>;

		extirq: interrupt-controller@1ac {
			compatible = "fsl,ls1021a-extirq";
			#interrupt-cells = <2>;
			#address-cells = <0>;
			interrupt-controller;
			reg = <0x1ac 4>;
			fsl,extirq-map =
				<0 0 &gic GIC_SPI 163 IRQ_TYPE_LEVEL_HIGH>,
				<1 0 &gic GIC_SPI 164 IRQ_TYPE_LEVEL_HIGH>,
				<2 0 &gic GIC_SPI 165 IRQ_TYPE_LEVEL_HIGH>,
				<3 0 &gic GIC_SPI 167 IRQ_TYPE_LEVEL_HIGH>,
				<4 0 &gic GIC_SPI 168 IRQ_TYPE_LEVEL_HIGH>,
				<5 0 &gic GIC_SPI 169 IRQ_TYPE_LEVEL_HIGH>;
		};
	};


	interrupts-extended = <&gic GIC_SPI 88 IRQ_TYPE_LEVEL_HIGH>,
			      <&extirq 1 IRQ_TYPE_LEVEL_LOW>;
```

## Documentation/devicetree/bindings/interrupt-controller/fsl,ls-extirq.yaml
```yaml
# SPDX-License-Identifier: GPL-2.0
%YAML 1.2
---
$id: http://devicetree.org/schemas/interrupt-controller/fsl,ls-extirq.yaml#
$schema: http://devicetree.org/meta-schemas/core.yaml#

title: Freescale Layerscape external interrupt driver

maintainers:
  - Rasmus Villemoes <linux@rasmusvillemoes.dk>

description: |
  Some Layerscape SOCs (LS1021A, LS1043A, LS1046A LS1088A, LS208xA, LX216xA)
  support inverting the polarity of certain external interrupt lines.
  The device node must be a child of the node representing the
  Supplemental Configuration Unit (SCFG).

properties:
  compatible:
    oneOf:
      - const: fsl,ls1021a-extirq
      - const: fsl,ls1043a-extirq
      - const: fsl,ls1088a-extirq
      - items:
          - const: fsl,ls1046a-extirq
          - const: fsl,ls1043a-extirq
      - items:
          - const: fsl,lx2160a-extirq
          - const: fsl,ls1088a-extirq
      - items:
          - const: fsl,ls2080a-extirq
          - const: fsl,ls1088a-extirq

  reg:
    description: |
      Specifies the offset to the Interrupt Polarity Control Register (INTPCR)
      in the SCFG or the External Interrupt Control Register (IRQCR) in the
      ISC.
    maxItems: 1

  "#interrupt-cells":
    description: |
      Specifies the number of cells needed to encode an interrupt source. Must
      be equal to 2. The first element is the index of the external interrupt
      line. The second element is the trigger type.
    const: 2

  "#address-cells":
    const: 0

  interrupt-controller: true

  fsl,extirq-map:
    description: |
      An array of elements through which the mapping between external
      interrupts and GIC interrupts is specified. This isn't really a phandle
      array, it just contains some phandles. It should really be an array where
      the items are extirq-map-spec elements, but it seems like the
      vendor-props.yaml don't allow us to reference such things.
    type: object
    $ref: "/schemas/types.yaml#/definitions/phandle-array"

required:
  - compatible
  - reg
  - "#interrupt-cells"
  - interrupt-controller
  - fsl,extirq-map

additionalProperties: false

$defs:
  extirq-map-spec:
    description: |
      The first member of each array element is the index of the extirq line.
      The second member must be zero. The third member must be a phandle to the
      interrupt parent. The remaining number of members in an array element
      depends on the "#interrupt-cells" property of the interrupt parent, and
      are used to specify the parent interrupt.
    type: array
    items:
      $ref: "/schemas/types.yaml#/definitions/cell"
    minItems: 4
    maxItems: 4095

examples:
  - |
    scfg: scfg@1570000 {
        compatible = "fsl,ls1021a-scfg", "syscon";
        reg = <0x0 0x1570000 0x0 0x10000>;
        big-endian;
        #address-cells = <1>;
        #size-cells = <1>;
        ranges = <0x0 0x0 0x1570000 0x10000>;

        extirq: interrupt-controller@1ac {
            compatible = "fsl,ls1021a-extirq";
            #interrupt-cells = <2>;
            #address-cells = <0>;
            interrupt-controller;
            reg = <0x1ac 4>;
            fsl,extirq-map =
                <0 0 &gic GIC_SPI 163 IRQ_TYPE_LEVEL_HIGH>,
                <1 0 &gic GIC_SPI 164 IRQ_TYPE_LEVEL_HIGH>,
                <2 0 &gic GIC_SPI 165 IRQ_TYPE_LEVEL_HIGH>,
                <3 0 &gic GIC_SPI 167 IRQ_TYPE_LEVEL_HIGH>,
                <4 0 &gic GIC_SPI 168 IRQ_TYPE_LEVEL_HIGH>,
                <5 0 &gic GIC_SPI 169 IRQ_TYPE_LEVEL_HIGH>;
        };
    };
```

## Documentation/devicetree/bindings/interrupt-controller/idt,3243x-pic.yaml
```yaml
# SPDX-License-Identifier: (GPL-2.0 OR BSD-2-Clause)
%YAML 1.2
---
$id: http://devicetree.org/schemas/interrupt-controller/idt,3243x-pic.yaml#
$schema: http://devicetree.org/meta-schemas/core.yaml#

title: IDT 79RC3243x Interrupt Controller Device Tree Bindings

maintainers:
  - Thomas Bogendoerfer <tsbogend@alpha.franken.de>

allOf:
  - $ref: /schemas/interrupt-controller.yaml#

properties:
  "#interrupt-cells":
    const: 1

  compatible:
    const: idt,3243x-pci

  reg:
    maxItems: 1

  interrupt-controller: true

required:
  - "#interrupt-cells"
  - compatible
  - reg
  - interrupt-controller

additionalProperties: false

examples:
  - |
    idtpic3: interrupt-controller@3800c {
        compatible = "idt,3243x-pic";
        reg = <0x3800c 0x0c>;

        interrupt-controller;
        #interrupt-cells = <1>;

        interrupt-parent = <&cpuintc>;
        interrupts = <3>;
    };

...
```
