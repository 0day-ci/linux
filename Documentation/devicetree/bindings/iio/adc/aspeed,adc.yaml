## Documentation/devicetree/bindings/input/da9063-onkey.yaml
```yaml
# SPDX-License-Identifier: (GPL-2.0-only OR BSD-2-Clause)
%YAML 1.2
---
$id: http://devicetree.org/schemas/input/da9063-onkey.yaml#
$schema: http://devicetree.org/meta-schemas/core.yaml#

title: OnKey driver for Dialog DA9063/DA9063L Power Management Integrated Circuit (PMIC)

maintainers:
  - Support Opensource <support.opensource@diasemi.com>

description: |
  This module is part of the DA9063 MFD device. For more details, see
  Documentation/devicetree/bindings/mfd/da9063.yaml.

  The OnKey controller is represented as a sub-node of the PMIC node
  on the device tree.

  This node defines the OnKey settings for controlling the key
  functionality of the device. The node should contain the compatible property
  with the value "dlg,da9063-onkey".

properties:
  compatible:
    const: dlg,da9063-onkey

  dlg,disable-key-power:
    description: |
      Disable power-down using a long key-press. If this
      entry exists the OnKey driver will remove support for the KEY_POWER key
      press. If this entry does not exist then by default the key-press
      triggered power down is enabled and the OnKey will support both KEY_POWER
      and KEY_SLEEP.
    type: boolean

required:
  - compatible

additionalProperties: false
```

## Documentation/devicetree/bindings/input/hid-over-spi.txt
```
* HID over SPI Device-Tree bindings

HID over SPI provides support for Human Interface Devices over the SPI bus. HID
Over SPI Protocol Specification 1.0 was written by Microsoft and is available at
https://www.microsoft.com/en-us/download/details.aspx?id=103325.

If this binding is used, the kernel module spi-hid will handle the communication
with the device and the generic hid core layer will handle the protocol.

Required properties:
- compatible: must be "hid-over-spi"
- interrupts: interrupt line
- vdd-supply: phandle of the regulator that provides the supply voltage
- reset_gpio-gpios: gpio wired to the device reset line
- post-power-on-delay-ms: time required by the device after enabling its
regulators or powering it on, before it is ready for communication 
- minimal-reset-delay-ms: minimum amount of time that device needs to be in
reset state for the reset to take effect
- input-report-header-address: this property and the rest are described in HID
Over SPI Protocol Spec 1.0
- input-report-body-address
- output-report-address
- read-opcode
- write-opcode
- flags

Example:
	spi-hid-dev0 {
		compatible = "hid-over-spi";
		reg = <0>;
		interrupts-extended = <&tlmm 42 IRQ_TYPE_EDGE_FALLING>;
		vdd-supply = <&pm8350c_l3>;
		input-report-header-address = <0x1000>;
		input-report-body-address = <0x1004>;
		output-report-address = <0x2000>;
		read-opcode = <0x0b>;
		write-opcode = <0x02>;
		flags = <0x00>;
		reset_gpio-gpios = <&tlmm 25 GPIO_ACTIVE_LOW>;
		post-power-on-delay-ms = <5>;
		minimal-reset-delay-ms = <5>;
		
	};
```

## Documentation/devicetree/bindings/input/mediatek,mt6779-keypad.yaml
```yaml
# SPDX-License-Identifier: GPL-2.0
%YAML 1.2
---
$id: http://devicetree.org/schemas/input/mediatek,mt6779-keypad.yaml#
$schema: http://devicetree.org/meta-schemas/core.yaml#

title: Mediatek's Keypad Controller device tree bindings

maintainers:
  - Fengping Yu <fengping.yu@mediatek.com>

allOf:
  - $ref: "/schemas/input/matrix-keymap.yaml#"

description: |
  Mediatek's Keypad controller is used to interface a SoC with a matrix-type
  keypad device. The keypad controller supports multiple row and column lines.
  A key can be placed at each intersection of a unique row and a unique column.
  The keypad controller can sense a key-press and key-release and report the
  event using a interrupt to the cpu.

properties:
  compatible:
    oneOf:
      - const: mediatek,mt6779-keypad
      - items:
          - enum:
            - mediatek,mt6873-keypad
          - const: mediatek,mt6779-keypad

  reg:
    maxItems: 1

  interrupts:
    maxItems: 1

  clocks:
    maxItems: 1

  clock-names:
    description: Names of the clocks listed in clocks property in the same order
    items:
       - const: kpd

  wakeup-source:
    description: use any event on keypad as wakeup event
    type: boolean

  mediatek,debounce-us:
    description: |
      Debounce interval in microseconds, if not specified, the default
      value is 16000
    maximum: 256000

required:
  - compatible
  - reg
  - interrupts
  - clocks
  - clock-names

additionalProperties: false

examples:
  - |
    #include <dt-bindings/input/input.h>
    #include <dt-bindings/interrupt-controller/arm-gic.h>

    soc {
        #address-cells = <2>;
        #size-cells = <2>;

        kp@10010000 {
          compatible = "mediatek,mt6779-keypad";
          reg = <0 0x10010000 0 0x1000>;
          interrupts = <GIC_SPI 75 IRQ_TYPE_EDGE_FALLING>;
          clocks = <&clk26m>;
          clock-names = "kpd";
        };
    };
```

## Documentation/devicetree/bindings/input/qcom,pm8941-pwrkey.yaml
```yaml
# SPDX-License-Identifier: (GPL-2.0 OR BSD-2-Clause)
%YAML 1.2
---
$id: http://devicetree.org/schemas/input/qcom,pm8941-pwrkey.yaml#
$schema: http://devicetree.org/meta-schemas/core.yaml#

title: Qualcomm PM8941 PMIC Power Key

maintainers:
  - Courtney Cavin <courtney.cavin@sonymobile.com>
  - Vinod Koul <vkoul@kernel.org>

properties:
  compatible:
    enum:
      - qcom,pm8941-pwrkey
      - qcom,pm8941-resin
      - qcom,pmk8350-pwrkey
      - qcom,pmk8350-resin

  interrupts:
    description: |
          Key change interrupt; The format of the specifier is
          defined by the binding document describing the node's
          interrupt parent.

  debounce:
    description: |
          Time in microseconds that key must be pressed or
          released for state change interrupt to trigger.
    $ref: /schemas/types.yaml#/definitions/uint32

  bias-pull-up:
    description: |
           Presence of this property indicates that the KPDPWR_N
           pin should be configured for pull up.
    $ref: /schemas/types.yaml#/definitions/flag

  linux,code:
    description: |
           The input key-code associated with the power key.
           Use the linux event codes defined in
           include/dt-bindings/input/linux-event-codes.h
           When property is omitted KEY_POWER is assumed.
    $ref: "input.yaml#"

required:
  - compatible
  - interrupts

additionalProperties: false

examples:
  - |
   #include <dt-bindings/interrupt-controller/irq.h>
   #include <dt-bindings/input/linux-event-codes.h>
   #include <dt-bindings/spmi/spmi.h>
   spmi_bus: spmi@c440000 {
     reg = <0x0c440000 0x1100>;
     #address-cells = <2>;
     #size-cells = <0>;
     pmk8350: pmic@0 {
       reg = <0x0 SPMI_USID>;
       #address-cells = <1>;
       #size-cells = <0>;
       pmk8350_pon: pon_hlos@1300 {
         reg = <0x1300>;
         compatible = "qcom,pm8998-pon";

         pwrkey {
            compatible = "qcom,pm8941-pwrkey";
            interrupts = < 0x0 0x8 0 IRQ_TYPE_EDGE_BOTH >;
            debounce = <15625>;
            bias-pull-up;
            linux,code = <KEY_POWER>;
         };

         resin {
            compatible = "qcom,pm8941-resin";
            interrupts = <0x0 0x8 1 IRQ_TYPE_EDGE_BOTH>;
            debounce = <15625>;
            bias-pull-up;
            linux,code = <KEY_VOLUMEDOWN>;
         };
       };
     };
   };
...
```

## Documentation/devicetree/bindings/input/qwiic-joystick.yaml
```yaml
# SPDX-License-Identifier: (GPL-2.0 OR BSD-2-Clause)
# Copyright 2021 Oleh Kravchenko
%YAML 1.2
---
$id: "http://devicetree.org/schemas/input/qwiic-joystick.yaml#"
$schema: "http://devicetree.org/meta-schemas/core.yaml#"

title: SparkFun Qwiic Joystick

maintainers:
  - Oleh Kravchenko <oleg@kaa.org.ua>

description: |
  Bindings for SparkFun Qwiic Joystick (COM-15168).
  https://www.sparkfun.com/products/15168

properties:
  compatible:
    const: sparkfun,qwiic-joystick

required:
  - compatible

additionalProperties: false

examples:
  - |
    qwiic@20 {
        compatible = "sparkfun,qwiic-joystick";
        reg = <0x20>;
    };
```

## Documentation/devicetree/bindings/input/ti,palmas-pwrbutton.yaml
```yaml
# SPDX-License-Identifier: GPL-2.0-only
%YAML 1.2
---
$id: http://devicetree.org/schemas/input/ti,palmas-pwrbutton.yaml#
$schema: http://devicetree.org/meta-schemas/core.yaml#

title: Texas Instruments Palmas family of Power-Management ICs (power button)

maintainers:
  - Nishanth Menon <nm@ti.com>

description: |
  This module is part of the Palmas family of PMICs. For more details about the whole chip see:

    Documentation/devicetree/bindings/mfd/palmas.txt

  This module provides a simple power button event via an interrupt.

properties:
  compatible:
    const: ti,palmas-pwrbutton

  interrupts:
    maxItems: 1

  wakeup-source:
    $ref: /schemas/types.yaml#/definitions/flag
    description: Enables wake up of host system on power button press.

  ti,palmas-long-press-seconds:
    $ref: /schemas/types.yaml#/definitions/uint32
    description: |
      Duration in seconds which the power button should be kept pressed for Palmas to power off
      automatically.

      NOTE: This depends on OTP support and POWERHOLD signal configuration on platform.
    enum: [ 6, 8, 10, 12 ]

  ti,palmas-pwron-debounce-milli-seconds:
    $ref: /schemas/types.yaml#/definitions/uint32
    description: |
      Duration in milliseconds which the power button should be kept pressed for Palmas to
      register a press for debouncing purposes. NOTE: This depends on specific Palmas variation
      capability.
    enum: [ 15, 100, 500, 1000 ]

additionalProperties: false

required:
  - compatible
  - interrupts

examples:
  - |
    #include <dt-bindings/interrupt-controller/irq.h>

    i2c {
      #address-cells = <1>;
      #size-cells = <0>;

      pmic@48 {
        compatible = "ti,tps65913", "ti,palmas";
        reg = <0x48>;

        #interrupt-cells = <2>;
        interrupt-controller;

        pwrbutton {
          compatible = "ti,palmas-pwrbutton";
          interrupt-parent = <&tps659038>;
          interrupts = <1 IRQ_TYPE_EDGE_FALLING>;
          ti,palmas-long-press-seconds = <12>;
          ti,palmas-pwron-debounce-milli-seconds = <15>;
        };
      };
    };
```

## Documentation/devicetree/bindings/input/touchscreen/cypress,cyttsp5.yaml
```yaml
# SPDX-License-Identifier: GPL-2.0-only
%YAML 1.2
---
$id: http://devicetree.org/schemas/input/touchscreen/cypress,cyttsp5.yaml#
$schema: http://devicetree.org/meta-schemas/core.yaml#

title: Cypress cyttsp touchscreen controller, generation 5

maintainers:
  - Alistair Francis <alistair@alistair23.me>

allOf:
  - $ref: touchscreen.yaml#

properties:
  compatible:
    const: cypress,cyttsp5

  reg:
    maxItems: 1

  interrupts:
    maxItems: 1

  vdd-supply:
    description: Regulator for voltage.

  reset-gpios:
    maxItems: 1

  linux,code:
    $ref: /schemas/types.yaml#/definitions/uint32
    description: EV_ABS specific event code generated by the axis.

required:
  - compatible
  - reg
  - interrupts
  - vdd-supply

additionalProperties: false

examples:
  - |
    i2c {
        #address-cells = <1>;
        #size-cells = <0>;

        touchscreen@24 {
            compatible = "cypress,cyttsp5";
            reg = <0x24>;
            pinctrl-names = "default";
            pinctrl-0 = <&tp_reset_ds203>;
            interrupt-parent = <&pio>;
            interrupts = <1 5 IRQ_TYPE_LEVEL_LOW>;
            reset-gpios = <&pio 7 1 GPIO_ACTIVE_HIGH>;
            vdd-supply = <&reg_touch>;

            button@0 {
                linux,code = <KEY_HOMEPAGE>;
            };

            button@1 {
                linux,code = <KEY_MENU>;
            };

            button@2 {
                linux,code = <KEY_BACK>;
            };
        };
    };
...
```

## Documentation/devicetree/bindings/input/touchscreen/ti,am3359-tsc.yaml
```yaml
# SPDX-License-Identifier: (GPL-2.0 OR BSD-2-Clause)
%YAML 1.2
---
$id: http://devicetree.org/schemas/input/touchscreen/ti,am3359-tsc.yaml#
$schema: http://devicetree.org/meta-schemas/core.yaml#

title: Bindings for TSC part of TSCADC MFDs on TI SoCs

maintainers:
  - Vignesh Raghavendra <vigneshr@ti.com>

properties:
  compatible:
    const: ti,am3359-tsc

  ti,wires:
    $ref: /schemas/types.yaml#/definitions/uint32
    enum: [4, 5, 8]
    description:
      Number of wires used by touchscreen

  ti,x-plate-resistance:
    $ref: /schemas/types.yaml#/definitions/uint32
    description:
      X plate resistance

  ti,coordinate-readouts:
    $ref: /schemas/types.yaml#/definitions/uint32
    minimum: 1
    maximum: 5
    description:
      The sequencer supports a total of 16 programmable steps
      each step is used to read a single coordinate. A single
      readout is enough but multiple reads can increase the quality.
      A value of 5 means, 5 reads for X, 5 for Y and 2 for Z (always).
      This utilises 12 of the 16 software steps available.
      The remaining 4 can be used by the ADC.

  ti,wire-config:
    $ref: /schemas/types.yaml#/definitions/uint32-array
    description: |
      Different boards could have a different order for
      connecting wires on touchscreen. We need to provide an
      8 bit number where in the 1st four bits represent the
      analog lines and the next 4 bits represent positive/
      negative terminal on that input line. Notations to
      represent the input lines and terminals respectively
      is as follows:
      AIN0 = 0, AIN1 = 1 and so on till AIN7 = 7.
      XP  = 0, XN = 1, YP = 2, YN = 3.
      minItems: 4
    items:
      maximum: 0x73

  ti,charge-delay:
    $ref: /schemas/types.yaml#/definitions/uint32
    description:
      Length of touch screen charge delay step in terms of
      List of analog inputs available for ADC.
      ADC clock cycles. Charge delay value should be large
      in order to avoid false pen-up events. This value
      effects the overall sampling speed, hence need to be
      kept as low as possible, while avoiding false pen-up
      event. Start from a lower value, say 0x400, and
      increase value until false pen-up events are avoided.
      The pen-up detection happens immediately after the
      charge step, so this does in fact function as a
      hardware knob for adjusting the amount of "settling time".
    minimum: 0x1
    maximum: 0xFFFF

required:
  - compatible
  - ti,wires
  - ti,coordinate-readouts
  - ti,wire-config
  - ti,x-plate-resistance

additionalProperties: false
```
