## Documentation/devicetree/bindings/iio/dac/adi,ad5446.yaml
```yaml
# SPDX-License-Identifier: (GPL-2.0 OR BSD-2-Clause)
%YAML 1.2
---
$id: http://devicetree.org/schemas/iio/dac/adi,ad5446.yaml#
$schema: http://devicetree.org/meta-schemas/core.yaml#

title: Single channel DACs similar to the AD5446

maintainers:
  - Lars-Peter Clausen <lars@metafoo.de>
  - Jonathan Cameron <jic23@kernel.org>

properties:
  compatible:
    oneOf:
      - description: I2C devices
        enum:
          - adi,ad5602
          - adi,ad5612
          - adi,ad5622
      - description: SPI devices
        enum:
          - adi,ad5300
          - adi,ad5310
          - adi,ad5320
          - adi,ad5444
          - adi,ad5446
          - adi,ad5450
          - adi,ad5451
          - adi,ad5452
          - adi,ad5453
          - adi,ad5512a
          - adi,ad5541a
          - adi,ad5542a
          - adi,ad5543
          - adi,ad5553
          - adi,ad5600
          - adi,ad5601
          - adi,ad5611
          - adi,ad5621
          - adi,ad5641
          - adi,ad5620-2500
          - adi,ad5620-1250
          - adi,ad5640-2500
          - adi,ad5640-1250
          - adi,ad5660-2500
          - adi,ad5660-1250
          - adi,ad5662
          - ti,dac081s101
          - ti,dac101s101
          - ti,dac121s101
          - ti,dac7512

  reg:
    maxItems: 1

  vcc-supply: true

  spi-max-frequency: true

additionalProperties: false

required:
  - compatible
  - reg

# Ensure the scaling can be established for devices with no internal reference.
allOf:
  - if:
      not:
        properties:
          compatible:
            contains:
              enum:
                - adi,ad5620-2500
                - adi,ad5620-1250
                - adi,ad5640-2500
                - adi,ad5640-1250
                - adi,ad5660-2500
                - adi,ad5660-1250
    then:
      required:
        - vcc-supply

examples:
  - |
    spi {
        #address-cells = <1>;
        #size-cells = <0>;
        dac@0 {
            reg = <0>;
            compatible = "adi,ad5620-2500";
        };
    };
  - |
    i2c {
        #address-cells = <1>;
        #size-cells = <0>;
        dac@42 {
            reg = <0x42>;
            compatible = "adi,ad5602";
            vcc-supply = <&vcc_dac>;
        };
    };
...
```

## Documentation/devicetree/bindings/iio/dac/adi,ltc2688.yaml
```yaml
# SPDX-License-Identifier: (GPL-2.0-only OR BSD-2-Clause)
%YAML 1.2
---
$id: http://devicetree.org/schemas/iio/dac/adi,ltc2688.yaml#
$schema: http://devicetree.org/meta-schemas/core.yaml#

title: Analog Devices LTC2688 DAC

maintainers:
  - Nuno Sá <nuno.sa@analog.com>

description: |
  Analog Devices LTC2688 16 channel, 16 bit, +-15V DAC
  https://www.analog.com/media/en/technical-documentation/data-sheets/ltc2688.pdf

properties:
  compatible:
    enum:
      - adi,ltc2688

  reg:
    maxItems: 1

  vcc-supply:
    description: Analog Supply Voltage Input.

  iovcc-supply:
    description: Digital Input/Output Supply Voltage.

  vref-supply:
    description:
      Reference Input/Output. The voltage at the REF pin sets the full-scale
      range of all channels. By default, the internal reference is routed to
      this pin.

  reset-gpios:
    description:
      If specified, it will be asserted during driver probe. As the line is
      active low, it should be marked GPIO_ACTIVE_LOW.
    maxItems: 1

  clocks:
    minItems: 1
    maxItems: 3

  clock-names:
    minItems: 1
    maxItems: 3
    items:
      enum: [TGP1, TGP2, TGP3]

  '#address-cells':
    const: 1

  '#size-cells':
    const: 0

patternProperties:
  "^channel@([0-9]|1[0-5])$":
    type: object

    properties:
      reg:
        description: The channel number representing the DAC output channel.
        maximum: 15

      adi,toggle-mode:
        description:
          Set the channel as a toggle enabled channel. Toggle operation enables
          fast switching of a DAC output between two different DAC codes without
          any SPI transaction. It will result in a different ABI for the
          channel.
        type: boolean

      adi,output-range-millivolt:
        description:
          Specify the channel output full scale range. Allowed values are
            <0 5000>
            <0 10000>
            <-5000 5000>
            <-10000 10000>
            <-15000 15000>
        $ref: /schemas/types.yaml#/definitions/int32-array

      adi,overrange:
        description: Enable 5% overrange over the selected full scale range.
        type: boolean

      adi,toggle-dither-input:
        description:
          Selects the TGPx pin to be associated with this channel. This setting
          only makes sense for toggle or dither enabled channels. If
          @adi,toggle-mode is not set and this property is given, the channel is
          assumed to be a dither capable channel. Note that multiple channels
          can be mapped to the same pin. If this setting is given, the
          respective @clock must also be provided. Mappings between this and
          clocks
            0 - TGP1
            1 - TGP2
            2 - TGP3
        $ref: /schemas/types.yaml#/definitions/uint32
        enum: [0, 1, 2]

    required:
      - reg

required:
  - compatible
  - reg

additionalProperties: false

examples:
  - |

    spi {
          #address-cells = <1>;
          #size-cells = <0>;
          ltc2688: ltc2688@0 {
                  compatible = "adi,ltc2688";
                  reg = <0>;

                  vcc-supply = <&vcc>;
                  iovcc-supply = <&vcc>;
                  vref-supply = <&vref>;

                  clocks = <&clock_tgp2>;
                  clock-names = "TGP2";

                  #address-cells = <1>;
                  #size-cells = <0>;
                  channel@0 {
                          reg = <0>;
                          adi,toggle-mode;
                          adi,overrange;
                  };

                  channel@1 {
                          reg = <1>;
                          adi,output-range-millivolt = <(-10000) 10000>;
                          adi,toggle-dither-input = <2>;
                  };
          };
    };

...
```

## Documentation/devicetree/bindings/iio/frequency/adi,admv1013.yaml
```yaml
# SPDX-License-Identifier: (GPL-2.0-only OR BSD-2-Clause)
%YAML 1.2
---
$id: http://devicetree.org/schemas/iio/frequency/adi,admv1013.yaml#
$schema: http://devicetree.org/meta-schemas/core.yaml#

title: ADMV1013 Microwave Upconverter

maintainers:
  - Antoniu Miclaus <antoniu.miclaus@analog.com>

description: |
   Wideband, microwave upconverter optimized for point to point microwave
   radio designs operating in the 24 GHz to 44 GHz frequency range.

   https://www.analog.com/en/products/admv1013.html

properties:
  compatible:
    enum:
      - adi,admv1013

  reg:
    maxItems: 1

  spi-max-frequency:
    maximum: 1000000

  clocks:
    description:
      Definition of the external clock.
    minItems: 1

  clock-names:
    items:
      - const: lo_in

  clock-output-names:
    maxItems: 1

  vcm-supply:
    description:
      Analog voltage regulator.

  adi,vga-powerdown:
    description:
      Power Down the Voltage Gain Amplifier Circuit available at
      BG_RBIAS2 pin.
    type: boolean

  adi,mixer-powerdown:
    description:
      Power Down the Mixer Circuit. Enable to put the block in
      a power down state.
    type: boolean

  adi,quad-powerdown:
    description:
      Power Down the Quadrupler. Enable to put the block in
      a power down state.
    type: boolean

  adi,bg-powerdown:
    description:
      Power Down the Transmitter Band Gap. Enable to put the part in
      a power down state.
    type: boolean

  adi,mixer-if-enable:
    description:
      Enable the Intermediate Frequency Mode. Either IF Mode or I/Q Mode
      can be enabled at a time.
    type: boolean

  adi,detector-enable:
    description:
      Enable the Envelope Detector available at output pins VENV_P and
      VENV_N. Disable to reduce power consumption.
    type: boolean

  adi,quad-se-mode:
    description:
      Switch the LO path from differential to single-ended operation.
      Set value 6 for Single-Ended Mode, Negative Side Disabled.
      Set value 9 for Single-Ended Mode, Positive Side Disabled.
      Set value 12 for Differential Mode.
    $ref: /schemas/types.yaml#/definitions/uint32
    enum: [6, 9, 12]

  '#clock-cells':
    const: 0

required:
  - compatible
  - reg
  - clocks
  - clock-names
  - vcm-supply

additionalProperties: false

examples:
  - |
    spi {
      #address-cells = <1>;
      #size-cells = <0>;
      admv1013@0{
        compatible = "adi,admv1013";
        reg = <0>;
        spi-max-frequency = <1000000>;
        clocks = <&admv1013_lo>;
        clock-names = "lo_in";
        vcm-supply = <&vcm>;
        adi,quad-se-mode = <12>;
        adi,mixer-if-enable;
        adi,detector-enable;
      };
    };
...
```

## Documentation/devicetree/bindings/iio/frequency/adi,admv1014.yaml
```yaml
# SPDX-License-Identifier: (GPL-2.0-only OR BSD-2-Clause)
%YAML 1.2
---
$id: http://devicetree.org/schemas/iio/frequency/adi,admv1014.yaml#
$schema: http://devicetree.org/meta-schemas/core.yaml#

title: ADMV1014 Microwave Downconverter

maintainers:
  - Antoniu Miclaus <antoniu.miclaus@analog.com>

description: |
   Wideband, microwave downconverter optimized for point to point microwave
   radio designs operating in the 24 GHz to 44 GHz frequency range.

   https://www.analog.com/en/products/admv1014.html

properties:
  compatible:
    enum:
      - adi,admv1014

  reg:
    maxItems: 1

  spi-max-frequency:
    maximum: 1000000

  clocks:
    description:
      Definition of the external clock.
    minItems: 1

  clock-names:
    items:
      - const: lo_in

  vcm-supply:
    description:
      Analog voltage regulator.

  adi,input-mode:
    description:
      Select the input mode.
      iq - in-phase quadrature (I/Q) input
      if - complex intermediate frequency (IF) input
    enum: [iq, if]

  adi,detector-enable:
    description:
      Digital Rx Detector Enable. The Square Law Detector output is
      available at output pin VDET.
    type: boolean

  adi,p1db-comp-enable:
    description:
      Turn on bits to optimize P1dB.
    type: boolean

  adi,quad-se-mode:
    description:
      Switch the LO path from differential to single-ended operation.
      se-neg - Single-Ended Mode, Negative Side Disabled.
      se-pos - Single-Ended Mode, Positive Side Disabled.
      diff - Differential Mode.
    enum: [se-neg, se-pos, diff]

  '#clock-cells':
    const: 0

required:
  - compatible
  - reg
  - clocks
  - clock-names
  - vcm-supply

additionalProperties: false

examples:
  - |
    spi {
      #address-cells = <1>;
      #size-cells = <0>;
      admv1014@0{
        compatible = "adi,admv1014";
        reg = <0>;
        spi-max-frequency = <1000000>;
        clocks = <&admv1014_lo>;
        clock-names = "lo_in";
        vcm-supply = <&vcm>;
        adi,quad-se-mode = "diff";
        adi,detector-enable;
        adi,p1db-comp-enable;
      };
    };
...
```

## Documentation/devicetree/bindings/iio/frequency/adi,adrf6780.yaml
```yaml
# SPDX-License-Identifier: (GPL-2.0-only OR BSD-2-Clause)
%YAML 1.2
---
$id: http://devicetree.org/schemas/iio/frequency/adi,adrf6780.yaml#
$schema: http://devicetree.org/meta-schemas/core.yaml#

title: ADRF6780 Microwave Upconverter

maintainers:
  - Antoniu Miclaus <antoniu.miclaus@analog.com>

description: |
   Wideband, microwave upconverter optimized for point to point microwave
   radio designs operating in the 5.9 GHz to 23.6 GHz frequency range.

   https://www.analog.com/en/products/adrf6780.html

properties:
  compatible:
    enum:
      - adi,adrf6780

  reg:
    maxItems: 1

  spi-max-frequency:
    maximum: 1000000

  clocks:
    description:
      Definition of the external clock.
    minItems: 1

  clock-names:
    items:
      - const: lo_in

  clock-output-names:
    maxItems: 1

  adi,vga-buff-en:
    description:
      VGA Buffer Enable.
    type: boolean

  adi,lo-buff-en:
    description:
      LO Buffer Enable.
    type: boolean

  adi,if-mode-en:
    description:
      IF Mode Enable.
    type: boolean

  adi,iq-mode-en:
    description:
      IQ Mode Enable.
    type: boolean

  adi,lo-x2-en:
    description:
      LO x2 Enable.
    type: boolean

  adi,lo-ppf-en:
    description:
      LO x1 Enable.
    type: boolean

  adi,lo-en:
    description:
      LO Enable.
    type: boolean

  adi,uc-bias-en:
    description:
      UC Bias Enable.
    type: boolean

  adi,lo-sideband:
    description:
      Switch to the Other LO Sideband.
    type: boolean

  adi,vdet-out-en:
    description:
      VDET Output Select Enable.
    type: boolean

  '#clock-cells':
    const: 0

dependencies:
  adi,lo-x2-en: [ "adi,lo-en" ]
  adi,lo-ppf-en: [ "adi,lo-en" ]

required:
  - compatible
  - reg
  - clocks
  - clock-names

additionalProperties: false

examples:
  - |
    spi {
      #address-cells = <1>;
      #size-cells = <0>;
      adrf6780@0 {
        compatible = "adi,adrf6780";
        reg = <0>;
        spi-max-frequency = <1000000>;
        clocks = <&adrf6780_lo>;
        clock-names = "lo_in";
      };
    };
...
```

## Documentation/devicetree/bindings/iio/imu/bosch,bno055-serial.yaml
```yaml
# SPDX-License-Identifier: (GPL-2.0-only OR BSD-2-Clause)
%YAML 1.2
---
$id: http://devicetree.org/schemas/iio/imu/bosch,bno055-serial.yaml#
$schema: http://devicetree.org/meta-schemas/core.yaml#

title: Serial-attached Bosch BNO055

maintainers:
  - Jonathan Cameron <jic23@kernel.org>

description: |
  Inertial Measurement Unit with Accelerometer, Gyroscope, Magnetometer and
  internal MCU for sensor fusion
  https://www.bosch-sensortec.com/products/smart-sensors/bno055/

properties:
  compatible:
    enum:
     - bosch,bno055-serial

  reset-gpios:
    maxItems: 1

  clocks:
    maxItems: 1

required:
  - compatible

additionalProperties: false

examples:
 - |
   #include <dt-bindings/gpio/gpio.h>
   bno055 {
      compatible = "bosch,bno055-serial";
      reset-gpios = <&gpio0 54 GPIO_ACTIVE_LOW>;
      clocks = <&imu_clk>;
   };
```

## Documentation/devicetree/bindings/iio/temperature/ti,tmp117.yaml
```yaml
# SPDX-License-Identifier: GPL-2.0
%YAML 1.2
---
$id: "http://devicetree.org/schemas/iio/temperature/ti,tmp117.yaml#"
$schema: "http://devicetree.org/meta-schemas/core.yaml#"
description: |
    TI TMP117 - Digital temperature sensor with integrated NV memory that supports
    I2C interface.
      https://www.ti.com/lit/gpn/tmp1
examples: |
    tmp117@48 {
        compatible = "ti,tmp117";
        reg = <0x48>;
    };
maintainers: 
  - "Puranjay Mohan <puranjay12@gmail.com>"
properties: 
  compatible: 
    enum: 
      - "ti,tmp117"
  reg: 
    maxItems: 1
required: 
  - compatible
  - reg
title: "TI TMP117 - Digital temperature sensor with integrated NV memory"
```
