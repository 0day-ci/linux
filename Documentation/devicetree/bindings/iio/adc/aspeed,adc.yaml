## Documentation/devicetree/bindings/iio/adc/aspeed,adc.yaml
```yaml
# SPDX-License-Identifier: (GPL-2.0 OR BSD-2-Clause)
%YAML 1.2
---
$id: http://devicetree.org/schemas/iio/adc/aspeed,adc.yaml#
$schema: http://devicetree.org/meta-schemas/core.yaml#

title: ADC that forms part of an ASPEED server management processor.

maintainers:
  - Joel Stanley <joel@jms.id.au>

description:
  • 10-bits resolution for 16 voltage channels.
  At ast2400/ast2500 the device has only one engine with 16 voltage channels.
  At ast2600 the device split into two individual engine and each contains 8 voltage channels.
  • Channel scanning can be non-continuous.
  • Programmable ADC clock frequency.
  • Programmable upper and lower bound for each channels.
  • Interrupt when larger or less than bounds for each channels.
  • Support hysteresis for each channels.
  • Buildin a compensating method.
  Additional feature at ast2600
  • Internal or External reference voltage.
  • Support 2 Internal reference voltage 1.2v or 2.5v.
  • Integrate dividing circuit for battery sensing.

properties:
  compatible:
    enum:
      - aspeed,ast2400-adc
      - aspeed,ast2500-adc
      - aspeed,ast2600-adc

  reg:
    maxItems: 1

  clocks:
    maxItems: 1
    description:
      Input clock used to derive the sample clock. Expected to be the
      SoC's APB clock.

  resets:
    maxItems: 1

  "#io-channel-cells":
    const: 1

  vref:
    minItems: 900
    maxItems: 2700
    default: 2500
    description:
      ADC Reference voltage in millivolts.

  battery-sensing:
    type: boolean
    description:
      Inform the driver that last channel will be used to sensor battery.

required:
  - compatible
  - reg
  - clocks
  - resets
  - "#io-channel-cells"

additionalProperties: false

examples:
  - |
    #include <dt-bindings/clock/aspeed-clock.h>
    adc@1e6e9000 {
        compatible = "aspeed,ast2400-adc";
        reg = <0x1e6e9000 0xb0>;
        clocks = <&syscon ASPEED_CLK_APB>;
        resets = <&syscon ASPEED_RESET_ADC>;
        #io-channel-cells = <1>;
    };
...
```

## Documentation/devicetree/bindings/iio/adc/ti,ads1018.yaml
```yaml
# SPDX-License-Identifier: (GPL-2.0 OR BSD-2-Clause)
%YAML 1.2
---
$id: http://devicetree.org/schemas/iio/adc/ti,ads1018.yaml#
$schema: http://devicetree.org/meta-schemas/core.yaml#

title: TI ADS1018 4 channel I2C analog to digital converter

maintainers:
  - Iain Hunter <iain@hunterembedded.co.uk>

description: |
  Datasheet at: https://www.ti.com/lit/gpn/ads1018
  Supports both single ended and differential channels.

properties:
  compatible:
    const: ti,ads1018

  reg:
    maxItems: 1

  "#address-cells":
    const: 1

  "#size-cells":
    const: 0

  "#io-channel-cells":
    const: 1

  spi-max-frequency: true
  spi-cpol: true
  spi-cpha: true

required:
  - compatible
  - reg
  - "#address-cells"
  - "#size-cells"
  - spi-cpha

additionalProperties: false

patternProperties:
  "^channel@([0-3])$":
    $ref: "adc.yaml"
    type: object

    properties:
      reg:
        description: |
            Must be 0, actual channel selected in ti,adc-channels for single ended
            or ti-adc-channels-diff for differential
        $ref: /schemas/types.yaml#/definitions/uint32
        enum: [0]

      ti,adc-channels:
        description: |
          List of single-ended channels muxed for this ADC. It can have up to 4
          channels numbered 0-3
        $ref: /schemas/types.yaml#/definitions/uint32-array
        deprecated: true

      ti,adc-diff-channels:
        description: |
          List of differential channels muxed for this ADC between the pins vinp
          and vinn. The 4 possible options are:
          vinp=0, vinn=1
          vinp=0, vinn=3
          vinp=1, vinn=3
          vinp=2, vinn=3

          They are listed in a pair <vinp vinn>.

          Note: At least one of "ti,adc-channels" or "ti,adc-diff-channels" is
          required.
        $ref: /schemas/types.yaml#/definitions/uint32-matrix
        items:
          items:
            - description: |
                "vinp" indicates positive input number
              minimum: 0
              maximum: 2
            - description: |
                "vinn" indicates negative input number
              minimum: 1
              maximum: 3


    required:
      - reg

examples:
  - |
    // example on SPI1 with single ended channel 1
    spi {
        #address-cells = <1>;
        #size-cells = <0>;

        adc@1 {
            compatible = "ti,ads1018";
            reg = <0x0>;
            #address-cells = <1>;
            #size-cells = <0>;
            spi-cpha;
            ti,adc-channels = <1>;
        };
    };
  - |
    // example on SPI0 with differential between inputs 0 and 3
    spi {
        #address-cells = <1>;
        #size-cells = <0>;

        adc@0 {
            compatible = "ti,ads1018";
            reg = <0x0>;
            #address-cells = <1>;
            #size-cells = <0>;
            spi-cpha;
            ti,adc-diff-channels = <0 3>;
        };
    };

...
```

## Documentation/devicetree/bindings/iio/adc/ti,ads7142.yaml
```yaml
# SPDX-License-Identifier: (GPL-2.0-only OR BSD-2-Clause)
%YAML 1.2
---
$id: "http://devicetree.org/schemas/iio/adc/ti,ads7142.yaml#"
$schema: "http://devicetree.org/meta-schemas/core.yaml#"

title: Texas Instruments ADS7142 adc driver device tree bindings

maintainers:
  - József Horváth <info@ministro.hu>

description: |
  This document is for describing the required device tree parameters
   for ads7142 adc driver.
  The required parameters for proper operation are described below.

  Datasheet: https://www.ti.com/lit/ds/symlink/ads7142.pdf

  Operation modes supportedby the driver:
    When the 'ti,monitoring-mode' property is not present
      in the devicetree node definition, the driver initiates a single
      conversion in the device for each read request
      (/sys/bus/iio/devices/iio:deviceX/in_voltageY_raw).
      This is a one-shot conversion, and it is called
      "Manual Mode" in the datasheet.

    When the 'ti,monitoring-mode' property is present
      in the devicetree node definition, the driver configures
      the device's digital window comparator and sets the device's
      data buffer operation mode to pre alert data mode.
      The driver reads the conversion result when the BUSY/RDY interrupt
      fires, and keeps the value until the next BUSY/RDY interrupt
      or the first read request
      (/sys/bus/iio/devices/iio:deviceX/in_voltageY_raw).
      The digital window comparator and hysteresis parameters
      can be controlled by:
        - the devicetree definition of channel node
        - iio sysfs interfaces
      This is event driven conversion, and is called
      "Autonomous Mode with Pre Alert Data" in the datasheet.
      This mode can be used to wake up the system with the ALERT pin,
      in case when the monitored voltage level is out of the configured range.

properties:
  compatible:
    const: ti,ads7142

  reg:
    maxItems: 1

  interrupts:
    description: |
      The BUSY/PDY pin is used as interrupt line in autonomous monitoring mode.
    maxItems: 1

  vref-supply:
    description: Regulator for the reference voltage

  power-supply: true

  "#address-cells":
    const: 1

  "#size-cells":
    const: 0

  "#io-channel-cells":
    const: 1

  ti,osc-sel:
    description: |
      If present, the driver selects the high speed oscillator.
      See chapter 7.3.5 Oscillator and Timing Control in datasheet.
    type: boolean

  ti,n-clk:
    description: |
      nCLK is number of clocks in one conversion cycle.
      See chapter 7.3.5 Oscillator and Timing Control in datasheet.
    $ref: /schemas/types.yaml#/definitions/uint32
    maximum: 255
    minimum: 0

  ti,monitoring-mode:
    description: |
      If present, the driver selects the autonomous monitoring mode with pre alert data.
      See chapter 7.4 Device Functional Modes in datasheet.
    type: boolean

patternProperties:
  "^channel@[0-1]$":
    $ref: "adc.yaml"
    type: object
    description: |
      Represents the external channels which are connected to the ADC.
    properties:
      reg:
        description: |
          The channel number.
        items:
          minimum: 0
          maximum: 1
      "ti,threshold-falling":
        description: The low threshold for channel
        $ref: /schemas/types.yaml#/definitions/uint32
        maximum: 4095
        minimum: 0
      "ti,threshold-rising":
        description: The high threshold for channel
        $ref: /schemas/types.yaml#/definitions/uint32
        maximum: 4095
        minimum: 0
      "ti,hysteresis":
        description: The hysteresis for both comparators for channel
        $ref: /schemas/types.yaml#/definitions/uint32
        maximum: 63
        minimum: 0

    required:
      - reg

    additionalProperties: false

allOf:
  - if:
      required:
        - ti,monitoring-mode
    then:
      required:
        - interrupts

required:
  - compatible
  - "#io-channel-cells"

additionalProperties: false

examples:
  - |
    i2c {
      #address-cells = <1>;
      #size-cells = <0>;
      adc@18 {
        compatible = "ti,ads7142";
        reg = <0x18>;
        #address-cells = <1>;
        #size-cells = <0>;
        #io-channel-cells = <1>;

        vref-supply = <&vdd_3v3_reg>;
        power-supply = <&vdd_1v8_reg>;

        channel@0 {
          reg = <0>;
        };

        channel@1 {
          reg = <1>;
        };
      };
    };
  - |
    i2c {
      #address-cells = <1>;
      #size-cells = <0>;
      adc@1f {
        compatible = "ti,ads7142";
        reg = <0x1f>;
        #address-cells = <1>;
        #size-cells = <0>;

        #io-channel-cells = <1>;

        vref-supply = <&vdd_3v3_reg>;
        power-supply = <&vdd_1v8_reg>;

        interrupt-parent = <&gpio>;
        interrupts = <7 2>;

        ti,monitoring-mode;

        channel@0 {
          reg = <0>;
          ti,threshold-falling = <1000>;
          ti,threshold-rising = <2000>;
          ti,hysteresis = <20>;
        };

        channel@1 {
          reg = <1>;
          ti,threshold-falling = <100>;
          ti,threshold-rising = <2500>;
          ti,hysteresis = <0>;
        };
      };
    };
...
```

## Documentation/devicetree/bindings/iio/adc/ti,am3359-adc.yaml
```yaml
# SPDX-License-Identifier: (GPL-2.0 OR BSD-2-Clause)
%YAML 1.2
---
$id: http://devicetree.org/schemas/iio/adc/ti,am3359-adc.yaml#
$schema: http://devicetree.org/meta-schemas/core.yaml#

title: Bindings for ADC part of TSCADC MFDs on TI SoCs

maintainers:
  - Vignesh Raghavendra <vigneshr@ti.com>

properties:
  compatible:
    oneOf:
      - items:
          - enum:
              - ti,am654-adc
          - const: ti,am3359-adc
      - const: ti,am3359-adc

  ti,adc-channels:
    $ref: /schemas/types.yaml#/definitions/uint32-array
    description:
      List of analog inputs available for ADC.
      AIN0 = 0, AIN1 = 1 and so on till AIN7 = 7.
    minItems: 1
    maxItems: 8
    items:
      maximum: 7

  ti,chan-step-opendelay:
    $ref: /schemas/types.yaml#/definitions/uint32-array
    description:
      List of open delays for each channel of list of analog inputs
      available for ADC. ADC in the order of ti,adc-channels. The
      value corresponds to the number of ADC clock cycles to wait
      after applying the step configuration registers and before
      sending the start of ADC conversion.
    minItems: 1
    maxItems: 8
    items:
      maximum: 0x3FFFF

  ti,chan-step-sampledelay:
    $ref: /schemas/types.yaml#/definitions/uint32-array
    description:
      List of sample delays for each channel of ADC in the order of
      ti,adc-channels. The value corresponds to the number of
      ADC clock cycles to sample (to hold start of conversion high).
    minItems: 1
    maxItems: 8
    items:
      maximum: 0xFF

  ti,chan-step-avg:
    $ref: /schemas/types.yaml#/definitions/uint32-array
    description:
      Number of averages to be performed for each channel of ADC. If
      average is 16 then input is sampled 16 times and averaged to
      get more accurate value. This increases the time taken by ADC
      to generate a sample.
    minItems: 1
    maxItems: 8
    items:
      maximum: 16

  "#io-channel-cells":
    const: 1

required:
  - compatible
  - "#io-channel-cells"

additionalProperties: false
```

## Documentation/devicetree/bindings/iio/cdc/adi,ad7746.yaml
```yaml
# SPDX-License-Identifier: (GPL-2.0-only OR BSD-2-Clause)
%YAML 1.2
---
$id: http://devicetree.org/schemas/iio/cdc/adi,ad7746.yaml#
$schema: http://devicetree.org/meta-schemas/core.yaml#

title: AD7746 24-Bit Capacitance-to-Digital Converter with Temperature Sensor

maintainers:
  - Michael Hennerich <michael.hennerich@analog.com>

description: |
  AD7746 24-Bit Capacitance-to-Digital Converter with Temperature Sensor

  Specifications about the part can be found at:
  https://www.analog.com/media/en/technical-documentation/data-sheets/ad7291.pdf

properties:
  compatible:
    enum:
      - adi,ad7745
      - adi,ad7746
      - adi,ad7747

  reg:
    description: |
      Physiscal address of the EXC set-up register.
    maxItems: 1

  adi,excitation-voltage-level:
    description: |
      Select the reference excitation voltage level used by the device.
      With VDD being the power supply voltage, valid values are:
      0: +-VDD / 8
      1: +-VDD / 4
      2: +-VDD * 3 / 8
      3: +-VDD / 2
      If left empty option 3 is selected.
    $ref: /schemas/types.yaml#/definitions/uint32
    enum: [0, 1, 2, 3]

  adi,exca-output:
    description: |
      Sets the excitation output in the exca pin.
      Valid values are:
      0: Disables output in the EXCA pin.
      1: Enables EXCA pin as the excitation output.
      2: Enables EXCA pin as the inverted excitation output.
      If left empty the output is disabled.
    $ref: /schemas/types.yaml#/definitions/uint32
    enum: [0, 1, 2]

  adi,excb-output:
    description: |
      Analoguos to the adi,exca-output for the EXCB pin.
    $ref: /schemas/types.yaml#/definitions/uint32
    enum: [0, 1, 2]

required:
  - compatible
  - reg

additionalProperties: false

examples:
  - |
    i2c {
      #address-cells = <1>;
      #size-cells = <0>;

      ad7746: cdc@0 {
        compatible = "adi,ad7746";
        reg = <0>;
        adi,excitation-voltage-level = <3>;
        adi,exca-output = <0>;
        adi,excb-output = <0>;
      };
    };
...
```
