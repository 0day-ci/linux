## Documentation/devicetree/bindings/bus/palmbus.yaml
```yaml
# SPDX-License-Identifier: (GPL-2.0-only OR BSD-2-Clause)
%YAML 1.2
---
$id: http://devicetree.org/schemas/bus/palmbus.yaml#
$schema: http://devicetree.org/meta-schemas/core.yaml#

title: Ralink PalmBus Device Tree Bindings

maintainers:
  - Sergio Paracuellos <sergio.paracuellos@gmail.com>

description: |
  The ralink palmbus controller can be found in all ralink MIPS
  SoCs. It provides an external bus for connecting multiple
  external devices to the SoC.

properties:
  $nodename:
    pattern: "^palmbus(@[0-9a-f]+)?$"

  "#address-cells":
    const: 1

  "#size-cells":
    const: 1

  compatible:
    const: palmbus

  reg:
    maxItems: 1

  ranges: true

patternProperties:
  # All other properties should be child nodes with unit-address and 'reg'
  "^[a-zA-Z][a-zA-Z0-9,+\\-._]{0,63}@[0-9a-fA-F]+$":
    type: object
    properties:
      reg:
        maxItems: 1

    required:
      - reg

required:
  - compatible
  - reg
  - "#address-cells"
  - "#size-cells"
  - ranges

additionalProperties: false

examples:
  - |
    palmbus@1e000000 {
        compatible = "palmbus";
        reg = <0x1e000000 0x100000>;
        #address-cells = <1>;
        #size-cells = <1>;
        ranges = <0x0 0x1e000000 0x0fffff>;

        syscon@0 {
            compatible = "mediatek,mt7621-sysc", "syscon";
            reg = <0x0 0x100>;
            #clock-cells = <1>;
            #reset-cells = <1>;
            ralink,memctl = <&memc>;
            clock-output-names = "xtal", "cpu", "bus",
                                 "50m", "125m", "150m",
                                 "250m", "270m";
        };

        wdt@100 {
            compatible = "mediatek,mt7621-wdt";
            reg = <0x100 0x100>;
        };
    };

...
```

## Documentation/devicetree/bindings/bus/pci-ep-bus.yaml
```yaml
# SPDX-License-Identifier: (GPL-2.0-only OR BSD-2-Clause)
%YAML 1.2
---
$id: http://devicetree.org/schemas/bus/pci-ep-bus.yaml#
$schema: http://devicetree.org/meta-schemas/core.yaml#

title: PCIe Endpoint Bus binding

description: |
  PCIe device may use flattened device tree to describe apertures in its
  PCIe BARs. The Bus PCIe endpoint node is created and attached under the
  device tree root node for this kind of device. Then the flatten device
  tree overlay for this device is attached under the endpoint node.

  The aperture address which is under the endpoint node consists of BAR
  index and offset. It uses the following encoding:

    0xIooooooo 0xoooooooo

  Where:

    I = BAR index
    oooooo oooooooo = BAR offset

  The endpoint is compatible with 'simple-bus' and contains 'ranges'
  property for translating aperture address to CPU address.

allOf:
  - $ref: /schemas/simple-bus.yaml#

maintainers:
  - Lizhi Hou <lizhi.hou@xilinx.com>

properties:
  compatible:
    contains:
      const: pci-ep-bus

  "#address-cells":
    const: 2

  "#size-cells":
    const: 2

  ranges: true

patternProperties:
  "^.*@[0-9a-f]+$":
    description: hardware apertures belong to this device.
    type: object

required:
  - compatible
  - "#address-cells"
  - "#size-cells"
  - ranges

additionalProperties: false

examples:
  - |
    bus {
        #address-cells = <2>;
        #size-cells = <2>;
        pci-ep-bus@e0000000 {
            compatible = "pci-ep-bus", "simple-bus";
            #address-cells = <2>;
            #size-cells = <2>;
            ranges = <0x0 0x0 0x0 0xe0000000 0x0 0x2000000
                      0x20000000 0x0 0x0 0xe4200000 0x0 0x40000>;
        };
    };
```

## Documentation/devicetree/bindings/clock/amlogic,mmc-clkc.yaml
```yaml
# SPDX-License-Identifier: (GPL-2.0-only OR BSD-2-Clause)
%YAML 1.2
---
$id: http://devicetree.org/schemas/clock/amlogic,mmc-clkc.yaml#
$schema: http://devicetree.org/meta-schemas/core.yaml#

title: Amlogic MMC Sub Clock Controller Driver Device Tree Bindings

maintainers:
  - jianxin.pan@amlogic.com
  - liang.yang@amlogic.com

properties:
  compatible:
    enum:
      - "amlogic,axg-mmc-clkc", "syscon"
      - "amlogic,gx-mmc-clkc", "syscon"

  reg:
    maxItems: 1

  clocks:
    maxItems: 2

  clock-names:
    items:
      - const: "clkin0", "clkin1"

  "#clock-cells":
    const: 1

required:
  - compatible
  - reg
  - clocks
  - clock-names
  - "#clock-cells"

additionalProperties: false

examples:
  - |
    sd_mmc_c_clkc: clock-controller@7000 {
	compatible = "amlogic,axg-mmc-clkc", "syscon";
	reg = <0x0 0x7000 0x0 0x4>;
	#clock-cells = <1>;

	clock-names = "clkin0", "clkin1";
	clocks = <&clkc CLKID_SD_MMC_C_CLK0>,
		 <&clkc CLKID_FCLK_DIV2>;
     };

  - |
    sd_emmc_b_clkc: clock-controller@5000 {
	compatible = "amlogic,axg-mmc-clkc", "syscon";
	reg = <0x0 0x5000 0x0 0x4>;

	#clock-cells = <1>;
	clock-names = "clkin0", "clkin1";
	clocks = <&clkc CLKID_SD_EMMC_B_CLK0>,
		 <&clkc CLKID_FCLK_DIV2>;
    };

...
```

## Documentation/devicetree/bindings/clock/apple,cluster-clk.yaml
```yaml
# SPDX-License-Identifier: (GPL-2.0-only OR BSD-2-Clause)
%YAML 1.2
---
$id: http://devicetree.org/schemas/clock/apple,cluster-clk.yaml#
$schema: http://devicetree.org/meta-schemas/core.yaml#

title: CPU cluster frequency scaling for Apple SoCs

maintainers:
  - Hector Martin <marcan@marcan.st>

description: |
  Apple SoCs control CPU cluster frequencies by using a performance state
  index. This node represents the feature as a clock controller, and uses
  a reference to the CPU OPP table to translate clock frequencies into
  performance states. This allows the CPUs to use the standard cpufreq-dt
  mechanism for frequency scaling.

properties:
  compatible:
    items:
      - enum:
          - apple,t8103-cluster-clk
      - const: apple,cluster-clk

  reg:
    maxItems: 1

  '#clock-cells':
    const: 0

  operating-points-v2:
    $ref: /schemas/types.yaml#/definitions/phandle-array
    description:
      A reference to the OPP table used for the CPU cluster controlled by this
      device instance. The table should contain an `opp-level` property for
      every OPP, which represents the p-state index used by the hardware to
      represent this performance level.

      OPPs may also have a `required-opps` property (see power-domains).

  power-domains:
    maxItems: 1
    description:
      An optional reference to a power domain provider that links its
      performance state to the CPU cluster performance state. This is typically
      a memory controller. If set, the `required-opps` property in the CPU
      frequency OPP nodes will be used to change the performance state of this
      provider state in tandem with CPU frequency changes.

required:
  - compatible
  - reg
  - '#clock-cells'
  - operating-points-v2

additionalProperties: false


examples:
  - |
    pcluster_opp: opp-table-1 {
        compatible = "operating-points-v2";
        opp-shared;

        opp01 {
            opp-hz = /bits/ 64 <600000000>;
            opp-microvolt = <781000>;
            opp-level = <1>;
            clock-latency-ns = <8000>;
            required-opps = <&mcc_lowperf>;
        };
        /* intermediate p-states omitted */
        opp15 {
            opp-hz = /bits/ 64 <3204000000>;
            opp-microvolt = <1081000>;
            opp-level = <15>;
            clock-latency-ns = <56000>;
            required-opps = <&mcc_highperf>;
        };
    };

    mcc_opp: opp-table-2 {
        compatible = "operating-points-v2";

        mcc_lowperf: opp0 {
            opp-level = <0>;
            apple,memory-perf-config = <0x813057f 0x1800180>;
        };
        mcc_highperf: opp1 {
            opp-level = <1>;
            apple,memory-perf-config = <0x133 0x55555340>;
        };
    };

    soc {
        #address-cells = <2>;
        #size-cells = <2>;

        mcc: memory-controller@200200000 {
            compatible = "apple,t8103-mcc", "apple,mcc";
            #power-domain-cells = <0>;
            reg = <0x2 0x200000 0x0 0x200000>;
            operating-points-v2 = <&mcc_opp>;
            apple,num-channels = <8>;
        };

        clk_pcluster: clock-controller@211e20000 {
            compatible = "apple,t8103-cluster-clk", "apple,cluster-clk";
            #clock-cells = <0>;
            reg = <0x2 0x11e20000 0x0 0x4000>;
            operating-points-v2 = <&pcluster_opp>;
            power-domains = <&mcc>;
        };
    };
```

## Documentation/devicetree/bindings/clock/apple,gate-clock.yaml
```yaml
# SPDX-License-Identifier: GPL-2.0-only OR BSD-2-Clause
%YAML 1.2
---
$id: http://devicetree.org/schemas/clock/apple,gate-clock.yaml#
$schema: http://devicetree.org/meta-schemas/core.yaml#

title: Binding for Apple clock gates

maintainers:
  - Sven Peter <sven@svenpeter.dev>

description: |
  Apple SoC's such as the M1 contain various clock gates.
  These clock gates do not have a frequency associated with them and are only
  used to power on/off various peripherals. Generally, a clock gate needs to
  be enabled before the respective MMIO region can be accessed.

  Each clock gate is configured by a single 32bit MMIO register which contains
  the actual and the target state. The state is encoded as four bits but
  right now only "powered on" / 0b1111 and "powered off" / 0b0000 are used.


properties:
  compatible:
    enum:
      - apple,t8103-gate-clock
      - apple,gate-clock

  "#clock-cells":
    const: 0

  reg:
    maxItems: 1

  clocks:
    maxItems: 1

  clock-names:
    maxItems: 1

  clock-output-names:
    maxItems: 1

required:
  - compatible
  - reg
  - clock-output-names
  - "#clock-cells"

additionalProperties: false

examples:
  - |
    clock@3b7001c0 {
      compatible = "apple,t8103-gate-clock";
      reg = <0x3b7001c0 0x4>;
      #clock-cells = <0>;
      clock-output-names = "sio_busif_clk";
    };
...
```

## Documentation/devicetree/bindings/clock/armada3700-uart-clock.txt
```
* Marvell Armada 3720 UART clocks

Required properties:
- compatible: "marvell,armada-3700-uart-clock"
- reg: two 4-bytes registers: UART Clock Control and UART 2 Baud Rate Divisor
- #clock-cells : from common clock binding; shall be set to 1
- clocks: List of parent clocks suitable for UART from following set:
		"TBG-A-P", "TBG-B-P", "TBG-A-S", "TBG-B-S", "xtal"
	UART clock can use one from this set and when more are provided
	then kernel would choose and configure the most suitable one.
	It is suggest to specify at least one TBG clock to achieve
	baudrates above 230400 and also to specify clock which bootloader
	used for UART (most probably xtal) for smooth boot log on UART.

Example:
	uartclk: uartclk@12000 {
		compatible = "marvell,armada-3700-uart-clock";
		reg = <0x12010 0x4>, <0x12210 0x4>;
		clocks = <&tbg 0>, <&tbg 1>, <&tbg 2>,
			<&tbg 3>, <&xtalclk>;
		clock-names = "TBG-A-P", "TBG-B-P", "TBG-A-S",
			"TBG-B-S", "xtal";
		#clock-cells = <1>;
	};
```

## Documentation/devicetree/bindings/clock/exynos850-clock.yaml
```yaml
# SPDX-License-Identifier: (GPL-2.0-only OR BSD-2-Clause)
%YAML 1.2
---
$id: http://devicetree.org/schemas/clock/exynos850-clock.yaml#
$schema: http://devicetree.org/meta-schemas/core.yaml#

title: Clock bindings for Samsung Exynos850 clock controller

maintainers:
  - Sam Protsenko <semen.protsenko@linaro.org>

description: |
  The Exynos850 clock controller generates and supplies clock to various
  controllers within the SoC. Each clock is assigned an identifier and client
  nodes can use this identifier to specify the clock which they consume.

  All available clocks are defined as preprocessor macros in
  dt-bindings/clock/exynos850.h header and can be used in device tree sources.

properties:
  compatible:
    const: samsung,exynos850-clock

  reg:
    maxItems: 1

  '#clock-cells':
    const: 1

required:
  - compatible
  - reg
  - '#clock-cells'

additionalProperties: false

examples:
  # Clock controller node
  - |
    clock: clock-controller@0x120e0000 {
        compatible = "samsung,exynos850-clock";
        reg = <0x0 0x120e0000 0x8000>;
        #clock-cells = <1>;
    };

  # Required external clocks (should be provided in particular board DTS)
  - |
    fixed-rate-clocks {
        oscclk {
            compatible = "samsung,exynos850-oscclk";
            clock-frequency = <26000000>;
        };
    };

  # UART controller node that consumes the clock generated by the clock
  # controller
  - |
    #include <dt-bindings/clock/exynos850.h>

    serial_0: uart@13820000 {
        compatible = "samsung,exynos850-uart";
        reg = <0x0 0x13820000 0x100>;
        interrupts = <GIC_SPI INTREQ__UART IRQ_TYPE_LEVEL_HIGH>;
        pinctrl-names = "default";
        pinctrl-0 = <&uart0_bus>;
        clocks = <&clock GATE_UART_QCH>, <&clock DOUT_UART>;
        clock-names = "gate_uart_clk0", "uart";
    };

...
```
