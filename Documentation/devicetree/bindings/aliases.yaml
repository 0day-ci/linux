## Documentation/devicetree/bindings/aliases.yaml
```yaml
# SPDX-License-Identifier: (GPL-2.0-only OR BSD-2-Clause)
%YAML 1.2
---
$id: http://devicetree.org/schemas/aliases.yaml#
$schema: http://devicetree.org/meta-schemas/core.yaml#

title: '/aliases' node properties

maintainers:
  - Rob Herring <robh@kernel.org>

description: |
  This schema defines the list of known alias names.

properties:
  $nodename:
    const: aliases

patternProperties:
  '^ethernet[0-9]+$': true
  '^i2c[0-9]+$': true
  '^mmc[0-9]+$': true
  '^serial[0-9]+$': true
  '^spi[0-9]+$': true
  '^rtc[0-9]+$': true
  '^watchdog[0-9]+$': true
  '^usb[0-9]+$': true

  # Deprecated aliases in use. Don't add to this list.
  '^display[0-9]+$':
    deprecated: true

  '^dmc[0-9]+$':
    deprecated: true

  '^fimc[0-9]+$':
    deprecated: true

  '^fimc-lite[0-9]+$':
    deprecated: true

  '^fiu[0-9]+$':
    deprecated: true

  '^gpio[0-9]+$':
    deprecated: true

  '^gsc[0-9]+$':
    deprecated: true

  '^hsuart[0-9]+$':
    deprecated: true

  '^ipu[0-9]+$':
    deprecated: true

  '^mdio-gpio[0-9]+$':
    deprecated: true

  '^mshc[0-9]+$':
    deprecated: true

  '^mu[0-9]+$':
    deprecated: true

  '^phy[0-9]+$':
    deprecated: true

  '^pinctrl[0-9]+$':
    deprecated: true

  '^rproc[0-9]+$':
    deprecated: true

  '^sai[0-9]+$':
    deprecated: true

  '^saif[0-9]+$':
    deprecated: true

  '^ssc[0-9]+$':
    deprecated: true

  '^stmpe-i2c[0-9]+$':
    deprecated: true

  '^timer[0-9]+$':
    deprecated: true

  '^tmuctrl[0-9]+$':
    deprecated: true

  '^usbdrdphy[0-9]+$':
    deprecated: true

  '^usbphy[0-9]+$':
    deprecated: true

additionalProperties: false

...
```

## Documentation/devicetree/bindings/arm/cpu-enable-method/hpe,gxp-cpu-init.yaml
```yaml
# SPDX-License-Identifier: (GPL-2.0-only OR BSD-2-Clause)
%YAML 1.2
---
$id: http://devicetree.org/schemas/arm/cpu-enable-method/hpe,gxp-cpu-init.yaml#
$schema: http://devicetree.org/meta-schemas/core.yaml#

title: Initialize GXP CPU

maintainers:
  - Nick Hawkins <nick.hawkins@hpe.com>
  - Jean-Marie Verdun <verdun@hpe.com>

properties:
  compatible:
    const: hpe,gxp-cpu-init

  reg:
    maxItems: 1

required:
  - compatible
  - reg

additionalProperties: false

examples:
  - |
    gxp-init@cefe0010 {
      compatible = "hpe,gxp-cpu-init";
      reg = <0xcefe0010 0x04>;
    };
```

## Documentation/devicetree/bindings/arm/econet.yaml
```yaml
# SPDX-License-Identifier: (GPL-2.0-only OR BSD-2-Clause)
%YAML 1.2
---
$id: http://devicetree.org/schemas/arm/econet.yaml#
$schema: http://devicetree.org/meta-schemas/core.yaml#

title: EcoNet SoC based Platforms Device Tree Bindings

maintainers:
  - Felix Fietkau <nbd@nbd.name>
  - John Crispin <john@phrozen.org>
description: |
  Boards with an EcoNet SoC shall have the following properties.

properties:
  $nodename:
    const: '/'
  compatible:
    oneOf:
      - items:
          - enum:
              - econet,en7523-evb
          - const: econet,en7523

additionalProperties: true

...
```

## Documentation/devicetree/bindings/arm/engleder.yaml
```yaml
# SPDX-License-Identifier: (GPL-2.0-only OR BSD-2-Clause)
%YAML 1.2
---
$id: http://devicetree.org/schemas/arm/engleder.yaml#
$schema: http://devicetree.org/meta-schemas/core.yaml#

title: Engleder TSN endpoint Ethernet MAC bindings

maintainers:
  - Gerhard Engleder <gerhard@engleder-embedded.com>

properties:
  $nodename:
    const: "/"
  compatible:
    items:
      - enum:
          - engleder,zynqmp-tsnep

additionalProperties: true

...
```

## Documentation/devicetree/bindings/arm/firmware/linaro,optee-tz.yaml
```yaml
# SPDX-License-Identifier: (GPL-2.0 OR BSD-2-Clause)
%YAML 1.2
---
$id: http://devicetree.org/schemas/arm/firmware/linaro,optee-tz.yaml#
$schema: http://devicetree.org/meta-schemas/core.yaml#

title: OP-TEE Device Tree Bindings

maintainers:
  - Jens Wiklander <jens.wiklander@linaro.org>

description: |
  OP-TEE is a piece of software using hardware features to provide a Trusted
  Execution Environment. The security can be provided with ARM TrustZone, but
  also by virtualization or a separate chip.

properties:
  $nodename:
    const: optee
  compatible:
      oneOf:
        - description:
            We're using "linaro" as the first part of the compatible property
            for the reference implementation maintained by Linaro.
          const: linaro,optee-tz

  method:
    description: The method of calling the OP-TEE Trusted OS.
    $ref: /schemas/types.yaml#/definitions/string-array
    oneOf:
      - description: |
          SMC #0, with the register assignments specified in
          in drivers/tee/optee/optee_smc.h
        const: smc
      - description: |
          HVC #0, with the register assignments specified in
          in drivers/tee/optee/optee_smc.h
        const: hvc

additionalProperties: false

examples:
  - |
    firmware {
      optee {
        compatible = "linaro,optee-tz";
        method = "smc";
      };
    };
```

## Documentation/devicetree/bindings/arm/gxp.yaml
```yaml
# SPDX-License-Identifier: (GPL-2.0-only OR BSD-2-Clause)
%YAML 1.2
---
$id: http://devicetree.org/schemas/arm/gxp.yaml#
$schema: http://devicetree.org/meta-schemas/core.yaml#

title: HPE bmc GXP SoC driver

maintainers:
  - Nick Hawkins <nick.hawkins@hpe.com>
  - Jean-Marie Verdun <verdun@hpe.com>

properties:
  compatible:
    const: hpe,gxp

  "#address-cells":
    const: 1

required:
  - compatible

additionalProperties: true

examples:
  - |
      / {
          model = "Hewlett Packard Enterprise GXP BMC";
          compatible = "hpe,gxp";
          #address-cells = <1>;
          #size-cells = <1>;
          cpus {
              #address-cells = <1>;
              #size-cells = <0>;

              CPU0: cpu@0 {
                  compatible = "arm,cortex-a9";
                  device_type = "cpu";
                  reg = <0>;
              };
          };

          memory@40000000 {
            device_type = "memory";
            reg = <0x40000000 0x20000000>;
          };

          ahb {

          };
      };

...
```

## Documentation/devicetree/bindings/arm/mediatek/mediatek,mt8186-clock.yaml
```yaml
# SPDX-License-Identifier: (GPL-2.0 OR BSD-2-Clause)
%YAML 1.2
---
$id: "http://devicetree.org/schemas/arm/mediatek/mediatek,mt8186-clock.yaml#"
$schema: "http://devicetree.org/meta-schemas/core.yaml#"

title: Mediatek Functional Clock Controller for MT8186

maintainers:
  - Chun-Jie Chen <chun-jie.chen@mediatek.com>

description:
  The clock architecture in Mediatek like below
  PLLs -->
          dividers -->
                      muxes
                           -->
                              clock gate

  The devices provide clock gate control in different IP blocks.

properties:
  compatible:
    items:
      - enum:
          - mediatek,mt8186-imp_iic_wrap
          - mediatek,mt8186-mfgsys
          - mediatek,mt8186-wpesys
          - mediatek,mt8186-imgsys1
          - mediatek,mt8186-imgsys2
          - mediatek,mt8186-vdecsys
          - mediatek,mt8186-vencsys
          - mediatek,mt8186-camsys
          - mediatek,mt8186-camsys_rawa
          - mediatek,mt8186-camsys_rawb
          - mediatek,mt8186-mdpsys
          - mediatek,mt8186-ipesys
  reg:
    maxItems: 1

  '#clock-cells':
    const: 1

required:
  - compatible
  - reg

additionalProperties: false

examples:
  - |
    imp_iic_wrap: clock-controller@11017000 {
        compatible = "mediatek,mt8186-imp_iic_wrap";
        reg = <0x11017000 0x1000>;
        #clock-cells = <1>;
    };

  - |
    mfgsys: clock-controller@13000000 {
        compatible = "mediatek,mt8186-mfgsys";
        reg = <0x13000000 0x1000>;
        #clock-cells = <1>;
    };

  - |
    wpesys: clock-controller@14020000 {
        compatible = "mediatek,mt8186-wpesys";
        reg = <0x14020000 0x1000>;
        #clock-cells = <1>;
    };

  - |
    imgsys1: clock-controller@15020000 {
        compatible = "mediatek,mt8186-imgsys1";
        reg = <0x15020000 0x1000>;
        #clock-cells = <1>;
    };

  - |
    imgsys2: clock-controller@15820000 {
        compatible = "mediatek,mt8186-imgsys2";
        reg = <0x15820000 0x1000>;
        #clock-cells = <1>;
    };

  - |
    vdecsys: clock-controller@1602f000 {
        compatible = "mediatek,mt8186-vdecsys";
        reg = <0x1602f000 0x1000>;
        #clock-cells = <1>;
    };

  - |
    vencsys: clock-controller@17000000 {
        compatible = "mediatek,mt8186-vencsys";
        reg = <0x17000000 0x1000>;
        #clock-cells = <1>;
    };

  - |
    camsys: clock-controller@1a000000 {
        compatible = "mediatek,mt8186-camsys";
        reg = <0x1a000000 0x1000>;
        #clock-cells = <1>;
    };

  - |
    camsys_rawa: clock-controller@1a04f000 {
        compatible = "mediatek,mt8186-camsys_rawa";
        reg = <0x1a04f000 0x1000>;
        #clock-cells = <1>;
    };

  - |
    camsys_rawb: clock-controller@1a06f000 {
        compatible = "mediatek,mt8186-camsys_rawb";
        reg = <0x1a06f000 0x1000>;
        #clock-cells = <1>;
    };

  - |
    mdpsys: clock-controller@1b000000 {
        compatible = "mediatek,mt8186-mdpsys";
        reg = <0x1b000000 0x1000>;
        #clock-cells = <1>;
    };

  - |
    ipesys: clock-controller@1c000000 {
        compatible = "mediatek,mt8186-ipesys";
        reg = <0x1c000000 0x1000>;
        #clock-cells = <1>;
    };
```

## Documentation/devicetree/bindings/arm/mediatek/mediatek,mt8186-sys-clock.yaml
```yaml
# SPDX-License-Identifier: (GPL-2.0 OR BSD-2-Clause)
%YAML 1.2
---
$id: "http://devicetree.org/schemas/arm/mediatek/mediatek,mt8186-sys-clock.yaml#"
$schema: "http://devicetree.org/meta-schemas/core.yaml#"

title: Mediatek System Clock Controller for MT8186

maintainers:
  - Chun-Jie Chen <chun-jie.chen@mediatek.com>

description:
  The clock architecture in Mediatek like below
  PLLs -->
          dividers -->
                      muxes
                           -->
                              clock gate

  The apmixedsys provides most of PLLs which generated from SoC 26m.
  The topckgen provides dividers and muxes which provide the clock source to other IP blocks.
  The infracfg_ao provides clock gate in peripheral and infrastructure IP blocks.
  The mcusys provides mux control to select the clock source in AP MCU.

properties:
  compatible:
    items:
      - enum:
          - mediatek,mt8186-mcusys
          - mediatek,mt8186-topckgen
          - mediatek,mt8186-infracfg_ao
          - mediatek,mt8186-apmixedsys
      - const: syscon

  reg:
    maxItems: 1

  '#clock-cells':
    const: 1

required:
  - compatible
  - reg

additionalProperties: false

examples:
  - |
    mcusys: syscon@c53a000 {
        compatible = "mediatek,mt8186-mcusys", "syscon";
        reg = <0xc53a000 0x1000>;
        #clock-cells = <1>;
    };

  - |
    topckgen: syscon@10000000 {
        compatible = "mediatek,mt8186-topckgen", "syscon";
        reg = <0x10000000 0x1000>;
        #clock-cells = <1>;
    };

  - |
    infracfg_ao: syscon@10001000 {
        compatible = "mediatek,mt8186-infracfg_ao", "syscon";
        reg = <0x10001000 0x1000>;
        #clock-cells = <1>;
    };

  - |
    apmixedsys: syscon@1000c000 {
        compatible = "mediatek,mt8186-apmixedsys", "syscon";
        reg = <0x1000c000 0x1000>;
        #clock-cells = <1>;
    };
```

## Documentation/devicetree/bindings/arm/msm/qcom,dcc.yaml
```yaml
# SPDX-License-Identifier: (GPL-2.0-or-later OR BSD-2-Clause)
%YAML 1.2
---
$id: http://devicetree.org/schemas/arm/msm/qcom,dcc.yaml#
$schema: http://devicetree.org/meta-schemas/core.yaml#

title: Data Capture and Compare

maintainers:
  - Souradeep Chowdhury <schowdhu@codeaurora.org>

description: |
    DCC (Data Capture and Compare) is a DMA engine which is used to save
    configuration data or system memory contents during catastrophic failure
    or SW trigger.DCC is used to capture and store data for debugging purpose


properties:
  compatible:
    items:
      - enum:
          - qcom,sm8150-dcc
      - const: qcom,dcc

  reg:
    items:
      - description: DCC base register region
      - description: DCC RAM base register region

  reg-names:
    items:
      - const: dcc
      - const: dcc-ram

required:
  - compatible
  - reg
  - reg-names

additionalProperties: false

examples:
  - |
    dcc@10a2000{
                compatible = "qcom,sm8150-dcc","qcom,dcc";
                reg = <0x010a2000  0x1000>,
                      <0x010ad000  0x2000>;
                reg-names = "dcc", "dcc-ram";
    };
```

## Documentation/devicetree/bindings/arm/msm/qcom,dload-mode.yaml
```yaml
# SPDX-License-Identifier: (GPL-2.0 OR BSD-2-Clause)
%YAML 1.2
---
$id: http://devicetree.org/schemas/arm/msm/qcom,dload-mode.yaml#
$schema: http://devicetree.org/meta-schemas/core.yaml#

title: Qualcomm Download Mode binding

maintainers:
  - Sai Prakash Ranjan <saiprakash.ranjan@codeaurora.org>

description:
  Qualcomm download mode cookies memory region in IMEM is used by SDI
  (System Debug Image) firmware to determine whether to enter download
  mode or not to collect ramdump for post mortem debug.

properties:
  compatible:
    const: qcom,dload-mode

  reg:
    maxItems: 1

  qcom,sdi-disable-regs:
    $ref: /schemas/types.yaml#/definitions/phandle-array
    description:
      Phandle reference to a syscon representing TCSR followed by the
      offset and length for SDI disable register.

required:
  - compatible
  - reg

additionalProperties: false

examples:
  - |
    imem@146aa000 {
      compatible = "simple-mfd";
      reg = <0x146aa000 0x2000>;

      #address-cells = <1>;
      #size-cells = <1>;

      ranges = <0 0x146aa000 0x2000>;

      dload-mode@1c00 {
        compatible = "qcom,dload-mode";
        reg = <0x1c00 0x1000>;
        qcom,sdi-disable-regs = <&tcsr_regs 0x3a000 0x4>;
      };
    };
...
```
