## Documentation/devicetree/bindings/arm/msm/qcom,idle-state.yaml
```yaml
# SPDX-License-Identifier: (GPL-2.0-only OR BSD-2-Clause)
%YAML 1.2
---
$id: http://devicetree.org/schemas/arm/msm/qcom,idle-state.yaml#
$schema: http://devicetree.org/meta-schemas/core.yaml#

title: QCOM Idle States binding description

maintainers:
  - Bjorn Andersson <bjorn.andersson@linaro.org>

description: |
  ARM provides idle-state node to define the cpuidle states, as defined in [1].
  cpuidle-qcom is the cpuidle driver for Qualcomm SoCs and uses these idle
  states. Idle states have different enter/exit latency and residency values.
  The idle states supported by the QCOM SoC are defined as -

    * Standby
    * Retention
    * Standalone Power Collapse (Standalone PC or SPC)
    * Power Collapse (PC)

  Standby: Standby does a little more in addition to architectural clock gating.
  When the WFI instruction is executed the ARM core would gate its internal
  clocks. In addition to gating the clocks, QCOM cpus use this instruction as a
  trigger to execute the SPM state machine. The SPM state machine waits for the
  interrupt to trigger the core back in to active. This triggers the cache
  hierarchy to enter standby states, when all cpus are idle. An interrupt brings
  the SPM state machine out of its wait, the next step is to ensure that the
  cache hierarchy is also out of standby, and then the cpu is allowed to resume
  execution. This state is defined as a generic ARM WFI state by the ARM cpuidle
  driver and is not defined in the DT. The SPM state machine should be
  configured to execute this state by default and after executing every other
  state below.

  Retention: Retention is a low power state where the core is clock gated and
  the memory and the registers associated with the core are retained. The
  voltage may be reduced to the minimum value needed to keep the processor
  registers active. The SPM should be configured to execute the retention
  sequence and would wait for interrupt, before restoring the cpu to execution
  state. Retention may have a slightly higher latency than Standby.

  Standalone PC: A cpu can power down and warmboot if there is a sufficient time
  between the time it enters idle and the next known wake up. SPC mode is used
  to indicate a core entering a power down state without consulting any other
  cpu or the system resources. This helps save power only on that core.  The SPM
  sequence for this idle state is programmed to power down the supply to the
  core, wait for the interrupt, restore power to the core, and ensure the
  system state including cache hierarchy is ready before allowing core to
  resume. Applying power and resetting the core causes the core to warmboot
  back into Elevation Level (EL) which trampolines the control back to the
  kernel. Entering a power down state for the cpu, needs to be done by trapping
  into a EL. Failing to do so, would result in a crash enforced by the warm boot
  code in the EL for the SoC. On SoCs with write-back L1 cache, the cache has to
  be flushed in s/w, before powering down the core.

  Power Collapse: This state is similar to the SPC mode, but distinguishes
  itself in that the cpu acknowledges and permits the SoC to enter deeper sleep
  modes. In a hierarchical power domain SoC, this means L2 and other caches can
  be flushed, system bus, clocks - lowered, and SoC main XO clock gated and
  voltages reduced, provided all cpus enter this state.  Since the span of low
  power modes possible at this state is vast, the exit latency and the residency
  of this low power mode would be considered high even though at a cpu level,
  this essentially is cpu power down. The SPM in this state also may handshake
  with the Resource power manager (RPM) processor in the SoC to indicate a
  complete application processor subsystem shut down.

  The idle-state for QCOM SoCs are distinguished by the compatible property of
  the idle-states device node.

  [1] Documentation/devicetree/bindings/arm/idle-states.yaml

properties:
  $nodename:
    const: idle-states

patternProperties:
  "^(ret|spc|pc)$":
    type: object
    description:
      Each state node represents a domain idle state description.

    properties:
      compatible:
        items:
          - enum:
            - qcom,idle-state-ret
            - qcom,idle-state-spc
            - qcom,idle-state-pc
          - const: arm,idle-state

      entry-latency-us:
        description:
          The worst case latency in microseconds required to enter the idle
          state. Note that, the exit-latency-us duration may be guaranteed only
          after the entry-latency-us has passed.

      exit-latency-us:
        description:
          The worst case latency in microseconds required to exit the idle
          state.

      min-residency-us:
        description:
          The minimum residency duration in microseconds after which the idle
          state will yield power benefits, after overcoming the overhead while
          entering the idle state.

    required:
      - compatible
      - entry-latency-us
      - exit-latency-us
      - min-residency-us

additionalProperties: false

examples:
  - |
    idle-states {
      CPU_SPC: spc {
        compatible = "qcom,idle-state-spc", "arm,idle-state";
        entry-latency-us = <150>;
        exit-latency-us = <200>;
        min-residency-us = <2000>;
      };
    };
```

## Documentation/devicetree/bindings/arm/msm/qcom,kpss-acc.yaml
```yaml
# SPDX-License-Identifier: GPL-2.0-only OR BSD-2-Clause
%YAML 1.2
---
$id: http://devicetree.org/schemas/arm/msm/qcom,kpss-acc.yaml#
$schema: http://devicetree.org/meta-schemas/core.yaml#

title: Krait Processor Sub-system (KPSS) Application Clock Controller (ACC)

maintainers:
  - Ansuel Smith <ansuelsmth@gmail.com>

description: |
  The KPSS ACC provides clock, power domain, and reset control to a Krait CPU.
  There is one ACC register region per CPU within the KPSS remapped region as
  well as an alias register region that remaps accesses to the ACC associated
  with the CPU accessing the region.

properties:
  compatible:
    enum:
      - qcom,kpss-acc-v1
      - qcom,kpss-acc-v2

  reg:
    items:
      - description: Base address and size of the register region
      - description: Optional base address and size of the alias register region

  clocks:
    items:
      - description: phandle to pll8_vote
      - description: phandle to pxo_board

  clock-names:
    items:
      - const: pll8_vote
      - const: pxo

  clock-output-names:
    description: Name of the aux clock. Krait can have at most 4 cpu.
    enum:
      - acpu0_aux
      - acpu1_aux
      - acpu2_aux
      - acpu3_aux

  '#clock-cells':
    const: 0

required:
  - compatible
  - reg

allOf:
  - if:
      properties:
        compatible:
          contains:
            const: qcom,kpss-acc-v1
      then:
        required:
          - clocks
          - clock-names
          - clock-output-names
          - '#clock-cells'

additionalProperties: false

examples:
  - |
    #include <dt-bindings/clock/qcom,gcc-ipq806x.h>

    clock-controller@2088000 {
      compatible = "qcom,kpss-acc-v1";
      reg = <0x02088000 0x1000>, <0x02008000 0x1000>;
      clocks = <&gcc PLL8_VOTE>, <&pxo_board>;
      clock-names = "pll8_vote", "pxo";
      clock-output-names = "acpu0_aux";
      #clock-cells = <0>;
    };

    clock-controller@2098000 {
      compatible = "qcom,kpss-acc-v1";
      reg = <0x02098000 0x1000>, <0x02008000 0x1000>;
      clock-output-names = "acpu1_aux";
      clocks = <&gcc PLL8_VOTE>, <&pxo_board>;
      clock-names = "pll8_vote", "pxo";
      #clock-cells = <0>;
    };

  - |
    clock-controller@f9088000 {
      compatible = "qcom,kpss-acc-v2";
      reg = <0xf9088000 0x1000>,
            <0xf9008000 0x1000>;
    };
...
```

## Documentation/devicetree/bindings/arm/msm/qcom,kpss-gcc.yaml
```yaml
# SPDX-License-Identifier: GPL-2.0-only OR BSD-2-Clause
%YAML 1.2
---
$id: http://devicetree.org/schemas/arm/msm/qcom,kpss-gcc.yaml#
$schema: http://devicetree.org/meta-schemas/core.yaml#

title: Krait Processor Sub-system (KPSS) Global Clock Controller (GCC)

maintainers:
  - Ansuel Smith <ansuelsmth@gmail.com>

description: |
  Krait Processor Sub-system (KPSS) Global Clock Controller (GCC). Used
  to control L2 mux (in the current implementation).

properties:
  compatible:
    const: qcom,kpss-gcc

  reg:
    items:
      - description: Base address and size of the register region

  clocks:
    items:
      - description: phandle to pll8_vote
      - description: phandle to pxo_board

  clock-names:
    items:
      - const: pll8_vote
      - const: pxo

  clock-output-names:
    const: acpu_l2_aux

  '#clock-cells':
    const: 0

required:
  - compatible
  - reg
  - clocks
  - clock-names
  - clock-output-names
  - '#clock-cells'

additionalProperties: false

examples:
  - |
    #include <dt-bindings/clock/qcom,gcc-ipq806x.h>

    clock-controller@2011000 {
      compatible = "qcom,kpss-gcc";
      reg = <0x2011000 0x1000>;
      clocks = <&gcc PLL8_VOTE>, <&pxo_board>;
      clock-names = "pll8_vote", "pxo";
      clock-output-names = "acpu_l2_aux";
      #clock-cells = <0>;
    };
...
```

## Documentation/devicetree/bindings/arm/npcm/nuvoton,gcr.yaml
```yaml
# SPDX-License-Identifier: GPL-2.0-only OR BSD-2-Clause
%YAML 1.2
---
$id: http://devicetree.org/schemas/arm/npcm/nuvoton,gcr.yaml#
$schema: http://devicetree.org/meta-schemas/core.yaml#

title: Global Control Registers block in Nuvoton SoCs

maintainers:
  - Jonathan Neuschäfer <j.neuschaefer@gmx.net>

description: |
  The Global Control Registers (GCR) are a block of registers in Nuvoton SoCs
  that expose misc functionality such as chip model and version information or
  pinmux settings.

properties:
  compatible:
    items:
      - enum:
          - nuvoton,wpcm450-gcr
          - nuvoton,npcm750-gcr
      - const: syscon
      - const: simple-mfd
  reg: true

required:
  - compatible
  - reg

additionalProperties: false

examples:
  - |
    gcr: gcr@800000 {
      compatible = "nuvoton,npcm750-gcr", "syscon", "simple-mfd";
      reg = <0x800000 0x1000>;
    };
```

## Documentation/devicetree/bindings/arm/pensando,elba.yaml
```yaml
# SPDX-License-Identifier: (GPL-2.0-only OR BSD-2-Clause)
%YAML 1.2
---
$id: http://devicetree.org/schemas/arm/pensando,elba.yaml#
$schema: http://devicetree.org/meta-schemas/core.yaml#

title: Pensando Elba SoC Platforms Device Tree Bindings

maintainers:
  - Brad Larson  <brad@pensando.io>

properties:
  $nodename:
    const: "/"
  compatible:
    const: pensando,elba

additionalProperties: true

...
```

## Documentation/devicetree/bindings/arm/sunplus/sunplus,idle-state.yaml
```yaml
# SPDX-License-Identifier: (GPL-2.0-only OR BSD-2-Clause)
# Copyright (C) Sunplus Co., Ltd. 2021
%YAML 1.2
---
$id: http://devicetree.org/schemas/arm/sunplus/sunplus,idle-state.yaml#
$schema: http://devicetree.org/meta-schemas/core.yaml#

title: Sunplus SOC cpuidle state

maintainers:
  - Edwin Chiu<edwinchiu0505tw@gmail.com>

description: |
  Sunplus SOC cpuidle state

properties:
  compatible:
    oneOf:
      - items:
          - enum:
              - sunplus,sp7021-idle-state

  entry-latency-us:
    description:
      Worst case latency in microseconds required to enter the idle state.

  exit-latency-us:
    description:
      Worst case latency in microseconds required to exit the idle state.
      The exit-latency-us duration may be guaranteed only after
      entry-latency-us has passed.

  min-residency-us:
    description:
      Minimum residency duration in microseconds, inclusive of preparation
      and entry, for this idle state to be considered worthwhile energy wise
      (refer to section 2 of this document for a complete description).

required:
  - compatible
  - entry-latency-us
  - exit-latency-us
  - min-residency-us

additionalProperties: true

examples:
  - |

    idle-state {
      CPU_IDLE: cpu_idle {
        compatible = "sunplus,sp7021-idle-state";
        entry-latency-us = <8000>;
        exit-latency-us = <700>;
        min-residency-us = <9000>;
      };
    };

...
```

## Documentation/devicetree/bindings/ata/mikrotek,rb532-pata.yaml
```yaml
# SPDX-License-Identifier: (GPL-2.0 OR BSD-2-Clause)
%YAML 1.2
---
$id: http://devicetree.org/schemas/ata/mikrotek,rb532-pata.yaml#
$schema: http://devicetree.org/meta-schemas/core.yaml#

title: Mikrotek RB532 PATA Controller bindings

maintainers:
  - Thomas Bogendoerfer <tsbogend@alpha.franken.de>

properties:
  compatible:
    const: mikrotik,rb532-pata

  reg:
    maxItems: 1

  interrupts:
    maxItems: 1

  gpio:
    maxItems: 1

required:
  - compatible
  - reg
  - interrupts
  - gpio

additionalProperties: false

examples:
  - |
    cf@18a10000 {
        compatible = "mikrotik,rb532-pata";
        reg = <0x18a10000 0xc04>;

        gpio = <&gpio0 13 0>;

        interrupt-parent = <&gpio0>;
        interrupts = <13 0>;
    };
```

## Documentation/devicetree/bindings/bus/brcm,gisb-arb.yaml
```yaml
# SPDX-License-Identifier: (GPL-2.0-only OR BSD-2-Clause)
%YAML 1.2
---
$id: http://devicetree.org/schemas/bus/brcm,gisb-arb.yaml#
$schema: http://devicetree.org/meta-schemas/core.yaml#

title: Broadcom GISB bus Arbiter controller

maintainers:
  - Florian Fainelli <f.fainelli@gmail.com>

properties:
  compatible:
    oneOf:
      - items:
          - enum:
              - brcm,bcm7445-gisb-arb
          - const: brcm,gisb-arb
      - items:
          - const: brcm,bcm7278-gisb-arb
      - items:
          - const: brcm,bcm7435-gisb-arb
      - items:
          - const: brcm,bcm7400-gisb-arb
      - items:
          - const: brcm,bcm7038-gisb-arb
      - items:
          - const: brcm,gisb-arb

  reg:
    maxItems: 1

  interrupts:
    minItems: 2
    maxItems: 3

  brcm,gisb-arb-master-mask:
    $ref: /schemas/types.yaml#/definitions/uint32
    description: >
      32-bits wide bitmask used to specify which GISB masters are valid at the
      system level

  brcm,gisb-arb-master-names:
    $ref: /schemas/types.yaml#/definitions/string-array
    description: >
      String list of the litteral name of the GISB masters. Should match the
      number of bits set in brcm,gisb-master-mask and the order in which they
      appear

required:
  - compatible
  - reg
  - interrupts

additionalProperties: false

examples:
  - |
    gisb-arb@f0400000 {
      compatible = "brcm,gisb-arb";
      reg = <0xf0400000 0x800>;
      interrupts = <0>, <2>;
      interrupt-parent = <&sun_l2_intc>;
      brcm,gisb-arb-master-mask = <0x7>;
      brcm,gisb-arb-master-names = "bsp_0", "scpu_0", "cpu_0";
    };
```
