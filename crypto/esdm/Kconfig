## drivers/fpga/altera/Kconfig
```kconfig
config FPGA_ALTERA
	bool "Altera Devices"
	default y
	help
	  If you have an altera fpga, say Y.

if FPGA_ALTERA

config FPGA_MGR_SOCFPGA
	tristate "Altera SOCFPGA FPGA Manager"
	depends on ARCH_INTEL_SOCFPGA || COMPILE_TEST
	help
	  FPGA manager driver support for Altera SOCFPGA.

config FPGA_MGR_SOCFPGA_A10
	tristate "Altera SoCFPGA Arria10"
	depends on ARCH_INTEL_SOCFPGA || COMPILE_TEST
	select REGMAP_MMIO
	help
	  FPGA manager driver support for Altera Arria10 SoCFPGA.

config ALTERA_PR_IP_CORE
	tristate "Altera Partial Reconfiguration IP Core"
	help
	  Core driver support for Altera Partial Reconfiguration IP component

config ALTERA_PR_IP_CORE_PLAT
	tristate "Platform support of Altera Partial Reconfiguration IP Core"
	depends on ALTERA_PR_IP_CORE && OF && HAS_IOMEM
	help
	  Platform driver support for Altera Partial Reconfiguration IP
	  component

config FPGA_MGR_ALTERA_PS_SPI
	tristate "Altera FPGA Passive Serial over SPI"
	depends on SPI
	select BITREVERSE
	help
	  FPGA manager driver support for Altera Arria/Cyclone/Stratix
	  using the passive serial interface over SPI.

config FPGA_MGR_ALTERA_CVP
	tristate "Altera CvP FPGA Manager"
	depends on PCI
	help
	  FPGA manager driver support for Arria-V, Cyclone-V, Stratix-V,
	  Arria 10 and Stratix10 Altera FPGAs using the CvP interface over PCIe.

config FPGA_MGR_STRATIX10_SOC
	tristate "Intel Stratix10 SoC FPGA Manager"
	depends on (ARCH_INTEL_SOCFPGA && INTEL_STRATIX10_SERVICE)
	help
	  FPGA manager driver support for the Intel Stratix10 SoC.

config FPGA_MGR_TS73XX
	tristate "Technologic Systems TS-73xx SBC FPGA Manager"
	depends on ARCH_EP93XX && MACH_TS72XX
	help
	  FPGA manager driver support for the Altera Cyclone II FPGA
	  present on the TS-73xx SBC boards.

config ALTERA_FREEZE_BRIDGE
	tristate "Altera FPGA Freeze Bridge"
	depends on FPGA_BRIDGE && HAS_IOMEM
	help
	  Say Y to enable drivers for Altera FPGA Freeze bridges.  A
	  freeze bridge is a bridge that exists in the FPGA fabric to
	  isolate one region of the FPGA from the busses while that
	  region is being reprogrammed.

config SOCFPGA_FPGA_BRIDGE
	tristate "Altera SoCFPGA FPGA Bridges"
	depends on ARCH_INTEL_SOCFPGA && FPGA_BRIDGE
	help
	  Say Y to enable drivers for FPGA bridges for Altera SOCFPGA
	  devices.

endif #FPGA_ALTERA
```

## drivers/fpga/dfl/Kconfig
```kconfig
# SPDX-License-Identifier: GPL-2.0-only

config FPGA_DFL
	tristate "FPGA Device Feature List (DFL) support"
	select FPGA_BRIDGE
	select FPGA_REGION
	depends on HAS_IOMEM
	help
	  Device Feature List (DFL) defines a feature list structure that
	  creates a linked list of feature headers within the MMIO space
	  to provide an extensible way of adding features for FPGA.
	  Driver can walk through the feature headers to enumerate feature
	  devices (e.g. FPGA Management Engine, Port and Accelerator
	  Function Unit) and their private features for target FPGA devices.

	  Select this option to enable common support for Field-Programmable
	  Gate Array (FPGA) solutions which implement Device Feature List.
	  It provides enumeration APIs and feature device infrastructure.

if FPGA_DFL

config FPGA_DFL_FME
	tristate "FPGA DFL FME Driver"
	depends on HWMON && PERF_EVENTS
	help
	  The FPGA Management Engine (FME) is a feature device implemented
	  under Device Feature List (DFL) framework. Select this option to
	  enable the platform device driver for FME which implements all
	  FPGA platform level management features. There shall be one FME
	  per DFL based FPGA device.

config FPGA_DFL_FME_MGR
	tristate "FPGA DFL FME Manager Driver"
	depends on FPGA_DFL_FME
	help
	  Say Y to enable FPGA Manager driver for FPGA Management Engine.

config FPGA_DFL_FME_BRIDGE
	tristate "FPGA DFL FME Bridge Driver"
	depends on FPGA_DFL_FME
	help
	  Say Y to enable FPGA Bridge driver for FPGA Management Engine.

config FPGA_DFL_FME_REGION
	tristate "FPGA DFL FME Region Driver"
	depends on FPGA_DFL_FME
	help
	  Say Y to enable FPGA Region driver for FPGA Management Engine.

config FPGA_DFL_AFU
	tristate "FPGA DFL AFU Driver"
	help
	  This is the driver for FPGA Accelerated Function Unit (AFU) which
	  implements AFU and Port management features. A User AFU connects
	  to the FPGA infrastructure via a Port. There may be more than one
	  Port/AFU per DFL based FPGA device.

config FPGA_DFL_NIOS_INTEL_PAC_N3000
	tristate "FPGA DFL NIOS Driver for Intel PAC N3000"
	select REGMAP
	help
	  This is the driver for the N3000 Nios private feature on Intel
	  PAC (Programmable Acceleration Card) N3000. It communicates
	  with the embedded Nios processor to configure the retimers on
	  the card. It also instantiates the SPI master (spi-altera) for
	  the card's BMC (Board Management Controller).

config FPGA_DFL_PCI
	tristate "FPGA DFL PCIe Device Driver"
	depends on PCI
	help
	  Select this option to enable PCIe driver for PCIe-based
	  Field-Programmable Gate Array (FPGA) solutions which implement
	  the Device Feature List (DFL). This driver provides interfaces
	  for userspace applications to configure, enumerate, open and access
	  FPGA accelerators on the FPGA DFL devices, enables system level
	  management functions such as FPGA partial reconfiguration, power
	  management and virtualization with DFL framework and DFL feature
	  device drivers.

	  To compile this as a module, choose M here.

endif #FPGA_DFL
```

## drivers/fpga/lattice/Kconfig
```kconfig
config FPGA_LATTICE
	bool "Lattice Devices"
	default y
	help
	  If you have a lattic fpga, say Y.

if FPGA_LATTICE

config FPGA_MGR_ICE40_SPI
	tristate "Lattice iCE40 SPI"
	depends on OF && SPI
	help
	  FPGA manager driver support for Lattice iCE40 FPGAs over SPI.

config FPGA_MGR_MACHXO2_SPI
	tristate "Lattice MachXO2 SPI"
	depends on SPI
	help
	  FPGA manager driver support for Lattice MachXO2 configuration
	  over slave SPI interface.

endif #FPGA_LATTICE
```

## drivers/fpga/xilinx/Kconfig
```kconfig
config FPGA_XILINX
	bool "Xilinx Devices"
	default y
	help
	  If you have a xilinx fpga, say Y.

if FPGA_XILINX

config FPGA_MGR_ZYNQ_FPGA
	tristate "Xilinx Zynq FPGA"
	depends on ARCH_ZYNQ || COMPILE_TEST
	help
	  FPGA manager driver support for Xilinx Zynq FPGAs.

config FPGA_MGR_ZYNQMP_FPGA
	tristate "Xilinx ZynqMP FPGA"
	depends on ZYNQMP_FIRMWARE || (!ZYNQMP_FIRMWARE && COMPILE_TEST)
	help
	  FPGA manager driver support for Xilinx ZynqMP FPGAs.
	  This driver uses the processor configuration port(PCAP)
	  to configure the programmable logic(PL) through PS
	  on ZynqMP SoC.

config XILINX_PR_DECOUPLER
	tristate "Xilinx LogiCORE PR Decoupler"
	depends on FPGA_BRIDGE
	depends on HAS_IOMEM
	help
	  Say Y to enable drivers for Xilinx LogiCORE PR Decoupler
	  or Xilinx Dynamic Function eXchnage AIX Shutdown Manager.
	  The PR Decoupler exists in the FPGA fabric to isolate one
	  region of the FPGA from the busses while that region is
	  being reprogrammed during partial reconfig.
	  The Dynamic Function eXchange AXI shutdown manager prevents
	  AXI traffic from passing through the bridge. The controller
	  safely handles AXI4MM and AXI4-Lite interfaces on a
	  Reconfigurable Partition when it is undergoing dynamic
	  reconfiguration, preventing the system deadlock that can
	  occur if AXI transactions are interrupted by DFX.

config FPGA_MGR_XILINX_SPI
	tristate "Xilinx Configuration over Slave Serial (SPI)"
	depends on SPI
	help
	  FPGA manager driver support for Xilinx FPGA configuration
	  over slave serial interface.

endif #FPGA_XILINX
```

## drivers/fpga/xrt/Kconfig
```kconfig
# XRT Alveo FPGA device configuration
#

config FPGA_XRT
	tristate "XRT Alveo Drivers"
	depends on OF
	select OF_EMPTY_ROOT
	select OF_OVERLAY
	help
	  Select this option to enable Xilinx XRT Alveo drivers. Xilinx Alveo
	  card is PCIe device and has two PCIe functions. The first function
	  performs board manangement and XRT management driver will be attached
	  to it. The second function performs data movement, compute unit
	  scheduling etc. And an XRT user driver will be attached to it.

config FPGA_XRT_XMGMT
	tristate "Xilinx Alveo Management Driver"
	depends on FPGA_XRT
	help
	  Select this option to enable XRT PCIe driver for Xilinx Alveo FPGA.
	  This driver provides interfaces for userspace application to access
	  Alveo FPGA device, such as: downloading FPGA bitstream, query card
	  information, hot reset card etc.
```

## drivers/fpga/xrt/lib/Kconfig
```kconfig
# SPDX-License-Identifier: GPL-2.0-only
#
# XRT Alveo FPGA device configuration
#

config FPGA_XRT_LIB
	tristate "XRT Alveo Driver Library"
	depends on HWMON && PCI && HAS_IOMEM
	select FPGA_XRT_METADATA
	select REGMAP_MMIO
	help
	  Select this option to enable Xilinx XRT Alveo driver library. This
	  library is core infrastructure of XRT Alveo FPGA drivers which
	  provides functions for working with device nodes, iteration and
	  lookup of platform devices, common interfaces for platform devices,
	  plumbing of function call and ioctls between platform devices and
	  parent partitions.
```

## drivers/fpga/xrt/metadata/Kconfig
```kconfig
# SPDX-License-Identifier: GPL-2.0-only
#
# XRT Alveo FPGA device configuration
#

config FPGA_XRT_METADATA
	bool "XRT Alveo Driver Metadata Parser"
	select LIBFDT
	help
	  This option provides helper functions to parse Xilinx Alveo FPGA
	  firmware metadata. The metadata is in device tree format and the
	  XRT driver uses it to discover the HW subsystems behind PCIe BAR.
```

## drivers/fpga/xrt/mgmt/Kconfig
```kconfig
# SPDX-License-Identifier: GPL-2.0-only
#
# Xilinx XRT FPGA device configuration
#

config FPGA_XRT_XMGMT
	tristate "Xilinx Alveo Management Driver"
	depends on FPGA_XRT_LIB
	select FPGA_XRT_METADATA
	select FPGA_BRIDGE
	select FPGA_REGION
	help
	  Select this option to enable XRT PCIe driver for Xilinx Alveo FPGA.
	  This driver provides interfaces for userspace application to access
	  Alveo FPGA device.
```

## drivers/gpu/drm/etnaviv/Kconfig
```kconfig
# SPDX-License-Identifier: GPL-2.0-only

config DRM_ETNAVIV
	tristate "ETNAVIV (DRM support for Vivante GPU IP cores)"
	depends on DRM
	depends on MMU
	select SHMEM
	select SYNC_FILE
	select THERMAL if DRM_ETNAVIV_THERMAL
	select TMPFS
	select WANT_DEV_COREDUMP
	select CMA if HAVE_DMA_CONTIGUOUS
	select DMA_CMA if HAVE_DMA_CONTIGUOUS
	select DRM_SCHED
	help
	  DRM driver for Vivante GPUs.

config DRM_ETNAVIV_PCI_DRIVER
	bool "Enable PCI device driver support"
	depends on DRM_ETNAVIV
	depends on PCI
	depends on MACH_LOONGSON64
	default y
	help
	  DRM PCI driver for the Vivante GPU in LS7A1000 north bridge
	  and LS2K1000 SoC. The GC1000 in LS2K1000 and LS7A1000 is a
	  PCI device.
	  If in doubt, say "n".

config DRM_ETNAVIV_THERMAL
	bool "enable ETNAVIV thermal throttling"
	depends on DRM_ETNAVIV
	default y
	help
	  Compile in support for thermal throttling.
	  Say Y unless you want to risk burning your SoC.
```

## drivers/gpu/drm/i915/Kconfig.platforms
```kconfig
config DRM_I915_INTEGRATED_GPU_SUPPORT
	bool "Support integrated GPUs"
	default y
	depends on DRM_I915
	help
	  Include support for integrated GPUs.
```

## drivers/gpu/drm/imx/dpu/Kconfig
```kconfig
config DRM_IMX_DPU
	tristate "DRM support for Freescale i.MX DPU Graphics"
	select DRM_KMS_HELPER
	select VIDEOMODE_HELPERS
	select DRM_GEM_CMA_HELPER
	select DRM_KMS_CMA_HELPER
	depends on DRM && OF && ARCH_MXC
	depends on COMMON_CLK
	help
	  enable Freescale i.MX DPU graphics support
```

## drivers/gpu/drm/loongson/Kconfig
```kconfig
# SPDX-License-Identifier: GPL-2.0-only

config DRM_LOONGSON
	tristate "DRM support for LS7A bridge chipset"
	depends on DRM && PCI
	depends on CPU_LOONGSON64 || COMPILE_TEST
	select DRM_KMS_HELPER
	select DRM_VRAM_HELPER
	help
	  The loongson 7A bridge chip (LS7A) is a special chipset for
	  loongson CPU. LS7A internal integrated display controllers,
	  support two display channels.
	  If compiled as a module it will be called loongson.
```

## drivers/gpu/drm/lsdc/Kconfig
```kconfig
# SPDX-License-Identifier: GPL-2.0

config DRM_LSDC
	tristate "DRM Support for loongson's display controller"
	depends on DRM && PCI
	depends on MACH_LOONGSON64 || LOONGARCH || MIPS || COMPILE_TEST
	select OF
	select CMA if HAVE_DMA_CONTIGUOUS
	select DMA_CMA if HAVE_DMA_CONTIGUOUS
	select DRM_KMS_HELPER
	select DRM_KMS_FB_HELPER
	select DRM_GEM_CMA_HELPER
	select DRM_VRAM_HELPER
	select VIDEOMODE_HELPERS
	default m
	help
	  This is a KMS driver for the display controller in the LS7A1000
	  bridge chip and LS2K1000/LS2K0500 SoC.
	  If "M" is selected, the module will be called lsdc.

	  If in doubt, say "Y".
```

## drivers/hte/Kconfig
```kconfig
# SPDX-License-Identifier: GPL-2.0-only
menuconfig HTE
	bool "Hardware Timestamping Engine (HTE) Support"
	help
	  Hardware Timestamping Engine (HTE) Support.

	  Some devices provide a hardware timestamping engine which can
	  timestamp certain device lines/signals in realtime. This provides a
	  hardware-assisted timestamp to generic signals like GPIOs or IRQs
	  lines. It comes with a benefit for applications like autonomous
	  machines needing accurate timestamping event with less jitter.

	  This framework provides a generic interface to such HTE devices
	  within the Linux kernel. It provides an API to register and
	  unregister a HTE provider chip, configurable software buffer to
	  store the timestamps, push the timestamp from the HTE providers and
	  retrieve timestamps for the consumers. It also provides means for the
	  consumers to request signals it wishes to hardware timestamp and
	  release them if not required.

	  If unsure, say no.

if HTE

config HTE_TEGRA194
	tristate "NVIDIA Tegra194 HTE Support"
	depends on ARCH_TEGRA_194_SOC
	help
	  Enable this option for integrated hardware timestamping engine also
	  known as generic timestamping engine (GTE) support on NVIDIA Tegra194
	  systems-on-chip. The driver supports 352 LIC IRQs and 39 AON GPIOs
	  lines for timestamping in realtime.

config HTE_TEGRA194_IRQ_TEST
        tristate "NVIDIA Tegra194 HTE LIC IRQ Test"
        depends on HTE_TEGRA194
        help
	  The NVIDIA Tegra194 GTE IRQ test driver demonstrates HTE subsystem
	  usage for the LIC IRQ hardware timestamp.

endif
```

## drivers/hv/Kconfig
```kconfig
# SPDX-License-Identifier: GPL-2.0

menu "Microsoft Hyper-V guest support"

config HYPERV
	tristate "Microsoft Hyper-V client drivers"
	depends on X86 && ACPI && X86_LOCAL_APIC && HYPERVISOR_GUEST
	select PARAVIRT
	select X86_HV_CALLBACK_VECTOR
	help
	  Select this option to run Linux as a Hyper-V client operating
	  system.

config HYPERV_TIMER
	def_bool HYPERV

config HYPERV_UTILS
	tristate "Microsoft Hyper-V Utilities driver"
	depends on HYPERV && CONNECTOR && NLS
	help
	  Select this option to enable the Hyper-V Utilities.

config HYPERV_BALLOON
	tristate "Microsoft Hyper-V Balloon driver"
	depends on HYPERV
	select PAGE_REPORTING
	help
	  Select this option to enable Hyper-V Balloon driver.

config HYPERV_ROOT_API
	tristate "Microsoft Hypervisor root partition interfaces: /dev/mshv"
	depends on HYPERV
	help
	  Provides access to interfaces for managing guest virtual machines
	  running under the Microsoft Hypervisor.

	  These interfaces will only work when Linux is running as root
	  partition on the Microsoft Hypervisor.

	  The interfaces are provided via a device named /dev/mshv.

	  To compile this as a module, choose M here.
          The module is named mshv.

	  If unsure, say N.


endmenu
```

## drivers/hwtracing/coresight/ultrasoc/Kconfig
```kconfig
# SPDX-License-Identifier: MIT
#
# ultrasoc configuration
#
config ULTRASOC_SMB
	tristate "Ultrasoc system memory buffer drivers"
        depends on ARM64 && CORESIGHT
	help
	  This enables support for the Ultrasoc system memory buffer
	  driver that is responsible for receiving the trace data from
	  Coresight ETM devices and storing them to a system buffer
	  respectively.
```
