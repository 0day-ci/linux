## drivers/hwtracing/hisilicon/Kconfig
```kconfig
# SPDX-License-Identifier: GPL-2.0-only
config HISI_PTT
	tristate "HiSilicon PCIe Tune and Trace Device"
	depends on ARM64
	depends on PCI && PCI_MSI
	depends on HAS_DMA && HAS_IOMEM
	depends on DEBUG_FS
	help
	  HiSilicon PCIe Tune and Trace Device exist as a PCIe iEP
	  device, provides support for PCIe traffic tuning and
	  tracing TLP headers to the memory.
```

## drivers/hwtracing/ultrasoc/Kconfig
```kconfig
# SPDX-License-Identifier: MIT
#
# ultrasoc configuration
#

menuconfig ULTRASOC
	tristate "Ultrasoc Tracing Support"
	select CORESIGHT
	help
	  This framework provides a kernel interface for the Ultrasoc trace
	  drivers to register themselves with. It's intended to build
	  a topological view of the Ultrasoc components based on ACPI
	  specification and configure the right series of components when a
	  trace source gets enabled.

if ULTRASOC
config ULTRASOC_AXI_COM
	tristate "Ultrasoc AXI communicator drivers"
	help
	  This config enables support for Ultrasoc AXI Bus Communicator
	  drivers. The AXI Communicator has upstream and downstream channels,
	  the upstream channel is used to transmit user configuration, and
	  downstream channel to carry response and trace data to the users.

config ULTRASOC_SMB
	tristate "Ultrasoc System memory buffer drivers"
	help
	  This config enables support for Ultrasoc System Memory Buffer
	  drivers. The System Memory Buffer provides a way to buffer and
	  store messages in system memory. It provides a capability to
	  store messages received on its input message interface to an
	  area of system memory.

endif
```

## drivers/iio/imu/bno055/Kconfig
```kconfig
# SPDX-License-Identifier: GPL-2.0

config BOSCH_BNO055_IIO
	tristate

config BOSCH_BNO055_SERIAL
	tristate "Bosch BNO055 attached via serial bus"
	depends on SERIAL_DEV_BUS
	select BOSCH_BNO055_IIO
	help
	  Enable this to support Bosch BNO055 IMUs attached via serial bus.

	  This driver can also be built as a module. If so, the module will be
	  called bno055_sl.
```
