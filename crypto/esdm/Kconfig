## crypto/esdm/Kconfig
```kconfig
# SPDX-License-Identifier: GPL-2.0
#
# Entropy Source and DRNG Manager configuration
#

config CRYPTO_ESDM
	bool "ESDM Implementation"
	default n
	select CRYPTO_LIB_SHA256 if CRYPTO
	help
	  The Entropy Source and DRNG Manager (ESDM) generates entropy
	  from different entropy sources. Each entropy source can
	  be enabled and configured independently. The interrupt
	  entropy source can be configured to be SP800-90B compliant.
	  The entire ESDM can be configured to be SP800-90C compliant.
	  Runtime-switchable cryptographic support is available.
	  The ESDM delivers significant entropy during boot.

	  The ESDM also provides compliance to SP800-90A/B/C.

menu "Entropy Source and DRNG Manager Configuration"
	depends on CRYPTO_ESDM

if CRYPTO_ESDM

config CRYPTO_ESDM_SHA256
	bool
	default y if CRYPTO_LIB_SHA256

menu "Specific DRNG seeding strategies"

config CRYPTO_ESDM_OVERSAMPLE_ENTROPY_SOURCES
	bool "Oversample entropy sources"
	default n
	help
	  When enabling this option, the entropy sources are
	  over-sampled with the following approach: First, the
	  the entropy sources are requested to provide 64 bits more
	  entropy than the size of the entropy buffer. For example,
	  if the entropy buffer is 256 bits, 320 bits of entropy
	  is requested to fill that buffer.

	  Second, the seed operation of the deterministic RNG
	  requests 128 bits more data from each entropy source than
	  the security strength of the DRNG during initialization.
	  A prerequisite for this operation is that the digest size
	  of the used hash must be at least equally large to generate
	  that buffer. If the prerequisite is not met, this
	  oversampling is not applied.

	  This strategy is intended to offset the asymptotic entropy
	  increase to reach full entropy in a buffer.

	  The strategy is consistent with the requirements in
	  NIST SP800-90C and is only enforced with fips=1.

	  If unsure, say N.

config CRYPTO_ESDM_OVERSAMPLE_ES_BITS
	int
	default 0 if !CRYPTO_ESDM_OVERSAMPLE_ENTROPY_SOURCES
	default 64 if CRYPTO_ESDM_OVERSAMPLE_ENTROPY_SOURCES

config CRYPTO_ESDM_SEED_BUFFER_INIT_ADD_BITS
	int
	default 0 if !CRYPTO_ESDM_OVERSAMPLE_ENTROPY_SOURCES
	default 128 if CRYPTO_ESDM_OVERSAMPLE_ENTROPY_SOURCES

endmenu # "Specific DRNG seeding strategies"

menu "Entropy Source Configuration"

config CRYPTO_ESDM_RUNTIME_ES_CONFIG
	bool "Enable runtime configuration of entropy sources"
	help
	  When enabling this option, the ESDM provides the mechanism
	  allowing to alter the entropy rate of each entropy source
	  during boot time and runtime.

	  Each entropy source allows its entropy rate changed with
	  a kernel command line option. When not providing any
	  option, the default specified during kernel compilation
	  is applied.

comment "Jitter RNG Entropy Source"

config CRYPTO_ESDM_JENT
	bool "Enable Jitter RNG as ESDM Seed Source"
	depends on CRYPTO
	select CRYPTO_JITTERENTROPY
	help
	  The Linux RNG may use the Jitter RNG as entropy source. Enabling
	  this option enables the use of the Jitter RNG. Its default
	  entropy level is 16 bits of entropy per 256 data bits delivered
	  by the Jitter RNG. This entropy level can be changed at boot
	  time or at runtime with the esdm_base.jitterrng configuration
	  variable.

config CRYPTO_ESDM_JENT_ENTROPY_RATE
	int "Jitter RNG Entropy Source Entropy Rate"
	depends on CRYPTO_ESDM_JENT
	range 0 256
	default 16
	help
	  The option defines the amount of entropy the ESDM applies to 256
	  bits of data obtained from the Jitter RNG entropy source. The
	  ESDM enforces the limit that this value must be in the range
	  between 0 and 256.

	  When configuring this value to 0, the Jitter RNG entropy source
	  will provide 256 bits of data without being credited to contain
	  entropy.

comment "Kernel RNG Entropy Source"

config CRYPTO_ESDM_KERNEL_RNG
	bool "Enable Kernel RNG as ESDM Seed Source"
	help
	  The Linux RNG may use the kernel RNG (random.c) as entropy
	  source.

config CRYPTO_ESDM_KERNEL_RNG_ENTROPY_RATE
	int "Kernel RNG Entropy Source Entropy Rate"
	depends on CRYPTO_ESDM_KERNEL_RNG
	range 0 256
	default 256
	help
	  The option defines the amount of entropy the ESDM applies to 256
	  bits of data obtained from the kernel RNG entropy source. The
	  ESDM enforces the limit that this value must be in the range
	  between 0 and 256.

	  When configuring this value to 0, the kernel RNG entropy source
	  will provide 256 bits of data without being credited to contain
	  entropy.

	  Note: This value is set to 0 automatically when booting the
	  kernel in FIPS mode (with fips=1 kernel command line option).
	  This is due to the fact that random.c is not SP800-90B
	  compliant.

endmenu # "Entropy Source Configuration"

config CRYPTO_ESDM_DRNG_KCAPI
	bool
	depends on CRYPTO
	select CRYPTO_RNG
	default y

endif # CRYPTO_ESDM

endmenu # CRYPTO_ESDM
```

## drivers/acpi/pfru/Kconfig
```kconfig
# SPDX-License-Identifier: GPL-2.0
config ACPI_PFRU
	tristate "ACPI Platform Firmware Runtime Update (PFRU)"
	depends on 64BIT
	help
	  In order to reduce the system reboot times and update the platform firmware
	  in time, Platform Firmware Runtime Update is leveraged to patch the system
	  without reboot. This driver supports Platform Firmware Runtime Update,
	  which is composed of two parts: code injection and driver update. It also
	  allows telemetry data to be retrieved from the platform firmware.

	  To compile this driver as module, choose M here:
	  the modules will be called pfru_update and pfru_telemetry.
```

## drivers/ata/pata_parport/Kconfig
```kconfig
# SPDX-License-Identifier: GPL-2.0
#
# PATA_PARPORT configuration
#
# PATA_PARPORT doesn't need PARPORT, but if PARPORT is configured as a module,
# PATA_PARPORT must also be a module.
# PATA_PARPORT only supports PC style parports. Tough for USB or other parports...

comment "Parallel IDE protocol modules"
	depends on PATA_PARPORT

config PATA_PARPORT_ATEN
	tristate "ATEN EH-100 protocol"
	depends on PATA_PARPORT
	help
	  This option enables support for the ATEN EH-100 parallel port IDE
	  protocol. This protocol is used in some inexpensive low performance
	  parallel port kits made in Hong Kong. If you chose to build PATA_PARPORT
	  support into your kernel, you may answer Y here to build in the
	  protocol driver, otherwise you should answer M to build it as a
	  loadable module. The module will be called aten.

config PATA_PARPORT_BPCK
	tristate "MicroSolutions backpack (Series 5) protocol"
	depends on PATA_PARPORT
	help
	  This option enables support for the Micro Solutions BACKPACK
	  parallel port Series 5 IDE protocol.  (Most BACKPACK drives made
	  before 1999 were Series 5) Series 5 drives will NOT always have the
	  Series noted on the bottom of the drive. Series 6 drivers will.

	  In other words, if your BACKPACK drive doesn't say "Series 6" on the
	  bottom, enable this option.

	  If you chose to build PATA_PARPORT support into your kernel, you may
	  answer Y here to build in the protocol driver, otherwise you should
	  answer M to build it as a loadable module.  The module will be
	  called bpck.

config PATA_PARPORT_BPCK6
	tristate "MicroSolutions backpack (Series 6) protocol"
	depends on PATA_PARPORT && !64BIT
	help
	  This option enables support for the Micro Solutions BACKPACK
	  parallel port Series 6 IDE protocol.  (Most BACKPACK drives made
	  after 1999 were Series 6) Series 6 drives will have the Series noted
	  on the bottom of the drive.  Series 5 drivers don't always have it
	  noted.

	  In other words, if your BACKPACK drive says "Series 6" on the
	  bottom, enable this option.

	  If you chose to build PATA_PARPORT support into your kernel, you may
	  answer Y here to build in the protocol driver, otherwise you should
	  answer M to build it as a loadable module.  The module will be
	  called bpck6.

config PATA_PARPORT_COMM
	tristate "DataStor Commuter protocol"
	depends on PATA_PARPORT
	help
	  This option enables support for the Commuter parallel port IDE
	  protocol from DataStor. If you chose to build PATA_PARPORT support
	  into your kernel, you may answer Y here to build in the protocol
	  driver, otherwise you should answer M to build it as a loadable
	  module. The module will be called comm.

config PATA_PARPORT_DSTR
	tristate "DataStor EP-2000 protocol"
	depends on PATA_PARPORT
	help
	  This option enables support for the EP-2000 parallel port IDE
	  protocol from DataStor. If you chose to build PATA_PARPORT support
	  into your kernel, you may answer Y here to build in the protocol
	  driver, otherwise you should answer M to build it as a loadable
	  module. The module will be called dstr.

config PATA_PARPORT_FIT2
	tristate "FIT TD-2000 protocol"
	depends on PATA_PARPORT
	help
	  This option enables support for the TD-2000 parallel port IDE
	  protocol from Fidelity International Technology. This is a simple
	  (low speed) adapter that is used in some portable hard drives. If
	  you chose to build PATA_PARPORT support into your kernel, you may answer Y
	  here to build in the protocol driver, otherwise you should answer M
	  to build it as a loadable module. The module will be called ktti.

config PATA_PARPORT_FIT3
	tristate "FIT TD-3000 protocol"
	depends on PATA_PARPORT
	help
	  This option enables support for the TD-3000 parallel port IDE
	  protocol from Fidelity International Technology. This protocol is
	  used in newer models of their portable disk, CD-ROM and PD/CD
	  devices. If you chose to build PATA_PARPORT support into your kernel, you
	  may answer Y here to build in the protocol driver, otherwise you
	  should answer M to build it as a loadable module. The module will be
	  called fit3.

config PATA_PARPORT_EPAT
	tristate "Shuttle EPAT/EPEZ protocol"
	depends on PATA_PARPORT
	help
	  This option enables support for the EPAT parallel port IDE protocol.
	  EPAT is a parallel port IDE adapter manufactured by Shuttle
	  Technology and widely used in devices from major vendors such as
	  Hewlett-Packard, SyQuest, Imation and Avatar. If you chose to build
	  PATA_PARPORT support into your kernel, you may answer Y here to build in
	  the protocol driver, otherwise you should answer M to build it as a
	  loadable module. The module will be called epat.

config PATA_PARPORT_EPIA
	tristate "Shuttle EPIA protocol"
	depends on PATA_PARPORT
	help
	  This option enables support for the (obsolete) EPIA parallel port
	  IDE protocol from Shuttle Technology. This adapter can still be
	  found in some no-name kits. If you chose to build PATA_PARPORT support
	  into your kernel, you may answer Y here to build in the protocol
	  driver, otherwise you should answer M to build it as a loadable
	  module. The module will be called epia.

config PATA_PARPORT_FRIQ
	tristate "Freecom IQ ASIC-2 protocol"
	depends on PATA_PARPORT
	help
	  This option enables support for version 2 of the Freecom IQ parallel
	  port IDE adapter.  This adapter is used by the Maxell Superdisk
	  drive.  If you chose to build PATA_PARPORT support into your kernel, you
	  may answer Y here to build in the protocol driver, otherwise you
	  should answer M to build it as a loadable module. The module will be
	  called friq. You must also have a high-level driver for the type
	  of device that you want to support.

config PATA_PARPORT_FRPW
	tristate "FreeCom power protocol"
	depends on PATA_PARPORT
	help
	  This option enables support for the Freecom power parallel port IDE
	  protocol. If you chose to build PATA_PARPORT support into your kernel, you
	  may answer Y here to build in the protocol driver, otherwise you
	  should answer M to build it as a loadable module. The module will be
	  called frpw.

config PATA_PARPORT_KBIC
	tristate "KingByte KBIC-951A/971A protocols"
	depends on PATA_PARPORT
	help
	  This option enables support for the KBIC-951A and KBIC-971A parallel
	  port IDE protocols from KingByte Information Corp. KingByte's
	  adapters appear in many no-name portable disk and CD-ROM products,
	  especially in Europe. If you chose to build PATA_PARPORT support into your
	  kernel, you may answer Y here to build in the protocol driver,
	  otherwise you should answer M to build it as a loadable module. The
	  module will be called kbic.
```

## drivers/crypto/vmx/Kconfig
```kconfig
# SPDX-License-Identifier: GPL-2.0-only
config CRYPTO_DEV_VMX_ENCRYPT
	tristate "Encryption acceleration support on P8 CPU"
	depends on CRYPTO_DEV_VMX
	depends on CRYPTO_MANAGER_DISABLE_TESTS && CRYPTO_AES || CRYPTO_AES=y
	depends on CRYPTO_MANAGER_DISABLE_TESTS && CRYPTO_CBC || CRYPTO_CBC=y
	depends on CRYPTO_MANAGER_DISABLE_TESTS && CRYPTO_CTR || CRYPTO_CTR=y
	depends on CRYPTO_MANAGER_DISABLE_TESTS && CRYPTO_XTS || CRYPTO_XTS=y
	select CRYPTO_GHASH
	default m
	help
	  Support for VMX cryptographic acceleration instructions on Power8 CPU.
	  This module supports acceleration for AES and GHASH in hardware. If you
	  choose 'M' here, this module will be called vmx-crypto.
```

## drivers/ddcci/Kconfig
```kconfig
# SPDX-License-Identifier: GPL-2.0-only
menuconfig DDCCI
	tristate "DDCCI display protocol support"
	help
	  Say Y here if you want to have DDCCI
```

## drivers/fpga/Kconfig
```kconfig
# SPDX-License-Identifier: GPL-2.0-only
#
# FPGA framework configuration
#

menuconfig FPGA
	tristate "FPGA Configuration Framework"
	help
	  Say Y here if you want support for configuring FPGAs from the
	  kernel.  The FPGA framework adds a FPGA manager class and FPGA
	  manager drivers.

if FPGA

config FPGA_BRIDGE
	tristate "FPGA Bridge Framework"
	help
	  Say Y here if you want to support bridges connected between host
	  processors and FPGAs or between FPGAs.

config FPGA_REGION
	tristate "FPGA Region"
	depends on FPGA_BRIDGE
	help
	  FPGA Region common code.  A FPGA Region controls a FPGA Manager
	  and the FPGA Bridges associated with either a reconfigurable
	  region of an FPGA or a whole FPGA.

config OF_FPGA_REGION
	tristate "FPGA Region Device Tree Overlay Support"
	depends on OF && FPGA_REGION
	help
	  Support for loading FPGA images by applying a Device Tree
	  overlay.

source "drivers/fpga/altera/Kconfig"
source "drivers/fpga/lattice/Kconfig"
source "drivers/fpga/dfl/Kconfig"
source "drivers/fpga/xilinx/Kconfig"

endif # FPGA
```
