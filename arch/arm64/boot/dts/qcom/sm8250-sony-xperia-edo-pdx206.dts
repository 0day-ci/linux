// SPDX-License-Identifier: BSD-3-Clause
/*
 * Copyright (c) 2021, Konrad Dybcio <konrad.dybcio@somainline.org>
 */

/dts-v1/;

#include "sm8250-sony-xperia-edo.dtsi"

/ {
	model = "Sony Xperia 5 II";
	compatible = "sony,pdx206-generic", "qcom,sm8250";
};

&framebuffer {
	width = <1080>;
	height = <2520>;
	stride = <(1080 * 4)>;
};
