// SPDX-License-Identifier: BSD-3-Clause
/*
 * sc7280 IDP2 board device tree source
 *
 * Copyright (c) 2021, The Linux Foundation. All rights reserved.
 */

/dts-v1/;

#include "sc7280-idp.dtsi"

/ {
	model = "Qualcomm Technologies, Inc. sc7280 IDP SKU2 platform";
	compatible = "qcom,sc7280-idp2", "google,piglin", "qcom,sc7280";

	aliases {
		bluetooth0 = &bluetooth;
		serial0 = &uart5;
		serial1 = &uart7;
	};

	chosen {
		stdout-path = "serial0:115200n8";
	};
};

&bluetooth {
	vddio-supply = <&vreg_l18b_1p8>;
};
