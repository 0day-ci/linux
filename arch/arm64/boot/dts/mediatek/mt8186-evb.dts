// SPDX-License-Identifier: (GPL-2.0 OR MIT)
/*
 * Copyright (C) 2022 MediaTek Inc.
 */
/dts-v1/;
#include "mt8186.dtsi"

/ {
	model = "MediaTek MT8186 evaluation board";
	compatible = "mediatek,mt8186-evb", "mediatek,mt8186";

	aliases {
		serial0 = &uart0;
	};

	chosen {
		stdout-path = "serial0:921600n8";
	};

	memory {
		device_type = "memory";
		reg = <0 0x40000000 0 0x80000000>;
	};
};
