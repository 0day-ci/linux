// SPDX-License-Identifier: (GPL-2.0 OR MIT)
/*
 * Copyright (C) 2018-2021 Synaptics Incorporated
 *
 * Author: Jisheng Zhang <jszhang@kernel.org>
 */

/dts-v1/;

#include "as370.dtsi"

/ {
	model = "Synaptics AS370 RDK";
	compatible = "syna,as370-rdk", "syna,as370";

	chosen {
		stdout-path = "serial0:115200n8";
	};

	memory@1000000 {
		device_type = "memory";
		/* the first 16MB is for firmwares' usage */
		reg = <0 0x01000000 0 0x1f000000>;
	};
};

&uart0 {
	status = "okay";
};
