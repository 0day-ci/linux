// SPDX-License-Identifier: GPL-2.0
/dts-v1/;

/* Bootloader installs ATF here */
/memreserve/ 0x80000000 0x80000;

#include "en7523.dtsi"

/ {
	model = "Airoha EN7523 Evaluation Board";
	compatible = "airoha,en7523-evb", "airoha,en7523";

	aliases {
		serial0 = &uart1;
	};

	chosen {
		bootargs = "earlycon=uart8250,mmio32,0x1fbf0000 console=ttyS0,115200";
		stdout-path = "serial0:115200n8";
	};

	memory@80000000 {
		device_type = "memory";
		reg = <0x80000000 0x20000000>;
	};
};
