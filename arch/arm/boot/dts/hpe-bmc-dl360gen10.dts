// SPDX-License-Identifier: GPL-2.0
/*
 * Device Tree file for HPE DL360Gen10
 */

/include/ "hpe-gxp.dtsi"

/ {
	#address-cells = <1>;
	#size-cells = <1>;
	compatible = "hpe,gxp";
	model = "Hewlett Packard Enterprise ProLiant dl360 Gen10";

	chosen {
		bootargs = "earlyprintk console=ttyS2,115200";
	};

	memory@40000000 {
		device_type = "memory";
		reg = <0x40000000 0x20000000>;
	};

	ahb {

	};

};
