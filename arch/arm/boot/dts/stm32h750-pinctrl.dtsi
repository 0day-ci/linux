// SPDX-License-Identifier: (GPL-2.0+ OR BSD-3-Clause)
/*
 * Copyright (C) STMicroelectronics 2021 - All Rights Reserved
 * Author: Dillon Min  <dillon.minfei@gmail.com> for STMicroelectronics.
 */

#include "stm32h7-pinctrl.dtsi"

&pinctrl{
	compatible = "st,stm32h750-pinctrl";
};
