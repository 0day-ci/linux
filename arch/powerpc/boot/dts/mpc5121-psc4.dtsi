// SPDX-License-Identifier: GPL-2.0-or-later

&soc {
	psc4: psc@11400 {
		compatible = "fsl,mpc5121-psc";
		reg = <0x11400 0x100>;
		interrupts = <40 0x8>;
		fsl,rx-fifo-size = <16>;
		fsl,tx-fifo-size = <16>;
		clocks = <&clks MPC512x_CLK_PSC4>,
			 <&clks MPC512x_CLK_PSC4_MCLK>;
		clock-names = "ipg", "mclk";
		status = "disabled";
	};
};
