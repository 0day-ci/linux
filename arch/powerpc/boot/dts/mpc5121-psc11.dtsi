// SPDX-License-Identifier: GPL-2.0-or-later

&soc {
	psc11: psc@11b00 {
		compatible = "fsl,mpc5121-psc";
		reg = <0x11b00 0x100>;
		interrupts = <40 0x8>;
		fsl,rx-fifo-size = <16>;
		fsl,tx-fifo-size = <16>;
		clocks = <&clks MPC512x_CLK_PSC11>,
			 <&clks MPC512x_CLK_PSC11_MCLK>;
		clock-names = "ipg", "mclk";
		status = "disabled";
	};
};
