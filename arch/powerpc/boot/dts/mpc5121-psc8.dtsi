// SPDX-License-Identifier: GPL-2.0-or-later

&soc {
	psc8: psc@11800 {
		compatible = "fsl,mpc5121-psc";
		reg = <0x11800 0x100>;
		interrupts = <40 0x8>;
		fsl,rx-fifo-size = <16>;
		fsl,tx-fifo-size = <16>;
		clocks = <&clks MPC512x_CLK_PSC8>,
			 <&clks MPC512x_CLK_PSC8_MCLK>;
		clock-names = "ipg", "mclk";
		status = "disabled";
	};
};
