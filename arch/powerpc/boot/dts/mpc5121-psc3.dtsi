// SPDX-License-Identifier: GPL-2.0-or-later

&soc {
	psc3: psc@11300 {
		compatible = "fsl,mpc5121-psc";
		reg = <0x11300 0x100>;
		interrupts = <40 0x8>;
		fsl,rx-fifo-size = <16>;
		fsl,tx-fifo-size = <16>;
		clocks = <&clks MPC512x_CLK_PSC3>,
			 <&clks MPC512x_CLK_PSC3_MCLK>;
		clock-names = "ipg", "mclk";
		status = "disabled";
	};
};
